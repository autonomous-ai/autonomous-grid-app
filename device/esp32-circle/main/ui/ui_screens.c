// ⚠️ A NOTE ON THE WORD "AGENT" IN THIS FILE.
//
// The vocabulary here is grid-app's: a PROJECT is the working unit with a workspace, and an AGENT is the
// runtime that answers in it (claude · codex · hermes · pi). The reference firmware this file is a cut-down
// copy of uses those two words the OTHER WAY ROUND — its "agent" is what grid-app calls a project — and
// its comments, its statics (`s_tiles[]` is still indexed by what it called an agent), its helper names
// (`ring_of_agent`, `agent_actions_apply`) and its geometry notes came across with it.
//
// Every string a USER can read has been converted. The internal names have not, deliberately: renaming
// them would touch several hundred lines of otherwise byte-faithful layout code for no behavioural gain,
// and this port exists because the last one learned what hand-editing that code costs. So read "agent" in
// a comment or an identifier below as "project", and never copy one of those words into a label.
#include "ui_screens.h"
#include "display.h"
#include "audio_capture.h"
#include "panel_client.h"
#include "power.h"
#include "ram_telemetry.h"
#include "voice.h"
#include <stdio.h>
#include <string.h>
#include <strings.h>   // strcasecmp / strncasecmp
#include <ctype.h>     // tolower / toupper / islower — runtime-v1 profile label formatting
#include <stdlib.h>
#include <stdint.h>
#include <time.h>
#include "lvgl.h"
#include "cJSON.h"
#include "icons_settings.h"
#include "spinner_spokes.h"   // 12 pre-rotated spinner bars (see the .c for why they are baked)
#include "icons_voice.h"      // Figma voice-state icons (mic/recording/tick)
#include "icons_engine.h"     // engine product marks
#include "esp_app_desc.h"   // esp_app_get_description — the Version row
#include "esp_log.h"
#include "esp_timer.h"
#include "esp_attr.h"
#include "../device_prefs.h"   // the one setting this device owns: its own brightness
#include "freertos/FreeRTOS.h"
#include "freertos/task.h"   // vTaskDelay — ui_scroll_benchmark paces its passes

static const char *TAG = "ui";

// Main UI font: Roboto Condensed (SIL OFL, full Vietnamese incl. ₫; ✓/✗ merged in from Arial Unicode).
// Condensed = narrower glyphs → more text per line / less truncation on the 466px round screen. Two weights:
// Geist — Regular for body/labels, Medium for names, titles and emphasis. Generated by
// scripts/gen_fonts.sh from the TTFs vendored under fonts/; see the `Opts:` header inside any of these
// files for the exact lv_font_conv invocation, and regenerate rather than hand-editing.
//
// A family swap ONLY: the five sizes are the ones the Roboto Condensed set used, so every call site kept
// its meaning and this was a rename. Geist is a normal-width proportional face where Roboto Condensed was
// a narrow one — measured, 0.534 em against 0.453 em average ASCII advance, so every line is ~18% longer
// than the surrounding geometry was tuned for. Those clip limits and max_widths are deliberately untouched.
//
// LVGL's Montserrat faces stay linked for LV_SYMBOL_* only: those are private-use codepoints that exist in
// no other font, so a label carrying one keeps a Montserrat face or its glyph draws as an empty box.
extern const lv_font_t geist_reg_16;
extern const lv_font_t geist_reg_20;
extern const lv_font_t geist_reg_24;  // small labels / muted meta
extern const lv_font_t geist_reg_25;  // main body: project-screen content, event cards, settings rows
extern const lv_font_t geist_med_28;
extern const lv_font_t geist_med_32;  // titles, section headers, agent name in the reader, status verb
extern const lv_font_t geist_reg_32;
extern const lv_font_t geist_reg_34;
extern const lv_font_t geist_reg_38;  // large body: reader detail, "No activity" placeholder, the "+" glyph
extern const lv_font_t geist_med_38;
extern const lv_font_t geist_med_48;
// The only SemiBold on the device: the reset confirm's primary, which the design sets one weight
// above its neighbours to mark it as the safe, committing action.
extern const lv_font_t geist_sem_24;  // largest display: tile agent name + overview agent count

// Round 466x466 AMOLED: keep ALL content inside the inscribed square (~330px, r·√2) and CENTRE it,
// so nothing reaches the curved edge. 330px is the widest column whose corners never clip; centred
// text makes the side margins read as intentional. Both axes centred + short content = stays in the
// circle's safe band (no top/bottom arc clip).
#define SCREEN_PAD   18
#define SAFE_CONTENT_W 384       // centred column for readable content — wide, since content sits in the
                                 // circle's mid band where the usable width is much larger than the inscribed square
// Overview action row, +10% over the first pass. The mockup budgeted 320px because it drew the row at
// y=330, where the chord is only ~333px. It does not sit there: the tile is a CENTRED flex column, which
// lands the row at y≈220-292 (238-312 with the "N working" line shown), and the chord is ~451px there.
// So the width was never the binding constraint — 352 clears the arc by ~99px.
// Re-check this if the column above ever grows a line: at y=410 the chord drops to 303px.
#define OV_ACT_W     352
#define OV_ACT_H     73
#define OV_ACT_GAP   13
// TWO rows: Goal + Loop share the top one, Voice sits alone beneath them — nearest the thumb, which
// rests low.
//
// The bottom row is deliberately NARROWER, and that is the arc talking, not taste. A second row does not
// drop into free space, it drops into a NARROWING one: the panel is 451px wide at the top row's baseline
// but only 366px at the bottom row's. So the block tapers wide → narrow going down, the same direction
// the panel tapers, and the shape agrees with the glass instead of fighting it.
//
// 329px for Voice clears the arc by 37px in the worst case. Its full 352px would leave 14px — 7px a side,
// which is not an overflow but is inside the margin where one more line in the column above turns it into
// one. That worst case is a BUSY machine: the green "N working" line pushes the whole column down 40px,
// so a too-wide bottom row looks perfect on an idle device and breaks on a working one. Re-run the
// numbers if anything above ever grows a line.
#define OV_MOD_W     ((OV_ACT_W - OV_ACT_GAP) / 2)                  // 169 — top row fills the full width
#define OV_VOICE_W   329                                            // bottom row, inset to clear the arc
#define OV_VOICE_X   ((OV_ACT_W - OV_VOICE_W) / 2)                  // 11 — centred under the pair above
#define OV_ROW2_Y    (OV_ACT_H + OV_ACT_GAP)                        // 86
#define OV_ACT_BLK_H (2 * OV_ACT_H + OV_ACT_GAP)                    // 159 — the whole two-row block
#define SAFE_W       lv_pct(72)  // ~335px — wrapped text on the side screens stays inside the curve
// MAX_TILES comes from panel_client.h, so the layer that RECEIVES the list and the layer that renders
// it cannot disagree about how many there can be. The UI keeps only a thin shell per project and
// materialises the heavy content for the active tile ± a window.
#define MAX_EVENTS   1      // tile shows only the latest event (the most recent summary)
#define TODO_VISIBLE_ROWS 4 // todo checklist shows this many rows; the rest scroll (keeps status on screen)
#define AGENTS_VISIBLE_ROWS 3 // sub-agent list shows this many rows; the rest scroll (coexists with the tool line)
#define BUSY_DOTS    3      // "processing" indicator = this many blinking dots (a loading animation)
#define PREVIEW_BYTES 220   // tile teaser length (bytes, UTF-8 safe) — one card has room for a longer
                            // tease; full text still via tap-to-read

#define COL_BG     lv_color_hex(0x000000)
#define COL_FG     lv_color_hex(0xeaeaf0)
#define COL_MUTED  lv_color_hex(0x8a8a99)
#define COL_GREEN  lv_color_hex(0x35c46a)
#define COL_VOICE     lv_color_hex(0x00ff2f)   // Figma "Section final": voice waveform + active sparkle green
#define COL_SPARK_OFF lv_color_hex(0xffffff)   // Figma "Section final": idle sparkle white (sweeps white↔green)
#define COL_DOT_OFF   lv_color_hex(0x4c4c4c)   // Figma overview: inactive page-dot grey + MACHINE eyebrow
#define COL_INK_LOW   lv_color_hex(0x5e5e6c)   // "present but dead" — how a disabled control is dimmed, since
                                               // lv_obj_set_style_opa() forces a temp layer (see display.c)
#define COL_RED    lv_color_hex(0xff5a5a)
#define COL_ACCENT lv_color_hex(0x5b8cff)
#define COL_YELLOW lv_color_hex(0xf0b429)
#define COL_ORANGE lv_color_hex(0xff8a4c)   // working-status verb row
#define COL_CLAUDE lv_color_hex(0xcc7c5e)   // matches the shared Claude reference color
#define COL_CARD   lv_color_hex(0x16161c)
// The Settings tile's palette. Also dresses the question card's option pills and the cancel overlays.
#define COL_SET_BG   lv_color_hex(0x000000)   // settings tile background + icon circle (black, per new Figma)
#define COL_SET_PILL lv_color_hex(0x1c1c1c)   // settings row pill fill (dark grey)
#define COL_SET_BORD lv_color_hex(0x333333)   // settings pill border
#define COL_BRIGHT   lv_color_hex(0x059600)   // brightness fill — the green the Figma track starts from

// ── Settings list geometry ─────────────────────────────────────────────────────────────────────────
// Rows are UNIFORM: one width, one height, no gap, in a scrollable column. The reference tapered them
// (336/427/427) to squeeze four into the circle at once; a list that scrolls does not need to, and equal
// rows are what make three of them read as a list rather than as three loose controls.
#define SET_ROW_W    320
#define SET_ROW_H    84
#define SET_LIST_PAD 65    // first row starts where the design puts it
#define SET_ROW_FONT (&geist_reg_32)

// Figma "New Setting" (Brightness): a 427-wide track at y=231 with the title above it at y=151.
#define BRIGHT_BOX_W 427
// The fill has a 20% floor, because min brightness IS 20% (see BRIGHT_MIN) — the track bottoms out at a
// fifth of the box and is never empty. An empty track would read as "off", and this screen cannot turn off.
#define BRIGHT_FILL_MIN (BRIGHT_BOX_W / 5)
#define COL_SET_BLUE lv_color_hex(0x006fff)   // the "Keep it" primary on the reset confirm (Figma)

static lv_obj_t *scr_error, *scr_projects;
static lv_obj_t *scr_reader, *reader_lbl;   // full-screen scrollable reader for one event's full text
static lv_obj_t *s_reader_name;             // project/agent name in the reader's top pill (Figma detail screen)
static lv_obj_t *scr_question;              // the `question` card: tappable option rows (rebuilt per render)
// "Not connected" badge on lv_layer_top. One state now, not three: over a cable there is no radio to be
// up while the peer is down, so the only question is whether grid-app has said anything in the last 15 s
// (docs/panel-protocol.md, "Heartbeat").
static lv_obj_t *s_reconnect_badge;
static lv_obj_t *err_title, *err_detail;
// The firmware-update screen: a spinner and one line, built on first use (an update is rare and this
// costs nothing until one arrives).
static lv_obj_t *scr_fw, *s_fw_lbl;

static lv_obj_t *tileview;
static lv_obj_t *page_dots;       // bottom page-indicator dots (one per project, active highlighted)
static lv_obj_t *mic_btn;
static lv_obj_t *s_sending_lbl;   // "Sending…" shown while a recorded voice clip uploads (mic already hidden)
// Figma voice-state indicator (bottom-center): mic (press) → recording bars → spinner (sending) → tick.
static lv_obj_t *s_voice_img;     // lv_image showing mic / recording / tick
static lv_obj_t *s_send_dots[3];  // three "typing" dots pulsing in sequence while the clip uploads
static lv_obj_t *s_pulse[2];      // two translucent circles rippling behind the mic while recording
// Figma "Section final" voice screens (retire the orb/glow/dots above): recording = 7 green bars pulsing as a
// travelling waveform; sending = 3 sparkles with a green highlight sweeping 0→1→2 over grey.
static lv_obj_t *s_wave[7];       // waveform bars (recording); animated by REAL height (never transform → OOM)
static lv_obj_t *s_send_sp[3];    // sending sparkles (icon_sparkle, recolored green/grey)
static int       s_send_idx;      // which sparkle is currently green; advanced ~3 Hz by busy_dots_tick
typedef enum { VIC_NONE, VIC_MIC, VIC_REC, VIC_SEND, VIC_DONE } voice_icon_state_t;
static voice_icon_state_t s_vic_state;
static voice_cmd_t s_voice_cmd;    // command this capture carries → "GOAL"/"LOOP" label above the waveform
static lv_obj_t *s_voice_goal_lbl; // that label (kept under its original name; it now shows either word)

// GOAL and LOOP are modifiers on the utterance you are ABOUT to speak. `voice.begin` carries them as `cmd`
// and grid-app puts "/goal " or "/loop " in front of the transcript. **`cmd` is a prefix, not a mode**: a
// plain turn and a modified one differ by the KEY being there, not by its value, so a panel that had never
// heard of a modifier would simply omit it. The panel's job ends at `cmd`.
//
// Three plain buttons rather than a value held between taps: each starts a recording in its own mode, so
// nothing survives a turn and there is no state to fall back from.
static uint32_t s_voice_start_ms;   // lv_tick at capture start → drives the cap below
// TEN MINUTES, and the device must draw the same number the app enforces: grid-app stops accepting audio
// at 600 s of PCM (kPanelVoiceMaxBytes) and closes a capture it has heard nothing more about at 660 s
// (kPanelVoiceOpenLimit) — the second is a backstop for a `voice.end` that never arrived, not a second cap.
//
// This was 60 s until 2026-08-18, and what it was really measuring was voice.c's record buffer: that
// buffer was linear rather than a ring, so nothing was reclaimed as it was sent and capture died at 2 MB
// = 65 s. 60 was a number tucked under 65. It then got explained upward — this comment used to argue the
// cap in terms of user experience ("a device that offered ten minutes would let someone talk into a
// recording that ended without saying so"), and docs/panel-protocol.md said the same thing normatively.
// The reasoning was sound and the premise was a bug. voice.c's ring is what makes 600 s honest: the
// panel now streams continuously and the buffer only has to hold the SENDER's backlog.
//
// ⚠️ A capture at this length is 19.2 MB of WAV, and the control plane refuses anything over 25 MB
// (MAX_AUDIO_BYTES). The invariant is `seconds x sample-rate x 2 < 25 MiB` — at 16 kHz that is a ceiling
// of ~13.6 minutes, so raising AUDIO_SAMPLE_RATE without lowering this returns HTTP 413 to somebody who
// has just finished speaking for ten minutes.
#define VOICE_MAX_MS 600000u
static uint32_t s_voice_max_ms = VOICE_MAX_MS;
// Silence auto-stop, DISABLED — and now a deliberate choice rather than a cheap one (2026-08-18). A
// recording that never crossed voice.c's speech gate within VOICE_SILENCE_MS used to be discarded, so an
// accidental Voice press could not sit there recording. Flip to 1 to bring it back.
//
// What it costs while it is off: a press nobody meant now records for TEN MINUTES rather than one, keeps
// the screen awake for all of it, and hands grid-app a 19 MB clip to upload to a paid transcriber. The
// old note here said this "matters much less now that the cap is 60 s" — that half is no longer true and
// is why the sentence is rewritten rather than left.
#define VOICE_SILENCE_AUTOSTOP 0
#define VOICE_SILENCE_MS 15000u
static void ui_voice_discard_silent(void);   // fwd: silent auto-abort teardown (defined below)
// Overview ROUTE voice: true from route-capture start until the router answers (voice_routed / empty / error /
// watchdog). While set we KEEP the "Sending…" loading overlay up AFTER the upload finishes — the router is still
// choosing an agent — so the user sees it working instead of the UI snapping back to a static Overview.
static bool s_voice_routing;
static uint32_t s_voice_route_ms;   // lv_tick when the upload finished (routing wait begins) → routing watchdog
// Release the loading overlay if the router never answers. Sized against the same sum as voice.c's
// REPLY_WAIT_MS — grid-app's STT timeout (120 s) plus its router deadline (30 s) — because this overlay
// is covering exactly that wait. The 60 s it inherited was described as "generous for ~10-min
// recordings", which was true of the reference's own transcription path and never of this one: here a
// 10-minute capture is a 19 MB upload followed by a model call, and only then the routing decision.
#define VOICE_ROUTE_WAIT_MS 180000
// Notification centre: a top "bell + unread count" pill + a pull-down drawer listing recent done events.
#define NOTIF_MAX 8
#define NOTIF_DEBUG_SEED 0   // set 1 to seed fake notifications at boot for testing the drawer redesign
// One machine only — the computer holding the cable — so a notification no longer records which machine
// it came from, and tapping one can never mean "switch machines first".
typedef struct { char proj_id[48]; char name[44]; char summary[100]; uint32_t ms; bool unread, used; } notif_t;
static EXT_RAM_BSS_ATTR notif_t s_notif[NOTIF_MAX];   // newest at index 0; opening marks read, tapping a row removes that one
static lv_obj_t *s_notif_pill;            // top-mid "🔔 N" count badge (projects screen, when N>0)
static lv_obj_t *s_notif_pill_lbl;        // the "N" label inside the pill
static lv_obj_t *s_notif_drawer;          // full-screen pull-down overlay (top layer), hidden by default
static lv_obj_t *s_notif_list;            // scrollable column of notification rows inside the drawer
static lv_obj_t *s_notif_empty;           // "No notifications" placeholder
static bool      s_notif_open;            // drawer currently shown
static lv_obj_t *s_creating_spin; // rotating spinner shown while a new project is being created (HTTP round-trip)
static lv_obj_t *stop_btn;       // red square overlay: interrupt the active project's running turn
static lv_obj_t *s_cancel_confirm; // "Cancel task?" Yes/No overlay (top layer) — guards the BOOT-button cancel
static bool s_connected;

// The Goal / Voice / Loop cluster on a project tile. Built ONCE on scr_projects, not per tile: all three
// act on whichever project is centred, so N copies would be N times the LVGL objects for identical buttons.
static lv_obj_t *s_agent_acts;
static lv_obj_t *s_no_agents_tile;   // persistent "No projects yet" page, shown at ring RING_LEAD ONLY when s_tile_count==0
static lv_obj_t *s_no_agents_hint_lbl; // the closing line under the command
static lv_obj_t *s_na_eyebrow;       // machine name above the no-projects headline
static lv_obj_t *s_na_title;         // "No projects yet"
static lv_obj_t *s_na_cmd_lbl;       // the green command inside its code pill
static lv_obj_t *s_overview_tile;      // persistent leading "overview" tile (ring 0): machine eyebrow + "N projects"
static lv_obj_t *s_overview_count_lbl; // the "N projects" label inside the overview tile (updated on count change)
static lv_obj_t *s_overview_working_lbl; // green "<N> <gerund>…" sub-line — count of busy agents + a rotating verb; hidden when 0
static lv_obj_t *s_overview_machine_lbl; // the eyebrow = selected machine NAME (updated on machine select/reload)
// The two lines the Overview shows once grid-app has been silent for 15 s. NOT an error state and it must
// not read as one: the app being closed is this panel's ordinary resting condition.
static lv_obj_t *s_overview_offline_hint_lbl;
static lv_obj_t *s_overview_offline_cmd_lbl;
static lv_obj_t *s_overview_spin;      // loading spinner shown in place of "N projects" while the list loads
static lv_obj_t *s_overview_actions;   // the 2:1:1 action row (Voice / Goal / Loop) below the agent count
static lv_obj_t *s_overview_voice_btn;
static lv_obj_t *s_overview_goal_btn;
static lv_obj_t *s_overview_loop_btn;
// Kept so the disabled state can be painted with COLOUR. Never reach for lv_obj_set_style_opa() here:
// it forces the object onto a temp layer, and that is exactly what hung the LVGL task on this board.
static lv_obj_t *s_ov_goal_ico[3];     // the three target rings, outermost first
static lv_obj_t *s_ov_loop_ico;        // the repeat-arrows image (recoloured, not a font glyph)
static lv_obj_t *s_ov_goal_lbl, *s_ov_loop_lbl;
static bool      s_ov_ready;           // last value overview_actions_apply() computed, for overview_mod_apply()
static bool      s_overview_loading;   // true = agents not loaded yet → show s_overview_spin, hide the count
// Project to focus once the list finishes loading ("" = land on the Overview).
static char s_notif_focus[48];
static volatile bool s_machine_landing_pending;   // land (drop the spinner + focus a project) once the list is built
static bool      s_remote_offline_view; // grid-app silent past the heartbeat → the Overview shows the guide
static bool      s_remote_online_reload; // offline→online reload: focus a project only if the Overview is still visible
static uint8_t s_brightness = 0x99;  // cached brightness level (0x00 dim .. 0xFF bright)
static lv_obj_t *s_dim;              // full-screen black overlay on the top layer; its opacity = the dimming
static lv_obj_t *s_voice_overlay;    // voice-mode overlay: shown while recording/uploading; we also FREE all
                                     // tile content then so the PCM capture keeps its internal-RAM headroom

// Raise an lv_layer_top overlay, then put the software dim BACK on top of it.
//
// The dim is a black overlay on the same layer, so "brightest thing on screen" is decided purely by
// z-order. Any overlay that calls lv_obj_move_foreground() lands above the dim and therefore renders at
// FULL brightness whatever the user set — which is how the reset confirm came up blinding on a device
// dimmed right down. Nothing warns about it; the overlay looks perfectly correct in isolation.
// Use this instead of lv_obj_move_foreground() for anything parented to lv_layer_top().
static void overlay_raise(lv_obj_t *o)
{
    if (o) lv_obj_move_foreground(o);
    if (s_dim) lv_obj_move_foreground(s_dim);
}
#define BRIGHT_MIN 0x14              // dim floor → the screen never dims to fully unreadable
static bool s_overview_active;       // true while the leading overview tile (ring 0) is the visible page

// ── Settings ───────────────────────────────────────────────────────────────────────────────────────
static lv_obj_t *s_settings_tile;    // the trailing tile, after the last project
static bool s_settings_active;       // true while the settings tile is the visible page
static lv_obj_t *s_vlang_lbl;        // the Voice row's VALUE — refreshed in place when the app says so

// Which language a voice capture is transcribed in — "en" or "vi".
//
// grid-app PROPOSES one from the machine's own locale (`welcome.voiceLang`); a tap on the Settings row
// DECIDES. The person holding the panel may well speak something other than the laptop is set to, so the
// app's reading is a default and not an answer. Whatever ends up here rides every `voice.begin`, which is
// what makes the server transcribe in it.
static char s_voice_lang[8];

static lv_obj_t *s_bright_screen;    // full-screen overlay on lv_layer_top, built once then shown/hidden
static lv_obj_t *s_bright_box;       // the track — and the drag surface, no separate catcher
static lv_obj_t *s_bright_fill;      // the green fill, a plain rounded rect (see build_brightness_screen)
static bool s_bright_dragging;
// The machine's name, from `welcome.machine.name`. One machine, so it is a string and not a list.
static char s_machine_name[64];

static void cancel_confirm_yes(lv_event_t *e); // "Cancel task?" Yes → actually cancel the turn
static void cancel_confirm_no(lv_event_t *e);  // "Cancel task?" No → dismiss, keep the turn running
static void stop_event(lv_event_t *e);   // tap STOP → cancel the active turn (defined below)
static void update_stop_btn(void);       // show/hide STOP per active tile's processing state (caller holds lock)
static void agent_actions_apply(void);   // show/hide the per-agent Goal/Voice/Loop cluster (caller holds lock)
static void build_agent_actions(void);   // build that cluster once on scr_projects (defined below)
static void notif_badge_apply(void);     // show/hide the top unread pill (defined below)
static void notif_bg_tap(lv_event_t *e); // tap the drawer's empty area → close (defined below)
static int  utf8_clip(const char *s, int max); // clip to <=max bytes on a codepoint boundary (defined below)
static void utf8_filter(const char *s, char *out, size_t cap); // strip glyphs the font can't render (emoji/CJK)
static void chip_clip(const char *src, char *out, size_t cap, size_t max_glyphs); // codepoint-safe clip (defined below)
static void tile_changed(lv_event_t *e); // tileview swipe tracker (defined below)
static void carousel_scroll(lv_event_t *e); // per-frame leading-edge cover for the 1-agent ring (defined below)
static void rebuild_page_dots(void);     // (re)build the bottom page-indicator dots (defined below)
static void rebuild_overview_tile(void); // refresh the overview tile's "N projects" label (defined below)
static void rebuild_settings_tile(void); // (re)build the trailing Settings tile (defined below)
static const char *vlang_tag(void);      // the Voice row's two-letter tag (defined below)
static void settings_vlang_tap(lv_event_t *e); // Settings → Voice: switch the language (defined below)
static void settings_passcode_tap(lv_event_t *e); // Settings → Passcode: set or turn off (defined below)
static void apply_dim(uint8_t level);    // dim overlay for a brightness level (defined below)
static void overview_actions_apply(void);// enable/disable the Overview Voice / Goal / Loop actions
static void overview_working_apply(void);// refresh the "<N> <gerund>…" sub-line from the agents' busy_model flags
static void overview_working_tick(lv_timer_t *t);// rotate the working verb while the row is shown
static void overview_voice_tap(lv_event_t *e);
static void overview_goal_tap(lv_event_t *e);    // start recording a GOAL turn
static void overview_loop_tap(lv_event_t *e);    // start recording a LOOP turn
static void overview_mod_apply(void);            // dim/undim the Goal + Loop pills with the rest of the row
static void update_content_window(void); // (re)materialize the active-tile±window; position the fixed tiles
static void clear_removed_project_transients_locked(const char *chat_id, bool voice_aborted);
static int find_proj(const char *id);            // index of the project with this id, or -1 (defined below)
static void voice_start_impl(voice_cmd_t cmd);
static void ev_card_free(lv_event_t *e); // free an event card's stored full text (defined below)
static void open_reader_text(const char *full); // swipe-up → open the full-text reader (defined below)
static void open_agent_detail(const char *proj_id); // notification tap → focus that agent AND open its detail
static void reader_close(lv_event_t *e); // swipe-down at top → back to projects (defined below)
static void voice_overlay_set(bool on);  // voice: dark overlay + free/restore tile content (RAM headroom)
static void notif_pill_tap(lv_event_t *e);       // the bell → open the drawer (defined below)
static void switch_close(void);                  // close the picker without picking (defined below)

// ---- agent switcher ----
// A picker over the MOST RECENT agents, opened by PULLING DOWN from the top of an agent tile. Swiping the
// carousel is the only other way across, and it is one tile at a time: with a few dozen chats, reaching the
// one you want means passing every one you don't. The list is the app's own order — see switch_rebuild.
//
// It took the pull-down from the notification drawer, and the drawer moved to a tap on the bell. The two
// had been fighting for the same 44px band at the top of the face: whichever control sat there was inside
// the drawer's gesture, and a bell that only needs a tap has no business owning a whole edge of a round
// screen while the thing you reach for constantly needs a button.
#define SWITCH_LIST_MAX 10
static lv_obj_t *s_switch_screen;               // full-screen overlay on the top layer, hidden by default
static lv_obj_t *s_switch_list;                 // the scrollable column of rows inside it
// The ids currently drawn, indexed by the row's user_data. Fixed storage rather than a strdup per row:
// the array's life IS the picker's, and rows are rebuilt on every open.
static char s_switch_ids[SWITCH_LIST_MAX][ID_MAX];

typedef struct {
    char id[48];
    char name[80];       // MODEL: the chat's title (clipped) — source of truth, was only in name_lbl (view)
    char project[48];    // MODEL: the project it lives in, drawn under the title. A tile is one CHAT, and two
                         // chats in one folder read as the same work without it.
    char engine[12];      // MODEL: claude|codex|cursor|opencode|pi|hermes|commandcode|devin; empty hides the mark
    char mode[8];        // MODEL: per-agent autonomy for voice turns — "plan" | "" (empty = auto/bypass)
    // The model, as `model` on the project shape — a PLAIN STRING ("auto", "opus", "gpt-5.6-sol"), not the
    // reference's opaque runtime-v1:<sid>:<engine>:<model>@<effort> profile. That profile carried an effort
    // axis and a session; this wire carries neither, which is why there is no `effort` field here and the
    // effort chip is a literal word.
    char model[64];
    char model_label[28];        // formatted for the chip
    lv_obj_t *tile;
    lv_obj_t *dot;
    lv_obj_t *header;    // one top-level flex child containing name + engine (keeps body geometry stable)
    lv_obj_t *name_lbl;
    lv_obj_t *project_lbl;   // the subtitle under the title, hidden while the tile has no project
    lv_obj_t *engine_lbl;
    lv_obj_t *engine_text_lbl; // hidden compatibility fallback; known engines use product-mark images
    lv_obj_t *model_lbl;  // tappable Model chip above the name → opens the model picker (remote machines)
    lv_obj_t *effort_lbl; // tappable Effort chip above the name → opens the effort picker (remote machines)
    lv_obj_t *ctl_row;    // the [mark][Model][Effort] row itself — needed to ask whether it is on screen
    lv_obj_t *body;     // fills the space below the pinned name; centers its content (list/busy/todo)
    lv_obj_t *list;     // centered column of event rows
    lv_obj_t *empty;    // placeholder until first event
    lv_obj_t *busy;     // transient working-status container (2 rows) — not part of the event ring
    lv_obj_t *busy_icon; // green "loading" sparkle spinning before the verb
    lv_obj_t *busy_verb; // orange row: rotating gerund ("› Working…")
    lv_obj_t *busy_meta; // grey row: "<elapsed> · <tokens> tokens"
    lv_obj_t *tool_line; // live "current tool" row above busy (colored toolName + muted title), or NULL
    lv_obj_t *agents;    // sub-agent (Task/Agent delegation) list above busy — one row per sub-agent, or NULL
    int64_t   busy_since; // esp_timer_get_time() when this turn's processing began (for elapsed)
    int       busy_tokens; // unused on this wire: `turn.parts` carries no token count. Kept as one int so
                           // the struct does not have to be re-shaped if one is ever added.
    int64_t   busy_last_ms; // esp_timer_get_time() at the last live 'processing' frame (turn OR summarize
                           // heartbeat: turn.parts). ui_prune_stale_busy clears busy if these stop
                           // arriving for > BUSY_TIMEOUT — a terminal event was lost / never produced.
    lv_obj_t *todo;       // Todo checklist container (below project name, shown while processing)
    lv_obj_t *todo_active; // the in_progress row's glyph (pulsed by busy_dots_tick), or NULL
    // --- lazy-content model (see "lazy content windowing" below) ---
    // Every project keeps a thin SHELL (tile/hdr/dot/name_lbl); the heavy CONTENT (body/list/card/
    // busy/todo/…) is materialized only for the active tile ± CONTENT_WINDOW and torn down otherwise.
    // These fields hold the render state so an off-window tile can be rebuilt on entry, and so live
    // live events (keyed by project id) land even when the tile's LVGL content isn't built.
    bool      content_live;  // is the CONTENT subtree (body/list/…) currently materialized?
    int       tile_col;      // absolute carousel column this agent's tile is currently positioned at (valid while content_live)
    bool      busy_model;    // model: is a turn currently processing (independent of the `busy` obj)
    lv_color_t m_col;        // color of the last event card (kind_style result)
    char     *m_preview;     // PSRAM: tile-preview text of the last event (NULL = none → "No activity yet")
    char     *m_full;        // PSRAM: full text of the last event (for the tap-to-read reader)
} tile_t;
static tile_t *s_tiles;   // MAX_TILES array, allocated in PSRAM at ui_init (off the internal .bss)
static int s_tile_count;
static int s_active_idx;   // currently-visible agent index (updated on swipe; defaults to 0)

// --- Carousel scroll helpers ---
// `tileview` is now a plain horizontally-scrollable lv_obj (NOT lv_tileview): paging is done with
// LV_SCROLL_SNAP_CENTER + LV_OBJ_FLAG_SCROLL_ONE (exactly what lv_tileview uses internally, so the feel
// is identical), and each tile is positioned at column*width. carousel_goto centers a column;
// carousel_col reads which column is centered from the scroll position.
static int32_t carousel_w(void) { int32_t w = tileview ? lv_obj_get_width(tileview) : 0; return w > 0 ? w : 466; }
static int32_t carousel_h(void) { int32_t h = tileview ? lv_obj_get_height(tileview) : 0; return h > 0 ? h : 466; }
static void carousel_goto(int col, lv_anim_enable_t anim) { if (tileview && col >= 0) lv_obj_scroll_to_x(tileview, col * carousel_w(), anim); }
static int carousel_col(void) { if (!tileview) return 0; int32_t w = carousel_w(); int32_t sx = lv_obj_get_scroll_x(tileview); return w > 0 ? (int)((sx + w / 2) / w) : 0; }
// Invisible 1px child that forces the scroll content width to (agent_count+1)*W, keeping scroll positions
// ABSOLUTE (one column per agent) even though only the ~CONTENT_WINDOW agent tiles around the visible one
// are ever materialized. A far-off agent then costs ZERO LVGL objects → truly unlimited agent count.
static lv_obj_t *s_carousel_spacer;
// Huge virtual scroll range: the carousel is a RING of (project_count + 1) positions (0 = the Overview,
// 1..N = project[r-1]) repeated CAROUSEL_M times. Column c maps to ring position `c % (N+1)`. Starting in
// the middle means you never reach an edge, so EVERY swipe (including last project → Overview) is a native
// adjacent slide — no wrap jump, no recentre. M*W must stay under int32 max: 100000*466 ≈ 46.6M ✓.
#define CAROUSEL_M 100000
// ONE leading fixed tile (the Overview) precedes the projects, and nothing trails them. Cyclic order is
// overview → project0 → project1 → … → (wrap), so the Overview is ring 0 and project i lives at ring
// i+RING_LEAD. An EMPTY machine (N==0) keeps 2 positions [overview, No projects] so the carousel stays
// swipeable.
//
// RING_FIXED was 2 in the reference — a Settings tile and a Machines wheel. The Machines wheel still has
// nothing to say here: there is exactly one machine, the computer holding the cable. Settings is back, and
// TRAILS rather than leading as it did there, because ring 0 is the Overview on this device and the home
// swipe goes to it.
#define RING_LEAD  1                    // number of leading fixed tiles (the Overview) before the projects
#define RING_FIXED 1                    // number of trailing fixed tiles — the Settings tile
static void resize_spacer(void) { if (s_carousel_spacer) lv_obj_set_width(s_carousel_spacer, CAROUSEL_M * carousel_w()); }
static int ring_len(void)      { return RING_LEAD + (s_tile_count > 0 ? s_tile_count : 1) + RING_FIXED; }
static int ring_agents_end(void) { return ring_len() - RING_FIXED; }   // first ring AFTER the projects
static int ring_settings(void) { return ring_agents_end(); }   // the trailing Settings tile
static int agent_of_ring(int r) { return r - RING_LEAD; }   // ring → agent index (valid RING_LEAD..ring_agents_end()-1)
static int ring_of_agent(int i) { return i + RING_LEAD; }   // agent index → ring
static int ring_of_col(int c) { int m = ring_len(); int r = c % m; return r < 0 ? r + m : r; }
// Nearest column to `cc` whose ring position is `r` (for jump/focus/start).
static int col_for_ring_near(int cc, int r) {
    int m = ring_len();
    int fwd = (((r - ring_of_col(cc)) % m) + m) % m;   // 0..m-1 steps forward to reach ring r
    return (fwd <= m - fwd) ? (cc + fwd) : (cc - (m - fwd));
}
// Whether the page in front of the user is a PROJECT tile.
//
// Written as one predicate because "not the Overview" was standing in for it in a dozen places, and the
// day a THIRD kind of page arrived every one of them was wrong at once. Settings was that third page:
// `s_active_idx` only moves on a project ring, so on Settings it still named the project last looked at
// and `!s_overview_active` was still true — which put the Goal/Voice/Loop cluster on the Settings list,
// opened the previous project's reader on a tap meant for a settings row, and made a sentence spoken from
// Settings read as one aimed at that project.
//
// The lock is in here too: a page behind the unlock overlay is not a page anyone is looking at.
static bool on_project_page(void)
{
    return lv_screen_active() == scr_projects && !s_overview_active && !s_settings_active
        && !ui_lock_active();
}

// Set active/settings state from whichever ring position is centered right now (single source of truth).
// The tile the carousel is centred on, and the last one grid-app was told about.
//
// PENDING vs SENT is the debounce. A swipe across four tiles calls this function four times; sending each
// one would walk the desktop window through every conversation on the way past, which is not what the
// person spinning the carousel meant. The pending id is flushed by busy_dots_tick once it has stopped
// changing (FOCUS_SETTLE_MS), and only if it differs from what was already sent — which is also what stops
// an echo, since grid-app focusing a tile makes this function run again with the id it just chose.
#define FOCUS_SETTLE_MS 400
static char     s_focus_pending[ID_MAX];
static char     s_focus_sent[ID_MAX];
static uint32_t s_focus_at;

static void apply_active_from_col(void)
{
    int r = ring_of_col(carousel_col());
    s_overview_active = (r == 0);
    s_settings_active = (r == ring_settings());
    if (r >= RING_LEAD && r < ring_agents_end()) s_active_idx = agent_of_ring(r);   // project ring → project index
    agent_actions_apply();   // the cluster belongs to agent tiles only — follow the swipe, not the next tick

    // Overview and Settings name no chat, so they say nothing rather than sending "". The window keeps
    // whatever it was showing: swiping onto Settings is not a request to change what the desktop displays.
    const char *id = (s_tile_count > 0 && !s_overview_active && !s_settings_active
                      && s_active_idx >= 0 && s_active_idx < s_tile_count)
                     ? s_tiles[s_active_idx].id : "";
    if (strcmp(id, s_focus_pending) != 0) {
        snprintf(s_focus_pending, sizeof(s_focus_pending), "%s", id);
        s_focus_at = lv_tick_get();
    }
}

// ---- helpers ----
static lv_obj_t *make_screen(void)
{
    lv_obj_t *s = lv_obj_create(NULL);
    lv_obj_set_style_bg_color(s, COL_BG, 0);
    lv_obj_set_style_bg_opa(s, LV_OPA_COVER, 0);
    lv_obj_set_style_border_width(s, 0, 0);
    lv_obj_set_style_radius(s, LV_RADIUS_CIRCLE, 0);
    lv_obj_set_style_pad_all(s, SCREEN_PAD, 0);
    lv_obj_set_flex_flow(s, LV_FLEX_FLOW_COLUMN);
    lv_obj_set_flex_align(s, LV_FLEX_ALIGN_CENTER, LV_FLEX_ALIGN_CENTER, LV_FLEX_ALIGN_CENTER);
    lv_obj_set_style_pad_row(s, 10, 0);
    lv_obj_clear_flag(s, LV_OBJ_FLAG_SCROLLABLE);
    return s;
}

// ---- iOS-style loading spinner: 12 white rounded bars, brightest at the head, fading around, rotating ----
// Each spoke is a rounded-rect with a UNIFORM bg opacity (no line end-caps → no bright dots at the ends);
// oriented radially by a fixed transform_rotation. Only the opacity animates. sin/cos of i*30° (from top).
#define SPIN_SPOKES 12
static const float SPIN_S30[SPIN_SPOKES] = {0,.5f,.866f,1,.866f,.5f,0,-.5f,-.866f,-1,-.866f,-.5f};    // sin(i*30)
static const float SPIN_C30[SPIN_SPOKES] = {1,.866f,.5f,0,-.5f,-.866f,-1,-.866f,-.5f,0,.5f,.866f};     // cos(i*30)
typedef struct { lv_obj_t *spoke[SPIN_SPOKES]; lv_timer_t *timer; int phase; } spinner_t;

static void spinner_tick(lv_timer_t *t)
{
    spinner_t *s = lv_timer_get_user_data(t);
    s->phase = (s->phase + 1) % SPIN_SPOKES;
    for (int i = 0; i < SPIN_SPOKES; i++) {
        int d = (i - s->phase + SPIN_SPOKES) % SPIN_SPOKES;   // 0 = head (brightest)
        lv_opa_t opa = (lv_opa_t)(255 - d * 200 / (SPIN_SPOKES - 1));   // head 255 → tail ~55
        lv_obj_set_style_image_opa(s->spoke[i], opa, 0);   // fades the baked bar; no layer
    }
}

static void spinner_del(lv_event_t *e)
{
    spinner_t *s = lv_event_get_user_data(e);
    if (!s) return;
    if (s->timer) lv_timer_delete(s->timer);
    lv_free(s);
}

// iOS-style spinner sized size×size. Returns the container — hide/show/align it like any object.
static lv_obj_t *make_spinner(lv_obj_t *parent, int size)
{
    lv_obj_t *c = lv_obj_create(parent);
    lv_obj_remove_style_all(c);
    lv_obj_set_size(c, size, size);
    lv_obj_clear_flag(c, LV_OBJ_FLAG_CLICKABLE | LV_OBJ_FLAG_SCROLLABLE);
    spinner_t *s = lv_malloc(sizeof(spinner_t));
    if (!s) return c;
    s->phase = 0;
    float cxy = size / 2.0f, mid_r = size * 0.335f;
    // The spokes are a fixed 18px baked image; only the RING RADIUS scales with the spinner.
    for (int i = 0; i < SPIN_SPOKES; i++) {
        // Radial BARS, as before — but each one is a pre-rotated image rather than a rotated object.
        //
        // lv_obj_set_style_transform_rotation() makes LVGL snapshot the object to a temp layer and blit it
        // through transform_and_recolor(). Twelve spokes repainted every 70ms by the fade meant twelve
        // layer snapshots ~14 times a second for as long as a spinner was up, which saturated the LVGL task
        // on this panel and tripped the task watchdog every 5s. The bars are baked at build time instead
        // (spinner_spokes.c), so this is a plain blit and the fade rides on image_opa — no layer either way.
        lv_obj_t *b = lv_image_create(c);
        lv_image_set_src(b, spinner_spokes[i]);
        lv_obj_clear_flag(b, LV_OBJ_FLAG_CLICKABLE | LV_OBJ_FLAG_SCROLLABLE);
        int cx = (int)(cxy + mid_r * SPIN_S30[i] + 0.5f);    // bar centre on the ring (top = i0, clockwise)
        int cy = (int)(cxy - mid_r * SPIN_C30[i] + 0.5f);
        lv_obj_set_pos(b, cx - SPINNER_SPOKE_PX / 2, cy - SPINNER_SPOKE_PX / 2);
        s->spoke[i] = b;
    }
    s->timer = lv_timer_create(spinner_tick, 70, s);
    spinner_tick(s->timer);   // set the initial fade gradient
    lv_obj_set_user_data(c, s);
    lv_obj_add_event_cb(c, spinner_del, LV_EVENT_DELETE, s);
    return c;
}

static lv_obj_t *make_label(lv_obj_t *parent, const char *txt, lv_color_t color, const lv_font_t *font)
{
    lv_obj_t *l = lv_label_create(parent);
    lv_label_set_text(l, txt);
    lv_obj_set_style_text_color(l, color, 0);
    if (font) lv_obj_set_style_text_font(l, font, 0);
    lv_label_set_long_mode(l, LV_LABEL_LONG_WRAP);
    lv_obj_set_width(l, SAFE_W);
    lv_obj_set_style_text_align(l, LV_TEXT_ALIGN_CENTER, 0);
    return l;
}

/**
 * The "code pill" — the one component both setup screens share in the design: a command or an SSID set in
 * green on a lifted surface, so the thing the user must TYPE or LOOK FOR is never mixed up with the prose
 * around it.
 *
 * Figma: white @10% fill, 16px corner, 20/12 padding, Roboto Mono Medium 20 in #00FF2F. The radius is a
 * real 16 rather than a full pill — this box wraps a line of monospace, and a capsule around code reads as
 * a button.
 *
 * Returns the LABEL, because every caller updates the text (machine name, SSID) and none of them touch the
 * box again.
 */
static lv_obj_t *code_pill(lv_obj_t *parent, const char *text)
{
    lv_obj_t *box = lv_obj_create(parent);
    lv_obj_remove_style_all(box);
    lv_obj_clear_flag(box, LV_OBJ_FLAG_CLICKABLE | LV_OBJ_FLAG_SCROLLABLE);
    lv_obj_set_size(box, LV_SIZE_CONTENT, LV_SIZE_CONTENT);
    lv_obj_set_style_bg_color(box, COL_FG, 0);
    lv_obj_set_style_bg_opa(box, LV_OPA_10, 0);      // white @10%, per the design
    lv_obj_set_style_radius(box, 16, 0);
    lv_obj_set_style_pad_hor(box, 20, 0);
    lv_obj_set_style_pad_ver(box, 12, 0);
    lv_obj_t *l = lv_label_create(box);
    // The device has no 20px face; reg_25 is the nearest and keeps the design's 16 < 20 < 28 ordering
    // intact as 20 < 25 < 32.
    lv_obj_set_style_text_font(l, &geist_reg_25, 0);
    lv_obj_set_style_text_color(l, COL_VOICE, 0);
    lv_label_set_text(l, text);
    lv_obj_center(l);
    return l;
}

static void set_hidden(lv_obj_t *obj, bool hidden)
{
    if (!obj) return;
    if (hidden) lv_obj_add_flag(obj, LV_OBJ_FLAG_HIDDEN);
    else lv_obj_clear_flag(obj, LV_OBJ_FLAG_HIDDEN);
}


// Reflect the link state on the UI: green tile dots while grid-app is talking, muted when it is not, and
// a "Not connected" badge on the projects screen.
//
// ONE state where the reference had three. Over a cable there is no radio that can be up while the peer is
// down, and no node that can be offline behind a healthy socket — the only question is whether grid-app
// has said anything in the last 15 s (docs/panel-protocol.md, "Heartbeat"). Cheap (no animation) — safe to
// call every ~1s. Caller holds the display lock.
static void refresh_conn_ui(void)
{
    lv_color_t dotc = s_connected ? COL_GREEN : COL_MUTED;
    for (int i = 0; i < s_tile_count; i++)
        if (s_tiles[i].dot) lv_obj_set_style_bg_color(s_tiles[i].dot, dotc, 0);   // only windowed tiles have a dot

    if (!s_reconnect_badge) return;
    // Not while the Overview is already SAYING the app is off — the badge would repeat the headline in
    // smaller type, one line above it.
    bool show = lv_screen_active() == scr_projects && !s_connected &&
                !(s_overview_active && s_remote_offline_view);
    if (show) {
        lv_label_set_text(s_reconnect_badge, "Not connected");
        lv_obj_set_style_text_color(s_reconnect_badge, COL_MUTED, 0);
        lv_obj_clear_flag(s_reconnect_badge, LV_OBJ_FLAG_HIDDEN);
    } else {
        lv_obj_add_flag(s_reconnect_badge, LV_OBJ_FLAG_HIDDEN);
    }
}

// 1 Hz housekeeping. Nothing draws a battery cluster or an SSID any more — the board has no battery and
// this firmware has no radio — so all that is left is the plug-in wake and the link state.
static void statusbar_tick(lv_timer_t *t)
{
    (void)t;
    // Plugging in WAKES the screen once, then it idle-offs again after IDLE_MS. Poll EVERY tick, even
    // while asleep, so the transition is caught.
    static bool ext_prev = false;
    bool ext = power_is_on_external();
    if (ext && !ext_prev && display_is_asleep()) display_wake();   // just plugged in -> wake once
    ext_prev = ext;

    refresh_conn_ui();   // project dot colours + the "Not connected" badge
}

// Claude-Code-style rotating gerunds for the working-status verb row (ASCII only → font renders them).
static const char *GERUNDS[] = {
    "Working", "Brewing", "Cooking", "Churning", "Frosting", "Simmering", "Tinkering",
    "Conjuring", "Composing", "Percolating", "Wrangling", "Hatching", "Concocting", "Puttering",
};
#define N_GERUNDS ((int)(sizeof(GERUNDS) / sizeof(GERUNDS[0])))

// "34s" or "1m 05s"
static void fmt_elapsed(int64_t s, char *out, size_t cap)
{
    if (s < 60) snprintf(out, cap, "%llds", (long long)s);
    else        snprintf(out, cap, "%lldm %02llds", (long long)(s / 60), (long long)(s % 60));
}
// Refresh a project's working-status verb line (Figma "working"): a single green "<verb> <elapsed>" label
// (e.g. "Cooking… 34s"). The grey teaser below is the last recap, set once in render_busy_row (unchanged here).
static void busy_compose(tile_t *p)
{
    if (!p->busy_verb) return;
    int64_t sec = (esp_timer_get_time() - p->busy_since) / 1000000LL;
    if (sec < 0) sec = 0;
    char el[24]; fmt_elapsed(sec, el, sizeof(el));
    lv_label_set_text_fmt(p->busy_verb, "%s\xE2\x80\xA6 %s", GERUNDS[(sec / 6) % N_GERUNDS], el);   // Cooking… 34s
}

// Tick the "Sending…" upload dots + the active project's working-status rows (verb rotates ~6s,
// elapsed each 1s). Runs a few times/second; the status text is only re-set when the second changes.
// The floating mic is a pure STATUS INDICATOR now (voice is driven by the on-screen action buttons, a
// tap stops — see touch.c). Shown only during a live turn: the red mic while recording, the spinner
// while the clip uploads; hidden otherwise (and while asleep). Reads s_vic_state; caller holds the lock.
static void voice_btn_apply_visibility(void)
{
    if (!s_wave[0] || !s_send_sp[0]) return;
    bool sending   = (s_vic_state == VIC_SEND);
    bool recording = (s_vic_state == VIC_MIC || s_vic_state == VIC_REC);
    bool show = !display_is_asleep() && (recording || sending);
    for (int i = 0; i < 7; i++) set_hidden(s_wave[i],    !show || !recording);  // green waveform: recording only
    for (int i = 0; i < 3; i++) set_hidden(s_send_sp[i], !show || !sending);    // sparkles: uploading only
    if (s_voice_img) set_hidden(s_voice_img, true);   // legacy orb retired
}
// One breathing halo: t 0→1000 grows the circle (84→124px) and brightens it (55→120), then the anim's
// playback shrinks/dims it back — a soft glow that pulses in and out (not a sonar ripple). We animate the
// REAL size (a direct circle fill), NOT transform_scale / style opa — those snapshot the object to an
// oversized temp layer each frame and OOM the LVGL draw pool (that crashed the device). bg_opa is a plain
// per-pixel alpha blend, no layer.
static void pulse_anim_cb(void *var, int32_t t)
{
    lv_obj_t *o = var;
    int32_t sz = 84 + (int32_t)((int64_t)t * (124 - 84) / 1000);   // breathe 84 ↔ 124 px
    lv_obj_set_size(o, sz, sz);
    lv_obj_align_to(o, s_voice_img, LV_ALIGN_CENTER, 0, 0);        // stay centred on the mic
    lv_obj_set_style_bg_opa(o, (lv_opa_t)(55 + (int32_t)((int64_t)t * (120 - 55) / 1000)), 0);  // 55 ↔ 120, brightest at full size
}
// Start/stop the two-circle breathing glow behind the mic/dots (on while recording or sending).
static void voice_pulse_set(bool on)
{
    for (int i = 0; i < 2; i++) {
        if (!s_pulse[i]) continue;
        lv_anim_delete(s_pulse[i], pulse_anim_cb);
        if (on) {
            set_hidden(s_pulse[i], false);
            lv_anim_t a; lv_anim_init(&a);
            lv_anim_set_var(&a, s_pulse[i]);
            lv_anim_set_exec_cb(&a, pulse_anim_cb);
            lv_anim_set_values(&a, 0, 1000);
            lv_anim_set_duration(&a, 1400);
            lv_anim_set_playback_time(&a, 1400);      // grow AND shrink → a breathing halo
            lv_anim_set_repeat_count(&a, LV_ANIM_REPEAT_INFINITE);
            lv_anim_set_path_cb(&a, lv_anim_path_ease_in_out);
            if (i == 1) lv_anim_set_delay(&a, 700);   // 2nd circle out of phase → layered, continuous glow
            lv_anim_start(&a);
        } else {
            set_hidden(s_pulse[i], true);
            lv_obj_set_style_bg_opa(s_pulse[i], 0, 0);
        }
    }
}
// Start/stop the 3-dot "typing" upload indicator: each dot's opacity pulses 60↔255, staggered 160ms → a
// sequential bounce. Runs while the clip uploads (VIC_SEND).
static void dot_anim_cb(void *var, int32_t v) { lv_obj_set_style_bg_opa((lv_obj_t *)var, (lv_opa_t)v, 0); }
static void voice_dots_set(bool on)
{
    for (int i = 0; i < 3; i++) {
        if (!s_send_dots[i]) continue;
        lv_anim_delete(s_send_dots[i], dot_anim_cb);
        if (on) {
            set_hidden(s_send_dots[i], false);
            lv_anim_t a; lv_anim_init(&a);
            lv_anim_set_var(&a, s_send_dots[i]);
            lv_anim_set_exec_cb(&a, dot_anim_cb);
            lv_anim_set_values(&a, 60, 255);
            lv_anim_set_duration(&a, 450);
            lv_anim_set_playback_time(&a, 450);
            lv_anim_set_repeat_count(&a, LV_ANIM_REPEAT_INFINITE);
            lv_anim_set_delay(&a, i * 160);           // stagger → the three dots bounce in sequence
            lv_anim_set_path_cb(&a, lv_anim_path_ease_in_out);
            lv_anim_start(&a);
        } else {
            set_hidden(s_send_dots[i], true);
        }
    }
}
// Figma "Section final" waveform: 7 vertical rounded bars, symmetric rest heights, pulsing to a travelling
// wave. We drive it from ONE ~25 Hz timer computing each bar's height from a shared travelling phase (NOT
// per-bar lv_anim with a leading delay — that applied the collapsed start value to every bar at once and let
// them sit short for ~1 cycle before the stagger established, which looked janky on entry). Here every bar is
// already at a distinct phase on the very first frame, so it's smooth immediately. REAL height (and re-centre)
// each frame — never transform_scale, which snapshots to an oversized temp layer and OOMs the LVGL draw pool.
static const int16_t s_wave_rest[7] = { 16, 52, 79, 121, 79, 52, 16 };   // px, screen 466 = Figma 1:1
static lv_timer_t *s_wave_timer;
static int16_t     s_wave_phase;   // degrees; advances each tick so the crest travels left→right
static void wave_tick(lv_timer_t *t)
{
    (void)t;
    s_wave_phase += 12;                                   // 12°/40ms → ~1.2s per full cycle
    if (s_wave_phase >= 360) s_wave_phase -= 360;
    for (int k = 0; k < 7; k++) {
        if (!s_wave[k]) continue;
        int16_t ang = (int16_t)((s_wave_phase + k * 40) % 360);   // 40° phase step per bar → travelling wave
        int32_t s   = lv_trigo_sin(ang);                          // -32767..32767
        int32_t amp = 675 + (s * 325 / 32767);                    // permille 350..1000 → 0.35×..1.0× rest
        int32_t h   = (int32_t)s_wave_rest[k] * amp / 1000;
        if (h < 2) h = 2;
        lv_obj_set_height(s_wave[k], h);
        lv_obj_set_y(s_wave[k], 233 - h / 2);             // stay centred on the midline as it grows/shrinks
    }
}
// Start/stop the waveform: spin up the shared travelling-phase timer and seed one frame immediately (so nothing
// is collapsed on show); tear it down when we leave the recording state.
static void voice_wave_set(bool on)
{
    if (on) {
        // Waveform stays green for both; the "GOAL" label alone marks a goal capture.
        for (int k = 0; k < 7; k++) if (s_wave[k]) set_hidden(s_wave[k], false);
        if (s_voice_goal_lbl) set_hidden(s_voice_goal_lbl, s_voice_cmd == VOICE_CMD_NONE);
        if (!s_wave_timer) s_wave_timer = lv_timer_create(wave_tick, 40, NULL);
        wave_tick(s_wave_timer);   // paint the first frame now → smooth from frame 1
    } else {
        if (s_wave_timer) { lv_timer_delete(s_wave_timer); s_wave_timer = NULL; }
        for (int k = 0; k < 7; k++) if (s_wave[k]) set_hidden(s_wave[k], true);
        if (s_voice_goal_lbl) set_hidden(s_voice_goal_lbl, true);
    }
}
// Paint the 3 sending sparkles: the s_send_idx one green + popped (scale 1.3), the other two idle white.
static void voice_send_apply_idx(void)
{
    for (int i = 0; i < 3; i++) {
        if (!s_send_sp[i]) continue;
        bool active = (i == s_send_idx);
        lv_obj_set_style_image_recolor(s_send_sp[i], active ? COL_VOICE : COL_SPARK_OFF, 0);
        lv_image_set_scale(s_send_sp[i], active ? 333 : 256);   // native 40px base (256); active pops ~1.3× (333)
    }
}
// Show/hide the 3 sending sparkles; the green highlight is marched across them by busy_dots_tick.
static void voice_send_set(bool on)
{
    if (on) s_send_idx = 0;
    for (int i = 0; i < 3; i++) {
        if (!s_send_sp[i]) continue;
        set_hidden(s_send_sp[i], !on);
    }
    if (on) voice_send_apply_idx();
}
// Show the voice indicator: the green waveform while recording, the 3 sweeping sparkles while sending; hidden
// otherwise. The legacy orb / blue glow / white dots are retired (kept created but permanently hidden). Caller
// holds the display lock.
static void voice_icon_apply(voice_icon_state_t st)
{
    s_vic_state = st;
    if (!s_wave[0] || !s_send_sp[0]) return;
    bool recording = (st == VIC_MIC || st == VIC_REC);
    bool sending   = (st == VIC_SEND);
    // Retire the old orb + glow + white dots entirely (kept created but always hidden).
    if (s_voice_img) set_hidden(s_voice_img, true);
    voice_pulse_set(false);
    voice_dots_set(false);
    voice_wave_set(recording);                     // green waveform while recording
    voice_send_set(sending);                        // sweeping sparkles while uploading
    voice_btn_apply_visibility();
}
// mic → recording after a brief beat (only if we're still in the mic state, i.e. still recording).
static void vic_to_rec_cb(lv_timer_t *t) { if (s_vic_state == VIC_MIC) voice_icon_apply(VIC_REC); lv_timer_delete(t); }

static void busy_dots_tick(lv_timer_t *t)
{
    (void)t;
    // Voice send finished (spinner up, upload no longer active) → back to the idle (hidden) indicator.
    // EXCEPT a route (Overview) voice: after the upload the router is still picking an agent, so we KEEP the
    // loading overlay/sparkles up (fall to the else branch → the sweep keeps animating) until voice_routed
    // arrives — or a watchdog releases it. That way the user never sees a static Overview mid-route.
    if (s_vic_state == VIC_SEND && !voice_active() && !s_voice_routing) {
        voice_icon_apply(VIC_NONE);
        voice_overlay_set(false);   // upload finished → restore tile content + hide the voice overlay
    } else {
        // Route voice: mark the moment the upload finished and hold the loading state until the router
        // answers; if it never does (STT/LLM failure with no terminal frame), release after the budget.
        if (s_voice_routing && s_vic_state == VIC_SEND && !voice_active()) {
            if (!s_voice_route_ms) s_voice_route_ms = lv_tick_get();
            if (lv_tick_elaps(s_voice_route_ms) > VOICE_ROUTE_WAIT_MS) {
                s_voice_routing = false; s_voice_route_ms = 0;
                voice_icon_apply(VIC_NONE);
                voice_overlay_set(false);
            }
        }
        // Mic capture ended (manual stop / buffer full) while the UI still shows the mic — audio stays
        // active through the upload, so flip to the "Sending…" spinner.
        if (ui_voice_is_recording() && voice_active() && !voice_recording()) {
            voice_icon_apply(VIC_SEND);
        }
        // Watchdog: stop the capture at the cap. TEN MINUTES — the same number grid-app enforces, so the
        // panel never draws a longer allowance than the app will accept (see VOICE_MAX_MS).
        if (ui_voice_is_recording() && lv_tick_elaps(s_voice_start_ms) > s_voice_max_ms) ui_voice_stop();
        // Silence gate (off — see VOICE_SILENCE_AUTOSTOP): a press with no speech in the first 15s used to be
        // discarded here. Only the ten-minute cap above stops a forgotten recording now, which is ten times
        // the recording it used to be.
        else if (VOICE_SILENCE_AUTOSTOP && ui_voice_is_recording()
                 && lv_tick_elaps(s_voice_start_ms) > VOICE_SILENCE_MS && !voice_heard())
            ui_voice_discard_silent();
        voice_btn_apply_visibility();   // keep the indicator's visibility fresh (~3 Hz)
        // Sending: march the green highlight across the 3 sparkles (~3 Hz ≈ Figma's 0.8s/3 sweep).
        if (s_vic_state == VIC_SEND) { s_send_idx = (s_send_idx + 1) % 3; voice_send_apply_idx(); }
        notif_badge_apply();            // keep the unread pill in sync (screen/settings/asleep)
        // Tell grid-app which tile the carousel settled on, once it has stopped moving.
        if (s_focus_pending[0] && lv_tick_elaps(s_focus_at) > FOCUS_SETTLE_MS
            && strcmp(s_focus_pending, s_focus_sent) != 0) {
            snprintf(s_focus_sent, sizeof(s_focus_sent), "%s", s_focus_pending);
            panel_client_send_focus(s_focus_sent);
        }
    }
    // Keep the screen awake through a voice turn: voice uses the PWR key (not the touchscreen), so
    // recording + upload + the agent working produces NO touch and the idle timer would auto-off the
    // screen mid-task. Count "recording/uploading" and "the visible tile's turn is still processing" as
    // activity so the screen stays on until ~IDLE_MS after the turn actually ends.
    if (voice_active() || s_voice_routing ||
        (s_active_idx >= 0 && s_active_idx < s_tile_count && s_tiles[s_active_idx].busy_model))
        display_bump_activity();
    if (display_is_asleep() || s_overview_active) return;
    if (s_active_idx < 0 || s_active_idx >= s_tile_count) return;
    tile_t *p = &s_tiles[s_active_idx];
    // Pulse the in_progress todo row's glyph (~3Hz) so the active task stands out.
    if (p->todo_active) {
        static int tphase;
        lv_obj_set_style_bg_opa(p->todo_active, (tphase++ & 1) ? LV_OPA_COVER : LV_OPA_40, 0);
    }
    if (!p->busy) return;
    // Re-render only when the elapsed second (or the visible project) changes — avoids repainting the
    // text a few times/second for no reason.
    static int64_t last_sec = -1; static int last_idx = -1;
    int64_t sec = (esp_timer_get_time() - p->busy_since) / 1000000LL;
    if (sec != last_sec || s_active_idx != last_idx) {
        last_sec = sec; last_idx = s_active_idx;
        busy_compose(p);
    }
}

void ui_init(void)
{
    display_lock();

    // Project array in PSRAM (off internal BSS): about 28KB at MAX_TILES.
    // The board requires working PSRAM, so never silently consume internal heap here.
    if (!s_tiles) {
        s_tiles = ram_psram_calloc(MAX_TILES, sizeof(tile_t), "tile_models");
        if (!s_tiles) {
            ESP_LOGE(TAG, "required tile model allocation failed");
            abort();
        }
    }

    // Error screen
    scr_error = make_screen();
    err_title = make_label(scr_error, LV_SYMBOL_WARNING "  Error", COL_RED, &lv_font_montserrat_22);
    err_detail = make_label(scr_error, "", COL_FG, NULL);

    // Projects tileview screen
    scr_projects = lv_obj_create(NULL);
    lv_obj_set_style_bg_color(scr_projects, COL_BG, 0);
    lv_obj_set_style_pad_all(scr_projects, 0, 0);
    lv_obj_set_style_border_width(scr_projects, 0, 0);
    // Plain horizontally-scrollable container (replaces lv_tileview). Paging feel comes from
    // SCROLL_SNAP_CENTER + SCROLL_ONE (one tile per swipe, always snaps a tile to center — exactly what
    // lv_tileview does internally). Tiles are positioned at column*width (see add_proj / rebuild_settings_tile).
    tileview = lv_obj_create(scr_projects);
    lv_obj_set_size(tileview, lv_pct(100), lv_pct(100));
    lv_obj_set_style_bg_color(tileview, COL_BG, 0);
    lv_obj_set_style_pad_all(tileview, 0, 0);
    lv_obj_set_style_border_width(tileview, 0, 0);
    lv_obj_set_style_radius(tileview, 0, 0);
    lv_obj_set_scrollbar_mode(tileview, LV_SCROLLBAR_MODE_OFF);
    lv_obj_set_scroll_dir(tileview, LV_DIR_HOR);
    lv_obj_set_scroll_snap_x(tileview, LV_SCROLL_SNAP_CENTER);   // always land a tile centered
    lv_obj_add_flag(tileview, LV_OBJ_FLAG_SCROLL_ONE);           // one tile per swipe (paging, no free drift)
    lv_obj_clear_flag(tileview, LV_OBJ_FLAG_SCROLL_ELASTIC);     // no edge over-scroll → clean edge-swipe detect
    lv_obj_add_event_cb(tileview, tile_changed, LV_EVENT_SCROLL_END, NULL);  // settle → update active/settings
    lv_obj_add_event_cb(tileview, carousel_scroll, LV_EVENT_SCROLL, NULL);   // during motion → cover the leading edge (N==1)

    // Invisible spacer reserving the full horizontal scroll range (see resize_spacer): only ~CONTENT_WINDOW
    // agent tiles are ever materialized, so this is what keeps scroll positions absolute (one per column).
    s_carousel_spacer = lv_obj_create(tileview);
    lv_obj_remove_style_all(s_carousel_spacer);
    lv_obj_set_size(s_carousel_spacer, carousel_w(), 1);
    lv_obj_set_pos(s_carousel_spacer, 0, 0);
    lv_obj_clear_flag(s_carousel_spacer, LV_OBJ_FLAG_CLICKABLE | LV_OBJ_FLAG_SCROLLABLE | LV_OBJ_FLAG_SNAPPABLE);
    lv_obj_move_background(s_carousel_spacer);   // behind the real tiles

    // "No agents yet" page — a persistent lightweight tile shown at ring 1 ONLY when the machine has 0 agents
    // (so an empty list is [Overview, No projects], swipeable). Hidden whenever there is ≥1 project.
    s_no_agents_tile = lv_obj_create(tileview);
    lv_obj_set_size(s_no_agents_tile, carousel_w(), carousel_h());
    lv_obj_set_style_border_width(s_no_agents_tile, 0, 0);
    lv_obj_set_style_radius(s_no_agents_tile, 0, 0);
    lv_obj_set_style_bg_color(s_no_agents_tile, COL_BG, 0);
    lv_obj_set_flex_flow(s_no_agents_tile, LV_FLEX_FLOW_COLUMN);
    lv_obj_set_flex_align(s_no_agents_tile, LV_FLEX_ALIGN_CENTER, LV_FLEX_ALIGN_CENTER, LV_FLEX_ALIGN_CENTER);
    lv_obj_set_style_pad_row(s_no_agents_tile, 8, 0);
    lv_obj_clear_flag(s_no_agents_tile, LV_OBJ_FLAG_SCROLLABLE);
    // Four parts, matching the design: the machine's name, what to do, the command to type, what happens
    // next. It used to be a title plus ONE recoloured wrapped label carrying all three lines — which made
    // the command just another line of prose instead of the one thing to copy.
    s_na_eyebrow = lv_label_create(s_no_agents_tile);
    lv_obj_set_style_text_font(s_na_eyebrow, &geist_reg_20, 0);
    lv_obj_set_style_text_color(s_na_eyebrow, COL_MUTED, 0);
    lv_obj_set_style_text_letter_space(s_na_eyebrow, 2, 0);
    lv_label_set_text(s_na_eyebrow, "");
    s_na_title = lv_label_create(s_no_agents_tile);
    lv_obj_set_width(s_na_title, SAFE_CONTENT_W);
    lv_obj_set_style_text_font(s_na_title, &geist_med_32, 0);
    lv_obj_set_style_text_color(s_na_title, COL_FG, 0);
    lv_obj_set_style_text_align(s_na_title, LV_TEXT_ALIGN_CENTER, 0);
    lv_label_set_long_mode(s_na_title, LV_LABEL_LONG_WRAP);
    lv_label_set_text(s_na_title, "No chats yet");
    s_na_cmd_lbl = code_pill(s_no_agents_tile, "grid new");
    s_no_agents_hint_lbl = lv_label_create(s_no_agents_tile);
    lv_obj_set_width(s_no_agents_hint_lbl, SAFE_CONTENT_W);
    lv_obj_set_style_text_font(s_no_agents_hint_lbl, &geist_reg_20, 0);
    lv_obj_set_style_text_color(s_no_agents_hint_lbl, COL_MUTED, 0);
    lv_obj_set_style_text_align(s_no_agents_hint_lbl, LV_TEXT_ALIGN_CENTER, 0);
    lv_label_set_long_mode(s_no_agents_hint_lbl, LV_LABEL_LONG_WRAP);
    // One line, not a switch. The reference chose between a local "create one here" and a remote
    // "$ tmux new" depending on which machine was selected; this panel sees one machine and cannot create
    // anything itself, so the page names the one thing that works.
    lv_label_set_text(s_no_agents_hint_lbl, "Start one on this computer");
    lv_obj_add_flag(s_no_agents_tile, LV_OBJ_FLAG_HIDDEN);
    // No "waiting for projects…" placeholder: with 0 projects this page IS the empty state.

    // Leading "overview" tile (ring 0): machine + agent count + Option A's paired round Voice / Goal actions.
    // Persistent (created once, positioned by update_content_window); the count label is refreshed on add/remove.
    s_overview_tile = lv_obj_create(tileview);
    lv_obj_set_size(s_overview_tile, carousel_w(), carousel_h());
    lv_obj_set_style_border_width(s_overview_tile, 0, 0);
    lv_obj_set_style_radius(s_overview_tile, 0, 0);
    lv_obj_set_style_bg_color(s_overview_tile, COL_BG, 0);
    lv_obj_set_flex_flow(s_overview_tile, LV_FLEX_FLOW_COLUMN);
    lv_obj_set_flex_align(s_overview_tile, LV_FLEX_ALIGN_CENTER, LV_FLEX_ALIGN_CENTER, LV_FLEX_ALIGN_CENTER);
    lv_obj_set_style_pad_row(s_overview_tile, 8, 0);
    lv_obj_clear_flag(s_overview_tile, LV_OBJ_FLAG_SCROLLABLE);
    s_overview_machine_lbl = lv_label_create(s_overview_tile);    // eyebrow = selected machine NAME (dim grey)
    lv_obj_set_style_text_font(s_overview_machine_lbl, &geist_reg_20, 0);
    lv_obj_set_style_text_color(s_overview_machine_lbl, COL_DOT_OFF, 0);
    lv_obj_set_style_text_letter_space(s_overview_machine_lbl, 2, 0);
    lv_obj_set_width(s_overview_machine_lbl, SAFE_CONTENT_W);
    lv_label_set_long_mode(s_overview_machine_lbl, LV_LABEL_LONG_DOT);
    lv_obj_set_style_text_align(s_overview_machine_lbl, LV_TEXT_ALIGN_CENTER, 0);
    lv_label_set_text(s_overview_machine_lbl, "Machine");
    s_overview_count_lbl = lv_label_create(s_overview_tile);    // "N projects" (largest font available)
    lv_obj_set_style_text_font(s_overview_count_lbl, &geist_med_38, 0);
    lv_obj_set_style_text_color(s_overview_count_lbl, COL_FG, 0);
    lv_label_set_text(s_overview_count_lbl, "0 chats");

    // What the Overview says once grid-app has been silent past the heartbeat. Two quiet lines under the
    // headline, and deliberately NOT an error: the app being closed is this panel's ordinary resting
    // state, not a fault, and a red screen would send someone looking for a problem that is a double-click
    // away. The reference put a "$ harness join" command here because its machine could be absent from a
    // network; this one is on the end of a cable that is already plugged in, so the only action is to open
    // the app on the computer it is plugged into.
    s_overview_offline_hint_lbl = lv_label_create(s_overview_tile);
    lv_obj_set_style_text_font(s_overview_offline_hint_lbl, &geist_reg_20, 0);
    lv_obj_set_style_text_color(s_overview_offline_hint_lbl, COL_MUTED, 0);
    lv_label_set_text(s_overview_offline_hint_lbl, "Open Grid on this computer");
    lv_obj_add_flag(s_overview_offline_hint_lbl, LV_OBJ_FLAG_HIDDEN);
    s_overview_offline_cmd_lbl = lv_label_create(s_overview_tile);
    lv_obj_set_style_text_font(s_overview_offline_cmd_lbl, &geist_reg_20, 0);
    lv_obj_set_style_text_color(s_overview_offline_cmd_lbl, COL_DOT_OFF, 0);
    lv_label_set_text(s_overview_offline_cmd_lbl, "The panel is still plugged in");
    lv_obj_add_flag(s_overview_offline_cmd_lbl, LV_OBJ_FLAG_HIDDEN);

    // "<N> <gerund>…" sub-line (e.g. "3 Cooking…"): count of busy agents + a rotating Claude-Code verb, like the
    // agent tile's working row. Green, hidden when nobody is working. The verb rotates via overview_working_tick.
    s_overview_working_lbl = lv_label_create(s_overview_tile);
    lv_obj_set_style_text_font(s_overview_working_lbl, &geist_reg_25, 0);
    lv_obj_set_style_text_color(s_overview_working_lbl, COL_VOICE, 0);
    lv_label_set_text(s_overview_working_lbl, "");
    lv_obj_add_flag(s_overview_working_lbl, LV_OBJ_FLAG_HIDDEN);
    lv_timer_create(overview_working_tick, 1000, NULL);         // rotate the gerund (every ~6s) while the row is shown

    // THREE buttons — Voice, Goal, Loop — each starting a recording in its own mode, matching the square.
    // This replaced a Voice pill beside a mode SELECT: a select shows a value, so setting Goal cost a tap,
    // a whole picker screen, a pick and a trip back before the Voice press that actually started anything.
    // Three actions is one tap, and nothing is left holding state between turns.
    //
    // GEOMETRY IS THE CONSTRAINT HERE. The panel is round, so usable width shrinks as the block descends:
    // 437px at row 1's baseline, 366px at row 2's, 303px by y=410. The block is sized EXACTLY to its two
    // rows (OV_ACT_BLK_H) and carries no translate — the 10px nudge the one-row version used would push
    // row 2 down to where the arc eats its corners. Controls must also stay above y≈400 (BOTTOM_EDGE_PX,
    // the home swipe) and below y=90 (the notification pull-zone).
    s_overview_actions = lv_obj_create(s_overview_tile);
    lv_obj_remove_style_all(s_overview_actions);
    lv_obj_clear_flag(s_overview_actions, LV_OBJ_FLAG_CLICKABLE | LV_OBJ_FLAG_SCROLLABLE);
    lv_obj_set_size(s_overview_actions, OV_ACT_W, OV_ACT_BLK_H);

    s_overview_voice_btn = lv_button_create(s_overview_actions);
    lv_obj_set_size(s_overview_voice_btn, OV_VOICE_W, OV_ACT_H);   // bottom row, alone, inset
    lv_obj_align(s_overview_voice_btn, LV_ALIGN_TOP_LEFT, OV_VOICE_X, OV_ROW2_Y);
    lv_obj_set_style_radius(s_overview_voice_btn, LV_RADIUS_CIRCLE, 0);
    lv_obj_set_style_bg_color(s_overview_voice_btn, lv_color_hex(0x10281a), 0);
    lv_obj_set_style_bg_opa(s_overview_voice_btn, LV_OPA_COVER, 0);
    lv_obj_set_style_border_width(s_overview_voice_btn, 1, 0);
    lv_obj_set_style_border_color(s_overview_voice_btn, lv_color_hex(0x24512f), 0);
    lv_obj_set_style_bg_color(s_overview_voice_btn, lv_color_hex(0x17371d), LV_STATE_PRESSED);
    lv_obj_set_style_shadow_width(s_overview_voice_btn, 0, 0);   // no snapshot/layer cost on the tight UI
    lv_obj_set_style_pad_all(s_overview_voice_btn, 0, 0);
    lv_obj_clear_flag(s_overview_voice_btn, LV_OBJ_FLAG_SCROLLABLE | LV_OBJ_FLAG_GESTURE_BUBBLE);
    lv_obj_add_event_cb(s_overview_voice_btn, overview_voice_tap, LV_EVENT_CLICKED, NULL);
    {   // mic + word as one centred lockup
        lv_obj_t *lock = lv_obj_create(s_overview_voice_btn);
        lv_obj_remove_style_all(lock);
        lv_obj_clear_flag(lock, LV_OBJ_FLAG_CLICKABLE | LV_OBJ_FLAG_SCROLLABLE);
        lv_obj_set_size(lock, LV_SIZE_CONTENT, LV_SIZE_CONTENT);
        lv_obj_set_flex_flow(lock, LV_FLEX_FLOW_ROW);
        lv_obj_set_flex_align(lock, LV_FLEX_ALIGN_CENTER, LV_FLEX_ALIGN_CENTER, LV_FLEX_ALIGN_CENTER);
        lv_obj_set_style_pad_column(lock, 10, 0);
        lv_obj_center(lock);
        // Same 40px pre-coloured mark the agent tile uses. It used to be the 32px asset scaled to 40 and
        // recoloured to #00ff2f — which is exactly the pair that makes LVGL snapshot the image to a temp
        // layer and run transform_and_recolor on it. The baked asset is a plain blit and is byte-identical
        // in appearance.
        lv_obj_t *mic = lv_image_create(lock);
        lv_image_set_src(mic, &icon_act_voice);
        lv_obj_t *t = lv_label_create(lock);
        lv_obj_set_style_text_font(t, &geist_med_32, 0);   // nothing exists between reg_25 and this
        lv_obj_set_style_text_color(t, COL_VOICE, 0);
        lv_label_set_text(t, "Voice");
    }

    // The two MODIFIERS. Quiet pills — surface fill, hairline border, a coloured glyph over a plain white
    // word. The row keeps exactly ONE filled shape (Voice) or the eye has to choose where to land, and the
    // whole argument for this row is that it lands on Voice.
    //
    // Goal wears the three-ring target it already wears elsewhere on this device, so the mark is not new
    // vocabulary. Loop wears the Figma repeat arrows (icon_loop), deliberately NOT a clock or a calendar:
    // `/loop` runs no scheduler (the repo's cron stack is not involved) and a time-shaped icon would
    // promise something the command does not do. It replaced LV_SYMBOL_LOOP — same idea, but the font
    // glyph was not the drawn mark, and it could not be sized to sit level with Goal's 28px target.
    for (int m = 0; m < 2; m++) {
        lv_obj_t *btn = lv_button_create(s_overview_actions);
        lv_obj_set_size(btn, OV_MOD_W, OV_ACT_H);
        lv_obj_align(btn, LV_ALIGN_TOP_LEFT, m * (OV_MOD_W + OV_ACT_GAP), 0);   // top row
        lv_obj_set_style_radius(btn, LV_RADIUS_CIRCLE, 0);
        // Both modifiers are deliberately OFF-DESIGN. Figma gives each of them the same neutral surface
        // (white at 10%, hairline #3a3f4b); here each pill is instead tinted into the colour of the mark
        // it carries, so surface and glyph agree — Goal into COL_YELLOW, Loop into COL_ACCENT.
        //
        // Derived the way Voice's green pair already was: Voice's fill and border sit at a fixed share of
        // its #00ff2f accent, so the same two shares are taken of each modifier's accent — but matched on
        // LUMINANCE, not on raw channel value. That correction is the whole trick. Blue at the same numbers
        // reads far darker than green and would have come out plain grey; yellow reads far brighter and
        // would have come out a glaring band. Equal luminance is also why the pair sits level with each
        // other: 0x2d2108 and 0x16223f look nothing alike as numbers and weigh the same on the panel.
        //
        // The cost: the row's old "exactly one filled shape" rule is gone. Voice still leads on size and on
        // a 32px green word, but there are now three coloured surfaces instead of one.
        lv_obj_set_style_bg_opa(btn, LV_OPA_COVER, 0);
        lv_obj_set_style_bg_color(btn, lv_color_hex(m == 0 ? 0x2d2108 : 0x16223f), 0);
        lv_obj_set_style_bg_color(btn, lv_color_hex(m == 0 ? 0x41300c : 0x203159), LV_STATE_PRESSED);
        lv_obj_set_style_border_color(btn, lv_color_hex(m == 0 ? 0x5b440f : 0x2e4680), 0);
        lv_obj_set_style_border_width(btn, 1, 0);
        lv_obj_set_style_shadow_width(btn, 0, 0);   // no snapshot/layer cost on the tight UI
        lv_obj_set_style_pad_all(btn, 0, 0);
        lv_obj_clear_flag(btn, LV_OBJ_FLAG_SCROLLABLE | LV_OBJ_FLAG_GESTURE_BUBBLE);
        lv_obj_add_event_cb(btn, m == 0 ? overview_goal_tap : overview_loop_tap, LV_EVENT_CLICKED, NULL);

        // Icon BESIDE the word, the square's own lockup. This is what the second row bought: at 169px the
        // pill is wider than the square's 159px one, so the icon-over-a-20px-word stack the single row
        // forced (81px fits nothing else) is gone, and the word gets to be 25px.
        lv_obj_t *lock = lv_obj_create(btn);
        lv_obj_remove_style_all(lock);
        lv_obj_clear_flag(lock, LV_OBJ_FLAG_CLICKABLE | LV_OBJ_FLAG_SCROLLABLE);
        lv_obj_set_size(lock, LV_SIZE_CONTENT, LV_SIZE_CONTENT);
        lv_obj_set_flex_flow(lock, LV_FLEX_FLOW_ROW);
        lv_obj_set_flex_align(lock, LV_FLEX_ALIGN_CENTER, LV_FLEX_ALIGN_CENTER, LV_FLEX_ALIGN_CENTER);
        lv_obj_set_style_pad_column(lock, 11, 0);
        lv_obj_center(lock);

        if (m == 0) {   // target: three concentric rings, innermost filled
            lv_obj_t *ring = lv_obj_create(lock);
            lv_obj_remove_style_all(ring);
            lv_obj_clear_flag(ring, LV_OBJ_FLAG_CLICKABLE | LV_OBJ_FLAG_SCROLLABLE);
            lv_obj_set_size(ring, 28, 28);
            const int sz[] = { 28, 16, 6 };
            for (int k = 0; k < 3; k++) {
                lv_obj_t *c = lv_obj_create(ring);
                lv_obj_remove_style_all(c);
                lv_obj_clear_flag(c, LV_OBJ_FLAG_CLICKABLE | LV_OBJ_FLAG_SCROLLABLE);
                lv_obj_set_size(c, sz[k], sz[k]);
                lv_obj_center(c);
                lv_obj_set_style_radius(c, LV_RADIUS_CIRCLE, 0);
                lv_obj_set_style_bg_color(c, COL_YELLOW, 0);
                lv_obj_set_style_bg_opa(c, k == 2 ? LV_OPA_COVER : LV_OPA_TRANSP, 0);
                lv_obj_set_style_border_width(c, k == 2 ? 0 : 3, 0);
                lv_obj_set_style_border_color(c, COL_YELLOW, 0);
                s_ov_goal_ico[k] = c;
            }
        } else {
            s_ov_loop_ico = lv_image_create(lock);
            lv_image_set_src(s_ov_loop_ico, &icon_loop);
            lv_obj_set_style_image_recolor(s_ov_loop_ico, COL_ACCENT, 0);
            lv_obj_set_style_image_recolor_opa(s_ov_loop_ico, LV_OPA_COVER, 0);
        }

        lv_obj_t *lbl = lv_label_create(lock);
        lv_obj_set_style_text_font(lbl, &geist_reg_25, 0);
        lv_obj_set_style_text_color(lbl, COL_FG, 0);
        lv_label_set_text(lbl, m == 0 ? "Goal" : "Loop");
        if (m == 0) { s_overview_goal_btn = btn; s_ov_goal_lbl = lbl; }
        else        { s_overview_loop_btn = btn; s_ov_loop_lbl = lbl; }
    }

    overview_actions_apply();
    lv_obj_add_flag(s_overview_tile, LV_OBJ_FLAG_HIDDEN);

    // Bottom page-indicator dots: one per ring tile (the Overview + one per project); the active page is a
    // green sparkle, the rest grey circles. Sits on the lower arc (~36px up). Rebuilt on snap + list change.
    page_dots = lv_obj_create(scr_projects);
    lv_obj_remove_style_all(page_dots);
    lv_obj_set_size(page_dots, LV_SIZE_CONTENT, LV_SIZE_CONTENT);
    lv_obj_set_flex_flow(page_dots, LV_FLEX_FLOW_ROW);
    lv_obj_set_flex_align(page_dots, LV_FLEX_ALIGN_CENTER, LV_FLEX_ALIGN_CENTER, LV_FLEX_ALIGN_CENTER);
    lv_obj_set_style_pad_column(page_dots, 8, 0);
    lv_obj_align(page_dots, LV_ALIGN_BOTTOM_MID, 0, -36);
    lv_obj_clear_flag(page_dots, LV_OBJ_FLAG_CLICKABLE | LV_OBJ_FLAG_SCROLLABLE);
    lv_obj_add_flag(page_dots, LV_OBJ_FLAG_HIDDEN);

    // Hold-to-talk mic button (overlay at bottom-center; captures press so it won't swipe).
    // Mic indicator: shown (red) ONLY while recording — physical button B toggles voice; tapping
    // the on-screen mic while it's visible also stops. Hidden the rest of the time.
    mic_btn = lv_button_create(scr_projects);
    lv_obj_set_size(mic_btn, 88, 88);
    lv_obj_align(mic_btn, LV_ALIGN_BOTTOM_MID, 0, -22);
    lv_obj_set_style_radius(mic_btn, LV_RADIUS_CIRCLE, 0);
    lv_obj_set_style_bg_color(mic_btn, COL_RED, 0);
    lv_obj_set_style_border_width(mic_btn, 0, 0);
    lv_obj_add_flag(mic_btn, LV_OBJ_FLAG_HIDDEN); // hidden until recording starts
    // Microphone glyph drawn from primitives (LVGL's built-in font has no mic symbol):
    // a white capsule body + stem + base on the red button.
    {
        struct { int w, h, x, y, r; } parts[] = {
            { 22, 32, 0, -6, 11 },  // body (capsule)
            {  4,  9, 0, 15,  2 },  // stem
            { 22,  4, 0, 21,  2 },  // base
        };
        for (int k = 0; k < 3; k++) {
            lv_obj_t *p = lv_obj_create(mic_btn);
            lv_obj_remove_style_all(p);
            lv_obj_clear_flag(p, LV_OBJ_FLAG_CLICKABLE | LV_OBJ_FLAG_SCROLLABLE);
            lv_obj_set_size(p, parts[k].w, parts[k].h);
            lv_obj_align(p, LV_ALIGN_CENTER, parts[k].x, parts[k].y);
            lv_obj_set_style_radius(p, parts[k].r, 0);
            lv_obj_set_style_bg_color(p, lv_color_white(), 0);
            lv_obj_set_style_bg_opa(p, LV_OPA_COVER, 0);
        }
    }
    lv_obj_add_flag(mic_btn, LV_OBJ_FLAG_HIDDEN);   // legacy primitive mic — kept hidden (unused; voice is gesture-driven)

    // Figma voice indicator: a 96px mic shown ONLY during a live voice turn (red while recording; the
    // spinner replaces it while the clip uploads). NOT clickable — voice is driven by gestures now
    // (an action button starts, a tap stops; see touch.c). On the TOP LAYER so it floats over any screen.
    s_voice_img = lv_image_create(lv_layer_top());
    lv_image_set_src(s_voice_img, &icon_v_mic);
    lv_image_set_inner_align(s_voice_img, LV_IMAGE_ALIGN_CENTER);
    // Asset is native 72px (1.5× the 48px original, circular-masked) → no LVGL upscale.
    lv_obj_set_size(s_voice_img, 72, 72);
    lv_obj_align(s_voice_img, LV_ALIGN_CENTER, 0, 0);   // dead-centre (voice now runs full-screen over the dark overlay); dots + glow align_to this
    lv_obj_remove_flag(s_voice_img, LV_OBJ_FLAG_CLICKABLE);   // pure indicator, not a button
    // Initial state = idle (hidden), applied by voice_icon_apply(VIC_NONE) below.

    // Upload indicator: three white "typing" dots at the mic centre, pulsing in sequence (voice_dots_set).
    for (int i = 0; i < 3; i++) {
        s_send_dots[i] = lv_obj_create(lv_layer_top());
        lv_obj_remove_style_all(s_send_dots[i]);
        lv_obj_set_size(s_send_dots[i], 12, 12);
        lv_obj_set_style_radius(s_send_dots[i], LV_RADIUS_CIRCLE, 0);
        lv_obj_set_style_bg_color(s_send_dots[i], COL_FG, 0);
        lv_obj_set_style_bg_opa(s_send_dots[i], LV_OPA_COVER, 0);
        lv_obj_align_to(s_send_dots[i], s_voice_img, LV_ALIGN_CENTER, (i - 1) * 20, 0);   // −20 / 0 / +20 row
        lv_obj_remove_flag(s_send_dots[i], LV_OBJ_FLAG_CLICKABLE | LV_OBJ_FLAG_SCROLLABLE);
        lv_obj_add_flag(s_send_dots[i], LV_OBJ_FLAG_HIDDEN);
    }

    // "Listening" ripple: two translucent blue circles centred on the mic, sized-animated out while
    // recording (see voice_pulse_set). Behind the mic (move_background), non-interactive.
    for (int i = 0; i < 2; i++) {
        s_pulse[i] = lv_obj_create(lv_layer_top());
        lv_obj_remove_style_all(s_pulse[i]);
        lv_obj_set_size(s_pulse[i], 72, 72);
        lv_obj_align_to(s_pulse[i], s_voice_img, LV_ALIGN_CENTER, 0, 0);
        lv_obj_set_style_radius(s_pulse[i], LV_RADIUS_CIRCLE, 0);
        lv_obj_set_style_bg_color(s_pulse[i], COL_ACCENT, 0);
        lv_obj_set_style_bg_opa(s_pulse[i], 0, 0);
        lv_obj_remove_flag(s_pulse[i], LV_OBJ_FLAG_CLICKABLE | LV_OBJ_FLAG_SCROLLABLE);
        lv_obj_add_flag(s_pulse[i], LV_OBJ_FLAG_HIDDEN);
        lv_obj_move_background(s_pulse[i]);   // behind the mic image
    }

    // Figma "Section final" — RECORDING: 7 green waveform bars, rest heights s_wave_rest[], pitch 22.4px, width
    // 6px, rounded caps, centred on the screen midline (233,233). Height is animated (voice_wave_set); we set
    // absolute x here and let wave_anim_cb drive height+y. On the top layer so it floats over any screen.
    for (int k = 0; k < 7; k++) {
        s_wave[k] = lv_obj_create(lv_layer_top());
        lv_obj_remove_style_all(s_wave[k]);
        lv_obj_set_size(s_wave[k], 6, s_wave_rest[k]);
        lv_obj_set_style_radius(s_wave[k], LV_RADIUS_CIRCLE, 0);   // rounded caps
        lv_obj_set_style_bg_color(s_wave[k], COL_VOICE, 0);
        lv_obj_set_style_bg_opa(s_wave[k], LV_OPA_COVER, 0);
        int cx = 233 + (k - 3) * 224 / 10;                        // pitch 22.4px, symmetric about centre
        lv_obj_set_pos(s_wave[k], cx - 3, 233 - s_wave_rest[k] / 2);
        lv_obj_remove_flag(s_wave[k], LV_OBJ_FLAG_CLICKABLE | LV_OBJ_FLAG_SCROLLABLE);
        lv_obj_add_flag(s_wave[k], LV_OBJ_FLAG_HIDDEN);
    }
    // "GOAL" label above the waveform — shown only while recording a GOAL command (orange, letter-spaced).
    s_voice_goal_lbl = lv_label_create(lv_layer_top());
    lv_obj_set_style_text_font(s_voice_goal_lbl, &geist_reg_25, 0);
    lv_obj_set_style_text_color(s_voice_goal_lbl, COL_ORANGE, 0);
    lv_obj_set_style_text_letter_space(s_voice_goal_lbl, 4, 0);
    lv_label_set_text(s_voice_goal_lbl, "GOAL");   // retitled per capture in voice_start_impl
    lv_obj_align(s_voice_goal_lbl, LV_ALIGN_CENTER, 0, -120);
    lv_obj_remove_flag(s_voice_goal_lbl, LV_OBJ_FLAG_CLICKABLE | LV_OBJ_FLAG_SCROLLABLE);
    lv_obj_add_flag(s_voice_goal_lbl, LV_OBJ_FLAG_HIDDEN);

    // Figma "Section final" — SENDING: 3 sparkles (icon_sparkle, native 32px → scaled ~40px), gap 26px so a
    // 66px centre pitch, centred. Recolored grey by default; busy_dots_tick sweeps the green one across them.
    for (int i = 0; i < 3; i++) {
        s_send_sp[i] = lv_image_create(lv_layer_top());
        lv_image_set_src(s_send_sp[i], &icon_sparkle_fill);       // SOLID-filled star (icon_sparkle is only a stroke)
        lv_image_set_inner_align(s_send_sp[i], LV_IMAGE_ALIGN_CENTER);
        lv_image_set_pivot(s_send_sp[i], 20, 20);                 // 40px source centre → scale pops about centre
        lv_obj_align(s_send_sp[i], LV_ALIGN_CENTER, (i - 1) * 66, 0);
        lv_obj_set_style_image_recolor(s_send_sp[i], COL_SPARK_OFF, 0);
        lv_obj_set_style_image_recolor_opa(s_send_sp[i], LV_OPA_COVER, 0);
        lv_obj_remove_flag(s_send_sp[i], LV_OBJ_FLAG_CLICKABLE | LV_OBJ_FLAG_SCROLLABLE);
        lv_obj_add_flag(s_send_sp[i], LV_OBJ_FLAG_HIDDEN);
    }

    voice_icon_apply(VIC_NONE);   // idle mic; voice_btn_apply_visibility keeps it hidden until scr_projects

    // "Cancel task?" confirm — a full-screen Yes/No overlay on the TOP LAYER, popped by the BOOT button
    // so an accidental press doesn't kill a running turn. Hidden by default; floats over any screen.
    s_cancel_confirm = lv_obj_create(lv_layer_top());
    lv_obj_set_size(s_cancel_confirm, lv_pct(100), lv_pct(100));
    lv_obj_align(s_cancel_confirm, LV_ALIGN_CENTER, 0, 0);
    lv_obj_set_style_bg_color(s_cancel_confirm, COL_BG, 0);
    lv_obj_set_style_bg_opa(s_cancel_confirm, LV_OPA_COVER, 0);
    lv_obj_set_style_border_width(s_cancel_confirm, 0, 0);
    lv_obj_set_style_radius(s_cancel_confirm, LV_RADIUS_CIRCLE, 0);
    lv_obj_set_style_pad_all(s_cancel_confirm, SCREEN_PAD, 0);
    lv_obj_set_flex_flow(s_cancel_confirm, LV_FLEX_FLOW_COLUMN);
    lv_obj_set_flex_align(s_cancel_confirm, LV_FLEX_ALIGN_CENTER, LV_FLEX_ALIGN_CENTER, LV_FLEX_ALIGN_CENTER);
    lv_obj_set_style_pad_row(s_cancel_confirm, 16, 0);
    lv_obj_clear_flag(s_cancel_confirm, LV_OBJ_FLAG_SCROLLABLE);
    { lv_obj_t *ql = lv_label_create(s_cancel_confirm);
      lv_obj_set_style_text_font(ql, &geist_med_32, 0);
      lv_obj_set_style_text_color(ql, COL_FG, 0);
      lv_obj_set_style_text_align(ql, LV_TEXT_ALIGN_CENTER, 0);
      lv_label_set_text(ql, "Cancel task?");
      // Two equal-size pills (Figma): "Yes, cancel" blue, "Back" dark navy — same width, full pill.
      lv_obj_t *yb = lv_button_create(s_cancel_confirm);   // Yes → cancel the running turn
      lv_obj_set_width(yb, lv_pct(80));
      lv_obj_set_style_bg_color(yb, lv_color_hex(0x3378ff), 0);   // Figma "Done" blue
      lv_obj_set_style_radius(yb, LV_RADIUS_CIRCLE, 0);
      lv_obj_set_style_pad_ver(yb, 14, 0);
      lv_obj_set_style_border_width(yb, 0, 0);
      lv_obj_t *yl = lv_label_create(yb);
      lv_obj_set_width(yl, lv_pct(100));
      lv_obj_set_style_text_font(yl, &geist_reg_25, 0);
      lv_obj_set_style_text_color(yl, COL_FG, 0);
      lv_obj_set_style_text_align(yl, LV_TEXT_ALIGN_CENTER, 0);
      lv_label_set_text(yl, "Yes, cancel");
      lv_obj_add_event_cb(yb, cancel_confirm_yes, LV_EVENT_CLICKED, NULL);
      lv_obj_t *nb = lv_button_create(s_cancel_confirm);   // Back → keep running
      lv_obj_set_width(nb, lv_pct(80));
      lv_obj_set_style_bg_color(nb, lv_color_hex(0x2a3245), 0);   // Figma "Redo" dark navy
      lv_obj_set_style_radius(nb, LV_RADIUS_CIRCLE, 0);
      lv_obj_set_style_pad_ver(nb, 14, 0);
      lv_obj_set_style_border_width(nb, 0, 0);
      lv_obj_t *nl2 = lv_label_create(nb);
      lv_obj_set_width(nl2, lv_pct(100));
      lv_obj_set_style_text_font(nl2, &geist_reg_25, 0);
      lv_obj_set_style_text_color(nl2, COL_FG, 0);
      lv_obj_set_style_text_align(nl2, LV_TEXT_ALIGN_CENTER, 0);
      lv_label_set_text(nl2, "Back");
      lv_obj_add_event_cb(nb, cancel_confirm_no, LV_EVENT_CLICKED, NULL); }
    lv_obj_add_flag(s_cancel_confirm, LV_OBJ_FLAG_HIDDEN);

    // STOP button (red SQUARE) — same bottom-center anchor as the mic, shown only while the active
    // project is "processing"; tapping it cancels (interrupts) that running Claude turn. Mutually
    // exclusive with the mic: hidden while recording (see update_stop_btn).
    build_agent_actions();
    stop_btn = lv_button_create(scr_projects);
    lv_obj_set_size(stop_btn, 80, 80);
    lv_obj_align(stop_btn, LV_ALIGN_BOTTOM_MID, 0, -22);
    lv_obj_set_style_radius(stop_btn, 14, 0);          // rounded SQUARE (vs the mic's circle)
    lv_obj_set_style_bg_color(stop_btn, COL_RED, 0);
    lv_obj_set_style_border_width(stop_btn, 0, 0);
    lv_obj_add_flag(stop_btn, LV_OBJ_FLAG_HIDDEN);     // hidden until the active tile is processing
    {
        // White "stop" square glyph centred on the red button.
        lv_obj_t *g = lv_obj_create(stop_btn);
        lv_obj_remove_style_all(g);
        lv_obj_clear_flag(g, LV_OBJ_FLAG_CLICKABLE | LV_OBJ_FLAG_SCROLLABLE);
        lv_obj_set_size(g, 28, 28);
        lv_obj_center(g);
        lv_obj_set_style_radius(g, 4, 0);
        lv_obj_set_style_bg_color(g, lv_color_white(), 0);
        lv_obj_set_style_bg_opa(g, LV_OPA_COVER, 0);
    }
    lv_obj_add_event_cb(stop_btn, stop_event, LV_EVENT_CLICKED, NULL);

    // "Sending…" — shown bottom-center (the spot the mic vacates) while a recorded clip uploads, so a
    // long ~15s upload isn't a silent void. Shown in ui_voice_stop, auto-hidden by busy_dots_tick when
    // the upload finishes. Non-interactive so it never steals taps.
    s_sending_lbl = lv_label_create(scr_projects);
    lv_obj_set_style_text_font(s_sending_lbl, &geist_reg_20, 0);
    lv_obj_set_style_text_color(s_sending_lbl, COL_ACCENT, 0);
    lv_obj_align(s_sending_lbl, LV_ALIGN_BOTTOM_MID, 0, -34);
    lv_obj_clear_flag(s_sending_lbl, LV_OBJ_FLAG_CLICKABLE | LV_OBJ_FLAG_SCROLLABLE);
    lv_label_set_text(s_sending_lbl, "Sending");
    lv_obj_add_flag(s_sending_lbl, LV_OBJ_FLAG_HIDDEN);

    // "Creating…" — a centered rotating spinner shown while a new project is being created
    // (tap → HTTP round-trip). No text, just the ring (per the design).
    s_creating_spin = make_spinner(scr_projects, 64);
    lv_obj_align(s_creating_spin, LV_ALIGN_CENTER, 0, 0);
    lv_obj_add_flag(s_creating_spin, LV_OBJ_FLAG_HIDDEN);

    // Reader screen: full text of one event, vertically scrollable. Opened by swipe-up on a project,
    // closed by a horizontal swipe (a TAP here reveals the voice button instead — see ui_tap).
    // Round screen: generous top/bottom padding keeps the first/last lines off the curved edge,
    // and horizontal padding keeps line ends inside the circle. Big top/bottom pad also lets the
    // very first and last lines scroll into the wide centre band to be read fully.
    // Centred column ~330px wide fits inside the circle's widest band, so lines never clip at the
    // left/right curve; 64px top/bottom keeps the first/last lines off the arc. Vertically scroll.
    scr_reader = lv_obj_create(NULL);
    lv_obj_set_style_bg_color(scr_reader, COL_BG, 0);
    lv_obj_set_style_pad_hor(scr_reader, 46, 0);   // wider text column (was 68) — less empty side space
    lv_obj_set_style_pad_top(scr_reader, 50, 0);   // name pill sits here, just under the top 🔔 arc
    lv_obj_set_style_pad_bottom(scr_reader, 64, 0);
    lv_obj_add_flag(scr_reader, LV_OBJ_FLAG_SCROLLABLE);
    lv_obj_set_scroll_dir(scr_reader, LV_DIR_VER);
    lv_obj_set_scrollbar_mode(scr_reader, LV_SCROLLBAR_MODE_OFF);
    // Stack the name pill over the full text (Figma "detail screen" adds the project name at the top).
    lv_obj_set_flex_flow(scr_reader, LV_FLEX_FLOW_COLUMN);
    lv_obj_set_flex_align(scr_reader, LV_FLEX_ALIGN_START, LV_FLEX_ALIGN_CENTER, LV_FLEX_ALIGN_CENTER);
    lv_obj_set_style_pad_row(scr_reader, 24, 0);
    // Name pill: green dot + project/agent name in a dark glass pill (same as the main-screen header).
    lv_obj_t *rhdr = lv_obj_create(scr_reader);
    lv_obj_remove_style_all(rhdr);
    lv_obj_clear_flag(rhdr, LV_OBJ_FLAG_CLICKABLE | LV_OBJ_FLAG_SCROLLABLE);
    lv_obj_set_size(rhdr, LV_SIZE_CONTENT, LV_SIZE_CONTENT);
    lv_obj_set_flex_flow(rhdr, LV_FLEX_FLOW_ROW);
    lv_obj_set_flex_align(rhdr, LV_FLEX_ALIGN_CENTER, LV_FLEX_ALIGN_CENTER, LV_FLEX_ALIGN_CENTER);
    lv_obj_set_style_pad_column(rhdr, 8, 0);
    lv_obj_set_style_bg_color(rhdr, lv_color_hex(0x1c1e24), 0);
    lv_obj_set_style_bg_opa(rhdr, LV_OPA_70, 0);
    lv_obj_set_style_radius(rhdr, LV_RADIUS_CIRCLE, 0);
    lv_obj_set_style_pad_hor(rhdr, 16, 0);
    lv_obj_set_style_pad_ver(rhdr, 7, 0);
    lv_obj_set_style_border_width(rhdr, 1, 0);
    lv_obj_set_style_border_color(rhdr, lv_color_hex(0xa6a6a6), 0);
    lv_obj_set_style_border_opa(rhdr, LV_OPA_20, 0);
    lv_obj_t *rdot = lv_obj_create(rhdr);
    lv_obj_remove_style_all(rdot);
    lv_obj_set_size(rdot, 8, 8);
    lv_obj_set_style_radius(rdot, LV_RADIUS_CIRCLE, 0);
    lv_obj_set_style_bg_opa(rdot, LV_OPA_COVER, 0);
    lv_obj_set_style_bg_color(rdot, COL_GREEN, 0);
    s_reader_name = lv_label_create(rhdr);
    lv_obj_set_style_text_color(s_reader_name, COL_FG, 0);
    lv_obj_set_style_text_font(s_reader_name, &geist_med_32, 0);   // agent name (32px)
    lv_obj_set_style_max_width(s_reader_name, 320, 0);
    lv_label_set_long_mode(s_reader_name, LV_LABEL_LONG_DOT);
    lv_label_set_text(s_reader_name, "");
    reader_lbl = lv_label_create(scr_reader);
    lv_label_set_long_mode(reader_lbl, LV_LABEL_LONG_WRAP);
    lv_obj_set_width(reader_lbl, lv_pct(100));
    lv_obj_set_style_text_font(reader_lbl, &geist_reg_34, 0);   // full-text detail body
    lv_obj_set_style_text_color(reader_lbl, COL_FG, 0);
    lv_obj_set_style_text_align(reader_lbl, LV_TEXT_ALIGN_CENTER, 0);
    lv_obj_set_style_text_line_space(reader_lbl, 4, 0);   // readable long-form text
    lv_label_set_text(reader_lbl, "");

    // Question screen: a vertical, scrollable flex column of tappable rows (rebuilt each render).
    scr_question = lv_obj_create(NULL);
    lv_obj_set_style_bg_color(scr_question, COL_BG, 0);
    lv_obj_set_style_pad_hor(scr_question, 54, 0);
    // Top-anchored (not centred) + scrollable so a tall question (text + options + Done) can
    // ALWAYS be scrolled to — a centred column clips its lower rows below the round screen's bottom
    // arc, leaving the last option / "Done" untappable. Generous top/bottom pad keeps the first/last
    // row out of the curve.
    lv_obj_set_style_pad_top(scr_question, 70, 0);
    lv_obj_set_style_pad_bottom(scr_question, 90, 0);
    lv_obj_set_style_pad_row(scr_question, 12, 0);
    lv_obj_set_flex_flow(scr_question, LV_FLEX_FLOW_COLUMN);
    lv_obj_set_flex_align(scr_question, LV_FLEX_ALIGN_START, LV_FLEX_ALIGN_CENTER, LV_FLEX_ALIGN_CENTER);
    lv_obj_add_flag(scr_question, LV_OBJ_FLAG_SCROLLABLE);
    lv_obj_set_scroll_dir(scr_question, LV_DIR_VER);
    lv_obj_set_scrollbar_mode(scr_question, LV_SCROLLBAR_MODE_AUTO);

    // "Not connected" badge — top-centre; hidden until grid-app goes quiet past the heartbeat (see
    // refresh_conn_ui). Non-interactive so it never steals taps.
    s_reconnect_badge = lv_label_create(lv_layer_top());
    lv_obj_set_style_text_font(s_reconnect_badge, &lv_font_montserrat_14, 0);
    lv_obj_set_style_text_color(s_reconnect_badge, COL_YELLOW, 0);
    lv_obj_align(s_reconnect_badge, LV_ALIGN_TOP_MID, 0, 30);
    lv_obj_clear_flag(s_reconnect_badge, LV_OBJ_FLAG_CLICKABLE);
    lv_obj_clear_flag(s_reconnect_badge, LV_OBJ_FLAG_SCROLLABLE);
    lv_label_set_text(s_reconnect_badge, "Reconnecting" LV_SYMBOL_REFRESH);
    lv_obj_add_flag(s_reconnect_badge, LV_OBJ_FLAG_HIDDEN);

    // Notification pill (top-mid): a "🔔 N" unread badge on the projects screen. Pure indicator (open the
    // drawer by pulling down from the top edge — see touch.c). Created before s_dim so the dim overlay
    // still darkens it.
    // THE BELL IS A BUTTON NOW. It used to be a read-only badge and the drawer opened by pulling down from
    // the top; the pull-down became the agent switcher, which is reached far more often than a list of
    // finished turns, so the drawer moved onto the badge that was already announcing it.
    s_notif_pill = lv_obj_create(lv_layer_top());
    lv_obj_remove_style_all(s_notif_pill);
    lv_obj_clear_flag(s_notif_pill, LV_OBJ_FLAG_SCROLLABLE);
    lv_obj_add_flag(s_notif_pill, LV_OBJ_FLAG_CLICKABLE);
    lv_obj_add_event_cb(s_notif_pill, notif_pill_tap, LV_EVENT_CLICKED, NULL);
    lv_obj_set_size(s_notif_pill, LV_SIZE_CONTENT, LV_SIZE_CONTENT);
    lv_obj_set_style_bg_color(s_notif_pill, lv_color_hex(0x006fff), 0);   // Figma blue 🔔 badge
    lv_obj_set_style_bg_opa(s_notif_pill, LV_OPA_COVER, 0);
    lv_obj_set_style_radius(s_notif_pill, LV_RADIUS_CIRCLE, 0);
    lv_obj_set_style_pad_hor(s_notif_pill, 13, 0);
    lv_obj_set_style_pad_ver(s_notif_pill, 4, 0);
    lv_obj_align(s_notif_pill, LV_ALIGN_TOP_MID, 0, 22);   // where the switcher's mark briefly sat
    lv_obj_set_style_bg_opa(s_notif_pill, LV_OPA_80, LV_STATE_PRESSED);   // it presses now, so it says so
    lv_obj_set_flex_flow(s_notif_pill, LV_FLEX_FLOW_ROW);
    lv_obj_set_flex_align(s_notif_pill, LV_FLEX_ALIGN_CENTER, LV_FLEX_ALIGN_CENTER, LV_FLEX_ALIGN_CENTER);
    lv_obj_set_style_pad_column(s_notif_pill, 6, 0);
    { lv_obj_t *bell = lv_label_create(s_notif_pill);
      lv_obj_set_style_text_font(bell, &lv_font_montserrat_14, 0);
      lv_obj_set_style_text_color(bell, COL_FG, 0);
      lv_label_set_text(bell, LV_SYMBOL_BELL);
      s_notif_pill_lbl = lv_label_create(s_notif_pill);
      lv_obj_set_style_text_font(s_notif_pill_lbl, &lv_font_montserrat_22, 0);
      lv_obj_set_style_text_color(s_notif_pill_lbl, COL_FG, 0);
      lv_label_set_text(s_notif_pill_lbl, "0"); }
    lv_obj_add_flag(s_notif_pill, LV_OBJ_FLAG_HIDDEN);

    // Notification drawer: a full-screen pull-down overlay (hidden by default, at y=0). Tap the empty
    // background → close; rows navigate. A grabber + "Notifications" header + a scrollable row list.
    s_notif_drawer = lv_obj_create(lv_layer_top());
    lv_obj_remove_style_all(s_notif_drawer);
    lv_obj_set_size(s_notif_drawer, lv_pct(100), lv_pct(100));
    lv_obj_set_pos(s_notif_drawer, 0, 0);
    lv_obj_set_style_bg_color(s_notif_drawer, COL_CARD, 0);
    lv_obj_set_style_bg_opa(s_notif_drawer, LV_OPA_COVER, 0);
    lv_obj_add_flag(s_notif_drawer, LV_OBJ_FLAG_CLICKABLE);   // empty-area tap closes it
    lv_obj_add_event_cb(s_notif_drawer, notif_bg_tap, LV_EVENT_CLICKED, NULL);
    lv_obj_add_flag(s_notif_drawer, LV_OBJ_FLAG_HIDDEN);
    { // Header is a plain close pill (Figma): 60x32, white at 10%, with a white x. It replaced a blue
      // bell+count badge — the drawer IS the notification list, so counting them again directly above it
      // told the user nothing they could not see, and the design draws only this.
      lv_obj_t *cls = lv_button_create(s_notif_drawer);
      lv_obj_set_size(cls, 60, 32);
      lv_obj_align(cls, LV_ALIGN_TOP_MID, 0, 16);   // Figma y
      lv_obj_set_style_bg_color(cls, COL_FG, 0);
      lv_obj_set_style_bg_opa(cls, LV_OPA_10, 0);
      lv_obj_set_style_bg_opa(cls, LV_OPA_20, LV_STATE_PRESSED);
      lv_obj_set_style_radius(cls, LV_RADIUS_CIRCLE, 0);
      lv_obj_set_style_border_width(cls, 0, 0);
      lv_obj_set_style_shadow_width(cls, 0, 0);
      lv_obj_set_style_pad_all(cls, 0, 0);
      lv_obj_add_event_cb(cls, notif_bg_tap, LV_EVENT_CLICKED, NULL);   // same close path as tapping the backdrop
      lv_obj_t *xl = lv_label_create(cls);
      lv_obj_set_style_text_font(xl, &lv_font_montserrat_22, 0);   // LV_SYMBOL_* exist only in Montserrat
      lv_obj_set_style_text_color(xl, COL_FG, 0);
      lv_label_set_text(xl, LV_SYMBOL_CLOSE);
      lv_obj_center(xl); }
    s_notif_list = lv_obj_create(s_notif_drawer);   // scrollable column of cards (centered band, below the badge)
    lv_obj_remove_style_all(s_notif_list);
    lv_obj_set_size(s_notif_list, 360, 320);
    lv_obj_align(s_notif_list, LV_ALIGN_CENTER, 0, 34);
    lv_obj_set_flex_flow(s_notif_list, LV_FLEX_FLOW_COLUMN);
    lv_obj_set_style_pad_row(s_notif_list, 12, 0);
    lv_obj_set_scroll_dir(s_notif_list, LV_DIR_VER);
    lv_obj_set_scrollbar_mode(s_notif_list, LV_SCROLLBAR_MODE_OFF);
    s_notif_empty = lv_label_create(s_notif_drawer);
    lv_obj_set_style_text_font(s_notif_empty, &geist_reg_25, 0);
    lv_obj_set_style_text_color(s_notif_empty, COL_MUTED, 0);
    lv_label_set_text(s_notif_empty, "No notifications");
    lv_obj_align(s_notif_empty, LV_ALIGN_CENTER, 0, 0);
    lv_obj_add_flag(s_notif_empty, LV_OBJ_FLAG_HIDDEN);

#if NOTIF_DEBUG_SEED   // TEMP: fake notifications so the redesigned drawer has content to review — REMOVE (set NOTIF_DEBUG_SEED 0)
    { struct { const char *nm, *sm; } seed[] = {
        {"Reliability Specialist", "A missing database index caused API latency to increase"},
        {"DevOps Operations Agent", "Roll back the affected deployment."},
        {"Analysis Agent", "Restore the missing index."},
      };
      for (int s = (int)(sizeof(seed)/sizeof(seed[0])) - 1; s >= 0; s--) {   // push oldest first → seed[0] newest
          notif_t r = {0};
          snprintf(r.proj_id, sizeof r.proj_id, "seed-%d", s);
          snprintf(r.name, sizeof r.name, "%s", seed[s].nm);
          snprintf(r.summary, sizeof r.summary, "%s", seed[s].sm);
          r.ms = lv_tick_get(); r.unread = true; r.used = true;
          for (int k = NOTIF_MAX - 1; k > 0; k--) s_notif[k] = s_notif[k - 1];
          s_notif[0] = r;
      }
    }
#endif

    // Software brightness: a full-screen black overlay on the very top of the top layer. Its opacity
    // dims everything below it (OLED black = off → real luminance drop). Non-interactive so touches
    // pass straight through. Created last → sits above all content.
    s_dim = lv_obj_create(lv_layer_top());
    lv_obj_remove_style_all(s_dim);
    lv_obj_set_size(s_dim, lv_pct(100), lv_pct(100));
    lv_obj_center(s_dim);
    lv_obj_set_style_bg_color(s_dim, lv_color_black(), 0);
    lv_obj_set_style_bg_opa(s_dim, LV_OPA_TRANSP, 0);
    lv_obj_add_flag(s_dim, LV_OBJ_FLAG_FLOATING);
    lv_obj_remove_flag(s_dim, LV_OBJ_FLAG_CLICKABLE);
    lv_obj_remove_flag(s_dim, LV_OBJ_FLAG_SCROLLABLE);

    // Voice-mode overlay (the Figma frame with the dimmed voice call): a dark full-screen layer shown while
    // recording/uploading, sitting BEHIND the mic/dots/pulse voice indicator. voice_overlay_set() shows it
    // AND frees all tile content while it's up, so the PCM capture keeps its internal-RAM headroom.
    s_voice_overlay = lv_obj_create(lv_layer_top());
    lv_obj_remove_style_all(s_voice_overlay);
    lv_obj_set_size(s_voice_overlay, lv_pct(100), lv_pct(100));
    lv_obj_center(s_voice_overlay);
    lv_obj_set_style_bg_color(s_voice_overlay, lv_color_black(), 0);
    lv_obj_set_style_bg_opa(s_voice_overlay, LV_OPA_COVER, 0);
    lv_obj_add_flag(s_voice_overlay, LV_OBJ_FLAG_FLOATING | LV_OBJ_FLAG_HIDDEN | LV_OBJ_FLAG_CLICKABLE);
    lv_obj_remove_flag(s_voice_overlay, LV_OBJ_FLAG_SCROLLABLE);
    // CLICKABLE (not just a visual cover): while it's up during a voice turn it must ABSORB every touch so a
    // tap can't fall through to the Overview Voice/Goal buttons on the screen below (a non-clickable overlay is
    // transparent to LVGL hit-testing → the tap-to-stop would instead land as a Goal button click). tap-to-stop
    // itself is driven from touch.c's raw coordinates, independent of this.
    lv_obj_move_background(s_voice_overlay);   // behind the voice indicator on the top layer

    // Built once, here, before the first `update_content_window` — which is what puts it at its column.
    // Unlike the reference this tile does not need rebuilding when the project count changes: tiles are
    // positioned by absolute x on this device, not by a tileview column index, so moving it is enough.
    rebuild_settings_tile();

    // The lock gate: arm on sleep, and on a genuine power-on demand the pattern before anything is drawn.
    // After rebuild_settings_tile because turning the lock off from its overlay rebuilds that tile.
    ui_lock_init_gate();

    lv_timer_create(statusbar_tick, 1000, NULL);
    lv_timer_create(busy_dots_tick, 300, NULL);   // animate the "processing" loading dots (~3Hz)
    lv_screen_load(scr_projects);
    display_unlock();
    ESP_LOGI(TAG, "ui ready");
}

void ui_show_error(const char *title, const char *detail)
{
    display_lock();
    lv_label_set_text(err_title, title ? title : "Error");
    lv_label_set_text(err_detail, detail ? detail : "");
    lv_screen_load(scr_error);
    display_unlock();
}

// An EMPTY machine (0 agents) never goes through add_proj — which sizes the huge spacer AND jumps the scroll
// to the middle of the range (CAROUSEL_M/2). Without that, the carousel sits pinned at the spacer's LEFT
// EDGE (4 fixed tiles at columns 0..3): no room to swipe left, no infinite loop. Set it up like a non-empty
// machine: assert the huge scroll range, then park the "No agents" page (ring RING_LEAD) at CAROUSEL_M/2.
static void carousel_center_empty(void)
{
    if (s_tile_count != 0) return;
    resize_spacer();
    // Only recenter when pinned near an EDGE of the huge range (i.e. never centered yet). Once we're at
    // ~M/2, leave the user's current swipe position on the empty ring alone.
    int cc = carousel_col();
    if (cc < CAROUSEL_M / 4 || cc > CAROUSEL_M - CAROUSEL_M / 4)
        carousel_goto(col_for_ring_near(CAROUSEL_M / 2, ring_of_agent(0)), LV_ANIM_OFF);   // "No agents" page at the middle
    apply_active_from_col();
    update_content_window();
    rebuild_page_dots();
}

void ui_show_tiles(void)
{
    display_lock();
    rebuild_overview_tile();
    rebuild_page_dots();
    carousel_center_empty();   // 0 agents → put "No agents" at CAROUSEL_M/2 so the ring stays swipeable
    lv_screen_load(scr_projects);
    display_unlock();
}

// Called once the project LIST is built (`projects` arrived). No-op unless a boot load or a
// reconnect is pending. Drops the loading spinner and slides to the OVERVIEW tile (ring 0) —
// the machine's home — regardless of project count.
void ui_land_after_reload(void)
{
    display_lock();
    if (!s_machine_landing_pending && !s_overview_loading) { display_unlock(); return; }
    bool land = s_machine_landing_pending;
    if (s_remote_online_reload &&
        (lv_screen_active() != scr_projects || !s_overview_active)) land = false;
    s_machine_landing_pending = false;
    s_remote_online_reload = false;
    ui_set_creating(false);
    s_overview_loading = false;   // list arrived → overview shows the real count (drops the spinner)
    rebuild_overview_tile();
    if (!land) {
        s_notif_focus[0] = '\0';
        update_content_window();
        rebuild_page_dots();
        display_unlock();
        return;
    }
    // ui_enter_machine_loading / ui_enter_boot_loading already centered the carousel at ~CAROUSEL_M/2, so this
    // slides (staying centered) to the Overview tile (ring 0) — the machine's home (name + agent count + Voice/Goal).
    // Exception: a notification tap that switched machines is asking for ONE agent — land on that tile instead
    // (falling back to the Overview if it's gone from the new list).
    int target = 0 /* overview */;
    char detail[48] = "";
    if (s_notif_focus[0]) {
        int ni = find_proj(s_notif_focus);
        snprintf(detail, sizeof detail, "%s", s_notif_focus);
        s_notif_focus[0] = '\0';
        if (ni >= 0) { target = ring_of_agent(ni); s_active_idx = ni; }
    }
    carousel_goto(col_for_ring_near(carousel_col(), target), LV_ANIM_ON);
    apply_active_from_col();
    update_content_window();
    rebuild_page_dots();
    display_unlock();
    // A notification whose agent lives on ANOTHER machine lands here instead, once that machine's list has
    // arrived. Finish the same way the direct tap does — otherwise the same gesture would take you to two
    // different places depending on which machine the notification came from. Called outside the lock.
    if (detail[0]) open_agent_detail(detail);
}

// Boot landing: the project list hasn't loaded yet, so DON'T flash the "No projects" empty tile. Park on
// the Overview tile (ring 0 — the machine's name + project count, a sensible home while data loads) and arm
// a landing so that once `projects` arrives, ui_land_after_reload slides to project 0 (or stays on the
// Overview when the list is empty).
void ui_enter_boot_loading(void)
{
    display_lock();
    s_remote_offline_view = false;
    s_remote_online_reload = false;
    s_machine_landing_pending = true;
    s_overview_loading = true;   // spinner (not "0 projects") while the list is still coming
    rebuild_overview_tile();
    resize_spacer();   // huge scroll range even for a machine that loads empty (add_proj won't run)
    carousel_goto(col_for_ring_near(CAROUSEL_M / 2, 0 /* overview */), LV_ANIM_OFF);   // CENTERED on the Overview
    apply_active_from_col();
    update_content_window();
    rebuild_page_dots();
    lv_screen_load(scr_projects);
    display_unlock();
}

void ui_enter_remote_offline(void)
{
    display_lock();
    s_remote_offline_view = true;
    s_remote_online_reload = false;
    s_machine_landing_pending = false;
    s_overview_loading = false;
    ui_set_creating(false);

    // Every tile is now a claim about a machine that has stopped answering. Drop the model before exposing
    // the carousel, so nothing can be swiped to and acted on while grid-app is not there to hear it.
    ui_tile_clear_all();
    rebuild_overview_tile();
    if (lv_screen_active() != scr_projects) lv_screen_load(scr_projects);
    carousel_goto(col_for_ring_near(carousel_col(), 0 /* overview */), LV_ANIM_OFF);
    apply_active_from_col();
    update_content_window();
    rebuild_page_dots();
    refresh_conn_ui();
    if (display_is_asleep()) display_wake();
    display_unlock();
}

void ui_leave_remote_offline_loading(void)
{
    display_lock();
    if (!s_remote_offline_view) { display_unlock(); return; }
    s_remote_offline_view = false;
    s_overview_loading = true;
    s_remote_online_reload = true;
    s_machine_landing_pending = true;
    rebuild_overview_tile();
    refresh_conn_ui();
    display_unlock();
}

void ui_leave_error_screen(void)
{
    display_lock();
    if (lv_screen_active() == scr_error) lv_screen_load(scr_projects);
    display_unlock();
}

// Refresh the overview tile: eyebrow = the machine's name (from `welcome`); headline = "N projects".
// Screen lock — 3×3 pattern passcode. A full-screen overlay on the top layer captures ALL touch; the user
// draws a path over 9 dots. Only a salted SHA-256 of the dot-index sequence is stored (device_prefs) — the
// pattern itself is never persisted. Locks on wake-from-sleep and at boot (ui_lock_init_gate). Casual
// security: a smudge trail on the AMOLED or a shoulder-surf can leak the shape — enough to stop a
// passer-by poking your agents, not a determined attacker.
enum { LK_UNLOCK, LK_SET, LK_CONFIRM, LK_DISABLE };
#define LK_GAP        113      // dot spacing (px) — matches the "Create your pattern" Figma grid
#define COL_LOCK_DOT   lv_color_hex(0xffffff)   // idle pattern dot (white, per Figma)
#define COL_LOCK_GREEN lv_color_hex(0x75f958)   // selected dot + line (bright green, per Figma)
#define LK_HIT        44       // finger hit radius around a dot (< GAP/2 so adjacent dots don't co-trigger)
#define LK_MIN        4        // minimum dots in a valid pattern
#define LK_MAX_FAIL   5        // wrong unlock tries → unpair (wipe token + passcode) + reboot to pairing
#define LK_CX         233      // grid centre x
#define LK_CY         233      // grid centre y — screen centre (flat, dots-only)

static lv_obj_t *s_lk_overlay;
static lv_obj_t *s_lk_msg;                 // single message line ABOVE the grid (instruction / error). Empty
                                           // on an idle unlock screen — the 9 dots alone are the cue.
static lv_obj_t *s_lk_cancel;              // "Cancel" pill (setup/disable only; hidden on the unlock gate)
static lv_obj_t *s_lk_dots[9];             // flat dot (grey idle → green selected)
static lv_obj_t *s_lk_seg[9];              // line between consecutive selected dots
static lv_point_precise_t s_lk_seg_pt[9][2];
static int32_t  s_lk_dcx[9], s_lk_dcy[9];  // dot centres (screen coords)
static uint8_t  s_lk_seq[9];
static int      s_lk_len;
static bool     s_lk_sel[9];
static int      s_lk_mode;
static char     s_lk_first[32];            // first pattern captured during setup (to confirm against)
static bool     s_lk_armed;                // re-lock on the next wake (set on sleep)
static bool     s_lk_shown;                // overlay currently blocking the UI
static int      s_lk_fails;

// The single message line above the grid. Empty string → blank (idle unlock = dots only).
static void lk_msg(const char *msg, lv_color_t col)
{
    if (!s_lk_msg) return;
    lv_label_set_text(s_lk_msg, msg ? msg : "");
    lv_obj_set_style_text_color(s_lk_msg, col, 0);
}

static void lk_clear_draw(void)
{
    for (int k = 0; k < 9; k++) {
        s_lk_sel[k] = false;
        if (s_lk_dots[k]) lv_obj_set_style_bg_color(s_lk_dots[k], COL_LOCK_DOT, 0);
        if (s_lk_seg[k]) lv_obj_add_flag(s_lk_seg[k], LV_OBJ_FLAG_HIDDEN);
    }
    s_lk_len = 0;
}

static void lk_seq_str(char *out, size_t cap)
{
    out[0] = '\0';
    for (int i = 0; i < s_lk_len; i++) {
        char b[8]; snprintf(b, sizeof b, i ? ",%d" : "%d", s_lk_seq[i]);
        strncat(out, b, cap - strlen(out) - 1);
    }
}

static void lk_add_dot(int k)
{
    if (s_lk_sel[k]) return;
    if (s_lk_len > 0) {                       // draw the segment from the previous dot to this one
        int prev = s_lk_seq[s_lk_len - 1], seg = s_lk_len - 1;
        int32_t x0 = s_lk_dcx[prev], y0 = s_lk_dcy[prev], x1 = s_lk_dcx[k], y1 = s_lk_dcy[k];
        // Size the line object tightly to the segment's bounding box (+margin) so only that small area
        // repaints — a full-screen line object would invalidate the whole panel per segment.
        int32_t ox = LV_MIN(x0, x1) - 6, oy = LV_MIN(y0, y1) - 6;
        lv_obj_set_pos(s_lk_seg[seg], ox, oy);
        lv_obj_set_size(s_lk_seg[seg], LV_ABS(x1 - x0) + 12, LV_ABS(y1 - y0) + 12);
        s_lk_seg_pt[seg][0].x = x0 - ox; s_lk_seg_pt[seg][0].y = y0 - oy;
        s_lk_seg_pt[seg][1].x = x1 - ox; s_lk_seg_pt[seg][1].y = y1 - oy;
        lv_line_set_points(s_lk_seg[seg], s_lk_seg_pt[seg], 2);
        lv_obj_clear_flag(s_lk_seg[seg], LV_OBJ_FLAG_HIDDEN);
    }
    s_lk_sel[k] = true;
    s_lk_seq[s_lk_len++] = (uint8_t)k;
    lv_obj_set_style_bg_color(s_lk_dots[k], COL_LOCK_GREEN, 0);   // flat: white → green on select
}

static void lk_hide(void)
{
    s_lk_shown = false;
    if (s_lk_overlay) lv_obj_add_flag(s_lk_overlay, LV_OBJ_FLAG_HIDDEN);
}

// One-shot timer (armed after LK_MAX_FAIL wrong unlocks): clear the passcode and carry on.
//
// THE REFERENCE DID SOMETHING DESTRUCTIVE HERE — it wiped the account link and rebooted into pairing, so
// five wrong tries cost you something real and were not a free bypass. This device has no account link to
// cut: it holds nothing but a brightness level and this pattern.
//
// So the choice is between a free bypass after five visible failures, and a panel that nobody can use
// again without a flash tool. The bypass, and the reason is the threat model the header states: this lock
// stops a passer-by, and a passer-by does not sit through five failures. Anyone who would is holding the
// cable, and over that cable the whole firmware can be replaced — so a lockout would protect nothing while
// costing a forgotten pattern the entire device.
//
// Deferred via a timer so the message paints before the overlay goes.
static void lk_reset_clear(lv_timer_t *t)
{
    (void)t;
    device_prefs_clear_lock();
    lk_hide();
    rebuild_settings_tile();
    update_content_window();
}

// Evaluate the drawn pattern on release, per mode.
static void lk_finish(void)
{
    char seq[32]; lk_seq_str(seq, sizeof seq);
    bool tooShort = s_lk_len < LK_MIN;

    lv_color_t err = lv_color_hex(0xe05555);   // soft red for errors
    switch (s_lk_mode) {
    case LK_UNLOCK:
        if (!tooShort && device_prefs_check_lock(seq)) { s_lk_fails = 0; s_lk_armed = false; lk_hide(); return; }
        lk_clear_draw();
        if (++s_lk_fails >= LK_MAX_FAIL) {
            // Too many wrong tries → unpair + reboot to pairing (deferred so this message paints first).
            lk_msg("Too many tries — the lock is off", err);
            lv_timer_t *tm = lv_timer_create(lk_reset_clear, 1500, NULL);
            lv_timer_set_repeat_count(tm, 1);
            return;
        }
        { char b[40]; snprintf(b, sizeof b, "Wrong, try again (%d/%d)", s_lk_fails, LK_MAX_FAIL);
          lk_msg(b, err); }
        return;
    case LK_DISABLE:
        if (!tooShort && device_prefs_check_lock(seq)) {
            device_prefs_clear_lock(); audio_notify_done(); lk_hide();
            rebuild_settings_tile(); update_content_window();   // reposition the rebuilt tile → back on Settings
            return;
        }
        lk_clear_draw();
        lk_msg("Wrong pattern", err);
        return;
    case LK_SET:
        if (tooShort) { lk_clear_draw(); lk_msg("Use at least 4 dots", err); return; }
        snprintf(s_lk_first, sizeof s_lk_first, "%s", seq);
        s_lk_mode = LK_CONFIRM;
        lk_clear_draw();
        lk_msg("Draw it again", COL_FG);
        return;
    case LK_CONFIRM:
        if (!tooShort && strcmp(seq, s_lk_first) == 0) {
            device_prefs_set_lock(seq); audio_notify_done(); lk_hide();
            rebuild_settings_tile(); update_content_window();   // reposition the rebuilt tile → back on Settings
            return;
        }
        s_lk_mode = LK_SET;
        lk_clear_draw();
        lk_msg("Didn't match", err);
        return;
    }
}

static void lk_pressing(lv_event_t *e)
{
    (void)e;
    lv_indev_t *indev = lv_indev_active();
    if (!indev) return;
    lv_point_t p; lv_indev_get_point(indev, &p);
    for (int k = 0; k < 9; k++) {
        if (s_lk_sel[k]) continue;
        int32_t dx = p.x - s_lk_dcx[k], dy = p.y - s_lk_dcy[k];
        if (dx * dx + dy * dy <= LK_HIT * LK_HIT) lk_add_dot(k);
    }
    // No live finger-tracking "tail" line: updating a full-screen line every pointer move forced a
    // full-screen repaint each frame → jank on this render-bound panel. Dots light up + segments connect
    // as the finger crosses them (cheap, occasional invalidation) — enough visual feedback.
}

static void lk_released(lv_event_t *e)
{
    (void)e;
    if (s_lk_len > 0) lk_finish();
}

// Cancel (setup/disable only): back out without changing anything — just hide the overlay to reveal the
// Settings tile underneath. Never wired on the unlock gate (the button is hidden there).
static void lk_cancel_tap(lv_event_t *e)
{
    (void)e;
    lk_hide();
}

static void lk_build(void)
{
    if (s_lk_overlay) return;
    lv_obj_t *ov = lv_obj_create(lv_layer_top());
    lv_obj_remove_style_all(ov);
    lv_obj_set_size(ov, 466, 466);
    lv_obj_set_pos(ov, 0, 0);
    lv_obj_set_style_bg_color(ov, COL_BG, 0);   // flat black, like the original
    lv_obj_set_style_bg_opa(ov, LV_OPA_COVER, 0);
    lv_obj_add_flag(ov, LV_OBJ_FLAG_CLICKABLE);
    lv_obj_clear_flag(ov, LV_OBJ_FLAG_SCROLLABLE);
    lv_obj_add_event_cb(ov, lk_pressing, LV_EVENT_PRESSING, NULL);
    lv_obj_add_event_cb(ov, lk_released, LV_EVENT_RELEASED, NULL);
    s_lk_overlay = ov;

    // One message line above the grid (instruction / error). Empty on an idle unlock screen.
    s_lk_msg = lv_label_create(ov);
    lv_obj_set_style_text_font(s_lk_msg, &geist_reg_25, 0);
    lv_obj_set_style_text_color(s_lk_msg, COL_FG, 0);
    lv_obj_set_width(s_lk_msg, 340);                                  // bound to the round-safe width
    lv_obj_set_style_text_align(s_lk_msg, LV_TEXT_ALIGN_CENTER, 0);
    lv_label_set_long_mode(s_lk_msg, LV_LABEL_LONG_WRAP);             // any long message wraps, never clips the UI
    lv_label_set_text(s_lk_msg, "");
    lv_obj_align(s_lk_msg, LV_ALIGN_TOP_MID, 0, 46);   // title y per the "Create your pattern" Figma

    // Segment lines first (below the dots in z-order). Positioned + sized tightly per segment in lk_add_dot.
    for (int k = 0; k < 9; k++) {
        lv_obj_t *ln = lv_line_create(ov);
        lv_obj_set_style_line_color(ln, COL_LOCK_GREEN, 0);
        lv_obj_set_style_line_width(ln, 5, 0);
        lv_obj_set_style_line_rounded(ln, true, 0);
        lv_obj_add_flag(ln, LV_OBJ_FLAG_HIDDEN);
        s_lk_seg[k] = ln;
    }

    // 9 flat dots (3×3), centred on the screen.
    for (int k = 0; k < 9; k++) {
        int r = k / 3, c = k % 3;
        s_lk_dcx[k] = LK_CX + (c - 1) * LK_GAP;
        s_lk_dcy[k] = LK_CY + (r - 1) * LK_GAP;
        lv_obj_t *d = lv_obj_create(ov);
        lv_obj_remove_style_all(d);
        lv_obj_clear_flag(d, LV_OBJ_FLAG_CLICKABLE | LV_OBJ_FLAG_SCROLLABLE);
        lv_obj_set_size(d, 16, 16);
        lv_obj_set_style_radius(d, LV_RADIUS_CIRCLE, 0);
        lv_obj_set_style_bg_opa(d, LV_OPA_COVER, 0);
        lv_obj_set_style_bg_color(d, COL_LOCK_DOT, 0);
        lv_obj_set_pos(d, s_lk_dcx[k] - 8, s_lk_dcy[k] - 8);
        s_lk_dots[k] = d;
    }

    // "Cancel" pill at the bottom — shown only for setup/disable (lk_show toggles it), lets the user back out.
    s_lk_cancel = lv_button_create(ov);
    lv_obj_set_style_bg_color(s_lk_cancel, COL_SET_PILL, 0);
    lv_obj_set_style_bg_color(s_lk_cancel, lv_color_hex(0x2c2c2c), LV_STATE_PRESSED);
    lv_obj_set_style_radius(s_lk_cancel, LV_RADIUS_CIRCLE, 0);
    lv_obj_set_style_border_width(s_lk_cancel, 1, 0);
    lv_obj_set_style_border_color(s_lk_cancel, COL_SET_BORD, 0);
    lv_obj_set_style_pad_hor(s_lk_cancel, 34, 0);
    lv_obj_set_style_pad_ver(s_lk_cancel, 16, 0);
    lv_obj_align(s_lk_cancel, LV_ALIGN_BOTTOM_MID, 0, -26);   // lower, clear of the bottom dot row
    lv_obj_set_ext_click_area(s_lk_cancel, 28);   // forgiving hit zone (tap drift near the edge still counts)
    lv_obj_add_flag(s_lk_cancel, LV_OBJ_FLAG_HIDDEN);
    lv_obj_add_event_cb(s_lk_cancel, lk_cancel_tap, LV_EVENT_CLICKED, NULL);
    lv_obj_t *cl = lv_label_create(s_lk_cancel);
    lv_obj_set_style_text_font(cl, &geist_reg_20, 0);
    lv_obj_set_style_text_color(cl, COL_MUTED, 0);
    lv_label_set_text(cl, "Cancel");
    lv_obj_center(cl);
}

static void lk_show(int mode)
{
    lk_build();
    s_lk_mode = mode;
    lk_clear_draw();
    // UNLOCK → no text (just the 9 dots); setup/disable → an instruction.
    lk_msg(mode == LK_SET ? "Create your pattern"
         : mode == LK_DISABLE ? "Confirm to turn off"
         : "Draw Pattern to Unlock", COL_FG);
    // Cancel only for setup/disable — the unlock gate has no way out but the correct pattern (or 5 fails).
    if (s_lk_cancel) {
        if (mode == LK_UNLOCK) lv_obj_add_flag(s_lk_cancel, LV_OBJ_FLAG_HIDDEN);
        else lv_obj_clear_flag(s_lk_cancel, LV_OBJ_FLAG_HIDDEN);
    }
    s_lk_shown = true;
    lv_obj_clear_flag(s_lk_overlay, LV_OBJ_FLAG_HIDDEN);
    overlay_raise(s_lk_overlay);
    if (display_is_asleep()) display_wake();
}

// display power hook (registered in ui_lock_init_gate): arm on sleep, unlock-prompt on wake.
static void lk_power_cb(bool on)
{
    if (!on) { if (device_prefs_lock_enabled()) s_lk_armed = true; return; }
    if (device_prefs_lock_enabled() && s_lk_armed && !s_lk_shown) lk_show(LK_UNLOCK);
}

void ui_lock_init_gate(void)
{
    display_set_power_cb(lk_power_cb);
    // Lock at boot ONLY on a genuine power-on / hardware reset — NOT on a firmware `esp_restart()`
    // (ESP_RST_SW). Here that is how a cable OTA finishes, and demanding the pattern after an update the
    // person at the desk just pushed from the app would read as the update having broken something.
    // Wake-from-sleep still prompts (lk_power_cb) regardless.
    if (esp_reset_reason() != ESP_RST_SW && device_prefs_lock_enabled()) {
        s_lk_armed = true;
        lk_show(LK_UNLOCK);
    }
}

void ui_lock_setup(void)
{
    lk_show(device_prefs_lock_enabled() ? LK_DISABLE : LK_SET);
}

bool ui_lock_active(void) { return s_lk_shown; }

// ── SETTINGS ────────────────────────────────────────────────────────────────────────────────────────
//
// Three rows: Voice · Brightness · Version. The reference had six — Wifi, Voice, Passcode, Brightness,
// Version, Reset device — and the three that went are the three that answer a question this device does
// not have:
//
//   * **Wifi** — there is no radio. The cable is the link and the authorization.
//   * **Passcode** — a screen lock guards a device that holds something. This one holds nothing: it draws
//     state that lives on the computer it is plugged into, and unplugging it is the lock.
//   * **Reset device** — it wiped provisioning, pairing and WiFi credentials, none of which exist here.
//     Left in, its confirm dialog would have led to erasing a brightness level.
//
// Three rows also means the list does not scroll (four fit the circle at this width), so it is a list by
// construction rather than by luck — but it is still built as a scrolling column, because a fourth row
// arriving should push the others rather than crowd them.

// A list row: a glyph in a black circle, the label, and an optional right-aligned value.
//
// Carries no fill and no border. That is not only cosmetic in the design: a pill now means "this one is a
// track you drag", which is why Brightness keeps one on its own screen and nothing in this list does.
// Losing the pill also loses the press highlight it provided, so a faint fill goes back on the pressed
// state alone — a tap has to be felt.
static lv_obj_t *settings_row(lv_obj_t *parent, const lv_image_dsc_t *icon, const char *label,
                              lv_color_t label_col, const char *trailing, const lv_font_t *trail_font,
                              lv_color_t trail_col, lv_event_cb_t cb, lv_obj_t **out_label)
{
    lv_obj_t *row = lv_button_create(parent);
    lv_obj_set_width(row, SET_ROW_W);
    lv_obj_set_height(row, SET_ROW_H);
    lv_obj_set_style_bg_opa(row, LV_OPA_TRANSP, 0);
    lv_obj_set_style_bg_color(row, COL_FG, LV_STATE_PRESSED);
    lv_obj_set_style_bg_opa(row, LV_OPA_10, LV_STATE_PRESSED);   // the only press feedback left
    lv_obj_set_style_radius(row, LV_RADIUS_CIRCLE, 0);
    lv_obj_set_style_pad_left(row, 6, 0);
    lv_obj_set_style_pad_right(row, 14, 0);
    lv_obj_set_style_pad_ver(row, 6, 0);
    lv_obj_set_style_border_width(row, 0, 0);
    lv_obj_set_style_shadow_width(row, 0, 0);
    lv_obj_set_flex_flow(row, LV_FLEX_FLOW_ROW);
    lv_obj_set_flex_align(row, LV_FLEX_ALIGN_START, LV_FLEX_ALIGN_CENTER, LV_FLEX_ALIGN_CENTER);
    lv_obj_set_style_pad_column(row, 14, 0);

    // The icon sits in a 72px circle. Black on black, so nothing of the circle shows — it is there to hold
    // the left column, which is what keeps every label on this page aligned with every other.
    lv_obj_t *circ = lv_obj_create(row);
    lv_obj_remove_style_all(circ);
    lv_obj_clear_flag(circ, LV_OBJ_FLAG_CLICKABLE | LV_OBJ_FLAG_SCROLLABLE);
    lv_obj_set_size(circ, 72, 72);
    lv_obj_set_style_radius(circ, LV_RADIUS_CIRCLE, 0);
    lv_obj_set_style_bg_opa(circ, LV_OPA_COVER, 0);
    lv_obj_set_style_bg_color(circ, COL_SET_BG, 0);
    if (icon) {
        lv_obj_t *ic = lv_image_create(circ);
        lv_image_set_src(ic, icon);
        lv_obj_center(ic);
    }

    lv_obj_t *lb = lv_label_create(row);
    lv_obj_set_style_text_font(lb, SET_ROW_FONT, 0);
    lv_obj_set_style_text_color(lb, label_col, 0);
    lv_label_set_text(lb, label);
    lv_obj_set_flex_grow(lb, 1);   // fills the middle, pushing the value to the right edge
    lv_label_set_long_mode(lb, LV_LABEL_LONG_DOT);
    // Pinned to ONE line. LV_LABEL_LONG_DOT only truncates at a fixed height; with a free height it WRAPS,
    // which is how the reference's Version row became two lines and broke the list's rhythm. Truncating is
    // the lesser failure — the row stays one tall whatever label is passed in later.
    lv_obj_set_height(lb, lv_font_get_line_height(SET_ROW_FONT));

    lv_obj_t *tr = NULL;
    if (trailing && trailing[0]) {
        const lv_font_t *tf = trail_font ? trail_font : SET_ROW_FONT;
        tr = lv_label_create(row);
        lv_obj_set_style_text_font(tr, tf, 0);
        lv_obj_set_style_text_color(tr, trail_col, 0);
        lv_label_set_text(tr, trailing);
        // Align the value's BASELINE with the label's, not its box. Flex centres two labels by box, and a
        // label draws from the top of its own box, so two fonts of different size share a centre but not a
        // baseline — the value floated above the foot of its label, worse the bigger the size gap. Derived
        // rather than eyeballed, so it stays right if either font is swapped:
        //     dy = (Hlabel - Hvalue) / 2 - (base_label - base_value)
        const lv_font_t *lf = SET_ROW_FONT;
        int32_t dy = (lv_font_get_line_height(lf) - lv_font_get_line_height(tf)) / 2
                   - ((int32_t)lf->base_line - (int32_t)tf->base_line);
        if (dy) lv_obj_set_style_translate_y(tr, dy, 0);
    }
    if (out_label) *out_label = tr ? tr : lb;   // whichever half the caller refreshes in place
    if (cb) lv_obj_add_event_cb(row, cb, LV_EVENT_CLICKED, NULL);
    return row;
}

// ── Brightness, on its own screen ───────────────────────────────────────────────────────────────────
// A full-screen overlay on lv_layer_top rather than a new lv_screen, built once then shown and hidden.
// The design keeps the pill HERE and drops it from every list row precisely because this one is dragged.

static int32_t bright_w_from_level(uint8_t level)    // fill width for a level (BRIGHT_MIN→20%, 0xFF→full)
{
    if (level < BRIGHT_MIN) level = BRIGHT_MIN;
    return BRIGHT_FILL_MIN
         + (int32_t)(level - BRIGHT_MIN) * (BRIGHT_BOX_W - BRIGHT_FILL_MIN) / (0xFF - BRIGHT_MIN);
}

static void bright_box_pressing(lv_event_t *e)      // finger moved → track the value and move the fill
{
    (void)e;
    lv_indev_t *indev = lv_indev_active();
    if (!indev || !s_bright_box) return;
    lv_point_t p;
    lv_indev_get_point(indev, &p);
    lv_area_t a;
    lv_obj_get_coords(s_bright_box, &a);
    int32_t w = lv_area_get_width(&a);
    int32_t lo = w / 5;                              // the 20% floor, matching BRIGHT_FILL_MIN
    if (w <= lo) return;
    int32_t rel = p.x - a.x1;
    if (rel < lo) rel = lo;
    else if (rel > w) rel = w;
    s_brightness = (uint8_t)(BRIGHT_MIN + (int32_t)(rel - lo) * (0xFF - BRIGHT_MIN) / (w - lo));
    // Resize only on a REAL change. This fires on every pointer move and each resize invalidates a 427x82
    // rounded rect — the hottest redraw path in the UI. Sub-pixel jitter from a finger otherwise produced
    // repaints that changed nothing on screen.
    if (s_bright_fill && lv_obj_get_width(s_bright_fill) != rel) lv_obj_set_width(s_bright_fill, rel);
}

static void bright_box_press(lv_event_t *e)         // touch down → freeze the swipe, jump to the touch
{
    s_bright_dragging = true;
    // Fully disable the tileview's scroll for the drag. A plain lv_obj does not "hold" the gesture the way
    // lv_slider does, so LVGL walks up and scrolls the tileview — the drag kept flipping projects.
    if (tileview) {
        lv_obj_clear_flag(tileview, LV_OBJ_FLAG_SCROLLABLE);
        lv_obj_set_scroll_dir(tileview, LV_DIR_NONE);
    }
    bright_box_pressing(e);
}

static void bright_box_release(lv_event_t *e)       // let go → restore the swipe, apply once, persist once
{
    (void)e;
    if (!s_bright_dragging) return;
    s_bright_dragging = false;
    if (tileview) {
        lv_obj_set_scroll_dir(tileview, LV_DIR_HOR);
        lv_obj_add_flag(tileview, LV_OBJ_FLAG_SCROLLABLE);
    }
    // Applied on RELEASE only. Driving the panel mid-drag shares the SPI bus with the pixel flush and
    // froze the display once already, so this is the one place that calls apply_dim().
    apply_dim(s_brightness);
    device_prefs_set_brightness(s_brightness);   // once, not per move: NVS is flash
    ESP_LOGI(TAG, "brightness -> 0x%02x", s_brightness);
}

static void brightness_close(lv_event_t *e)
{
    (void)e;
    if (s_bright_screen) lv_obj_add_flag(s_bright_screen, LV_OBJ_FLAG_HIDDEN);
}

static void build_brightness_screen(void)
{
    if (s_bright_screen) return;
    lv_obj_t *ov = lv_obj_create(lv_layer_top());
    s_bright_screen = ov;
    lv_obj_set_size(ov, lv_pct(100), lv_pct(100));
    lv_obj_align(ov, LV_ALIGN_CENTER, 0, 0);
    lv_obj_set_style_bg_color(ov, COL_BG, 0);
    lv_obj_set_style_bg_opa(ov, LV_OPA_COVER, 0);
    lv_obj_set_style_border_width(ov, 0, 0);
    lv_obj_set_style_radius(ov, LV_RADIUS_CIRCLE, 0);
    lv_obj_set_style_pad_all(ov, 0, 0);
    lv_obj_clear_flag(ov, LV_OBJ_FLAG_SCROLLABLE);
    lv_obj_add_flag(ov, LV_OBJ_FLAG_CLICKABLE | LV_OBJ_FLAG_HIDDEN);
    // The design draws no way out of this frame. Tapping the background closes it, the way the other
    // overlays behave; the track sits on top and swallows its own presses, so a drag never closes it.
    lv_obj_add_event_cb(ov, brightness_close, LV_EVENT_CLICKED, NULL);

    lv_obj_t *ttl = lv_label_create(ov);
    // Medium 38, not the Figma's 48, and the reason is measured: this title was the ONLY user of
    // geist_med_48, and pulling that face in cost **684 KB of flash** — a fifth of the whole image, for ten
    // points on one word. The image crosses the cable on every update and OTA time scales with it, so the
    // trade is a slightly smaller heading against a noticeably faster reflash. Medium 38 is already linked
    // by five other screens.
    lv_obj_set_style_text_font(ttl, &geist_med_38, 0);
    lv_obj_set_style_text_color(ttl, COL_FG, 0);
    lv_label_set_text(ttl, "Brightness");
    lv_obj_align(ttl, LV_ALIGN_TOP_MID, 0, 151);   // Figma y — still clears the track at this size

    lv_obj_t *box = lv_obj_create(ov);
    s_bright_box = box;
    lv_obj_remove_style_all(box);
    lv_obj_set_size(box, BRIGHT_BOX_W, 84);
    lv_obj_align(box, LV_ALIGN_TOP_MID, 0, 231);
    lv_obj_set_style_radius(box, 42, 0);
    lv_obj_set_style_bg_color(box, COL_SET_PILL, 0);
    lv_obj_set_style_bg_opa(box, LV_OPA_COVER, 0);
    lv_obj_set_style_border_width(box, 1, 0);
    lv_obj_set_style_border_color(box, COL_SET_BORD, 0);
    lv_obj_clear_flag(box, LV_OBJ_FLAG_SCROLLABLE);
    lv_obj_add_flag(box, LV_OBJ_FLAG_CLICKABLE);   // it IS the drag surface — no separate catcher

    // A plain rounded rect, NOT an lv_bar: a bar allocates a clip layer for a narrow indicator, and that
    // is what froze the device.
    s_bright_fill = lv_obj_create(box);
    lv_obj_remove_style_all(s_bright_fill);
    lv_obj_add_flag(s_bright_fill, LV_OBJ_FLAG_FLOATING);
    lv_obj_clear_flag(s_bright_fill, LV_OBJ_FLAG_CLICKABLE | LV_OBJ_FLAG_SCROLLABLE);
    // 82, not 84: the track carries a 1px border, so LVGL lays this child out in an 82px content box. At
    // 84 the fill overflowed a pixel top and bottom and read as a bar taller than its own track.
    lv_obj_set_height(s_bright_fill, 82);
    lv_obj_set_width(s_bright_fill, bright_w_from_level(s_brightness));
    lv_obj_align(s_bright_fill, LV_ALIGN_LEFT_MID, 0, 0);
    lv_obj_set_style_radius(s_bright_fill, 41, 0);   // matches the 82px height, so the left cap stays round
    lv_obj_set_style_bg_color(s_bright_fill, COL_BRIGHT, 0);
    lv_obj_set_style_bg_opa(s_bright_fill, LV_OPA_COVER, 0);

    lv_obj_t *circ = lv_obj_create(box);
    lv_obj_remove_style_all(circ);
    lv_obj_add_flag(circ, LV_OBJ_FLAG_FLOATING);
    lv_obj_clear_flag(circ, LV_OBJ_FLAG_CLICKABLE | LV_OBJ_FLAG_SCROLLABLE);
    lv_obj_set_size(circ, 72, 72);
    lv_obj_align(circ, LV_ALIGN_LEFT_MID, 6, 0);
    lv_obj_set_style_radius(circ, LV_RADIUS_CIRCLE, 0);
    lv_obj_set_style_bg_color(circ, COL_SET_BG, 0);
    lv_obj_set_style_bg_opa(circ, LV_OPA_COVER, 0);
    lv_obj_t *ic = lv_image_create(circ);
    lv_image_set_src(ic, &icon_brightness);
    lv_obj_center(ic);

    lv_obj_add_event_cb(box, bright_box_press, LV_EVENT_PRESSED, NULL);
    lv_obj_add_event_cb(box, bright_box_pressing, LV_EVENT_PRESSING, NULL);
    lv_obj_add_event_cb(box, bright_box_release, LV_EVENT_RELEASED, NULL);
    lv_obj_add_event_cb(box, bright_box_release, LV_EVENT_PRESS_LOST, NULL);
}

// Settings → Brightness. The fill is re-synced from the cached level because the settings tile is torn
// down and rebuilt often while this overlay is not.
static void settings_brightness_tap(lv_event_t *e)
{
    (void)e;
    build_brightness_screen();
    if (s_bright_fill) lv_obj_set_width(s_bright_fill, bright_w_from_level(s_brightness));
    lv_obj_clear_flag(s_bright_screen, LV_OBJ_FLAG_HIDDEN);
    overlay_raise(s_bright_screen);   // the preview has to be honest on THIS screen especially
}

// (Re)build the trailing Settings tile. Delete-and-recreate keeps its tileview column index correct
// without touching LVGL internals; `update_content_window` puts it at the right column afterwards.
// Caller holds the display lock.
static void rebuild_settings_tile(void)
{
    if (!tileview) return;
    if (s_settings_tile) {
        lv_obj_delete(s_settings_tile);
        s_settings_tile = NULL;
        s_vlang_lbl = NULL;
    }

    lv_obj_t *t = lv_obj_create(tileview);
    lv_obj_set_size(t, carousel_w(), carousel_h());
    lv_obj_set_style_border_width(t, 0, 0);
    lv_obj_set_style_radius(t, 0, 0);
    lv_obj_set_style_bg_color(t, COL_SET_BG, 0);
    s_settings_tile = t;
    lv_obj_set_style_pad_hor(t, SCREEN_PAD, 0);
    lv_obj_set_style_pad_top(t, SET_LIST_PAD, 0);
    lv_obj_set_style_pad_bottom(t, SET_LIST_PAD, 0);
    lv_obj_set_flex_flow(t, LV_FLEX_FLOW_COLUMN);
    // START, not CENTER: centring a list that can overflow fights its own scroll. Three rows do not
    // overflow today, and the alignment is what keeps that true when a fourth arrives.
    lv_obj_set_flex_align(t, LV_FLEX_ALIGN_START, LV_FLEX_ALIGN_CENTER, LV_FLEX_ALIGN_CENTER);
    lv_obj_set_style_pad_row(t, 0, 0);   // the design gives the rows no gap
    lv_obj_set_scroll_dir(t, LV_DIR_VER);   // the tileview owns the horizontal swipe
    lv_obj_set_scrollbar_mode(t, LV_SCROLLBAR_MODE_OFF);

    // Voice — the one row here that CHANGES something outside this screen. Tapping it switches the
    // language every capture is transcribed in, which is why it is worth a row of its own on a page with
    // only three: getting it wrong does not degrade the transcript, it empties it.
    s_vlang_lbl = NULL;
    settings_row(t, &icon_voice, "Voice", COL_FG, vlang_tag(),
                 &geist_reg_24, COL_FG, settings_vlang_tap, &s_vlang_lbl);
    // Passcode — On/Off, and the VALUE is the whole control: tapping it sets a pattern when there is none
    // and asks for the current one to turn it off. Green when on, muted when off, so the state reads at a
    // glance from across the desk rather than needing the word.
    settings_row(t, &icon_lock, "Passcode", COL_FG,
                 device_prefs_lock_enabled() ? "On" : "Off", &geist_reg_24,
                 device_prefs_lock_enabled() ? COL_GREEN : COL_MUTED,
                 settings_passcode_tap, NULL);
    settings_row(t, &icon_brightness, "Brightness", COL_FG, NULL, NULL, COL_FG,
                 settings_brightness_tap, NULL);
    // Version is an ordinary row, deliberately. In the reference it was a FLOATING label anchored to the
    // tile's bottom, which was fine while the tile held exactly four rows and never moved; once the list
    // scrolls, "the bottom of the content area" stops being the bottom of the screen and it landed in the
    // middle of the list looking like a broken row. A row cannot drift.
    const esp_app_desc_t *d = esp_app_get_description();
    char vbuf[24];
    snprintf(vbuf, sizeof(vbuf), "v%s", (d && d->version[0]) ? d->version : "?");
    settings_row(t, &icon_info, "Version", COL_FG, vbuf, &geist_reg_24, COL_MUTED, NULL, NULL);
}

// The two-letter tag the row draws. Vietnamese unless English was chosen, matching the server's own
// default (`pick_lang` returns "en" only when asked for it) so the label and the transcriber agree even
// if the parameter were ever lost between them.
static const char *vlang_tag(void)
{
    return strcmp(s_voice_lang, "en") == 0 ? "EN" : "VI";
}

// Settings → Voice: switch the language, remember it, say so.
static void settings_vlang_tap(lv_event_t *e)
{
    (void)e;
    display_lock();
    snprintf(s_voice_lang, sizeof(s_voice_lang), "%s",
             strcmp(s_voice_lang, "en") == 0 ? "vi" : "en");
    device_prefs_set_voice_lang(s_voice_lang);
    if (s_vlang_lbl) lv_label_set_text(s_vlang_lbl, vlang_tag());
    display_unlock();
    ESP_LOGI(TAG, "voice language -> %s", s_voice_lang);
    audio_notify_done();   // a short beep, so the toggle is felt without looking down at it
}

static void settings_passcode_tap(lv_event_t *e)
{
    (void)e;
    ESP_LOGI(TAG, "settings: passcode");
    ui_lock_setup();
}

const char *ui_voice_lang(void)
{
    return s_voice_lang[0] ? s_voice_lang : "vi";
}

void ui_set_voice_lang(const char *lang)
{
    if (!lang || !lang[0]) return;
    // A PROPOSAL, not an instruction. Once someone has tapped the row their choice is in NVS and stays —
    // otherwise the 15s keepalive `welcome` would quietly undo the tap, over and over, and the row would
    // look like a switch that springs back.
    char stored[sizeof(s_voice_lang)];
    if (device_prefs_voice_lang(stored, sizeof(stored))) return;
    display_lock();
    snprintf(s_voice_lang, sizeof(s_voice_lang), "%s", strcmp(lang, "en") == 0 ? "en" : "vi");
    // Refreshed in place rather than by rebuilding the tile: a rebuild while someone is reading the list
    // resets its scroll, and this arrives on every `welcome`.
    if (s_vlang_lbl) lv_label_set_text(s_vlang_lbl, vlang_tag());
    display_unlock();
}

static void rebuild_overview_tile(void)
{
    if (!s_overview_count_lbl) return;
    if (s_remote_offline_view) {
        if (s_overview_spin) { lv_obj_del(s_overview_spin); s_overview_spin = NULL; }
        // The headline. Plain words about what is true — grid-app is not running — rather than a status
        // term ("Node offline", "Disconnected") that names a thing the person holding this has no model of.
        lv_label_set_text(s_overview_count_lbl, "The app is turned off");
        lv_obj_clear_flag(s_overview_count_lbl, LV_OBJ_FLAG_HIDDEN);
        if (s_overview_offline_hint_lbl) lv_obj_clear_flag(s_overview_offline_hint_lbl, LV_OBJ_FLAG_HIDDEN);
        if (s_overview_offline_cmd_lbl) lv_obj_clear_flag(s_overview_offline_cmd_lbl, LV_OBJ_FLAG_HIDDEN);
    } else if (s_overview_loading) {
        // Agents not loaded yet → show a spinner in place of the (unknown) count; never flash "0 agents".
        lv_obj_add_flag(s_overview_count_lbl, LV_OBJ_FLAG_HIDDEN);
        if (!s_overview_spin) s_overview_spin = make_spinner(s_overview_tile, 56);
        lv_obj_clear_flag(s_overview_spin, LV_OBJ_FLAG_HIDDEN);
    } else {
        if (s_overview_spin) { lv_obj_del(s_overview_spin); s_overview_spin = NULL; }   // stop its timer
        char t[24];
        snprintf(t, sizeof t, s_tile_count == 1 ? "%d chat" : "%d chats", s_tile_count);
        lv_label_set_text(s_overview_count_lbl, t);
        lv_obj_clear_flag(s_overview_count_lbl, LV_OBJ_FLAG_HIDDEN);
    }
    if (!s_remote_offline_view) {
        if (s_overview_offline_hint_lbl) lv_obj_add_flag(s_overview_offline_hint_lbl, LV_OBJ_FLAG_HIDDEN);
        if (s_overview_offline_cmd_lbl) lv_obj_add_flag(s_overview_offline_cmd_lbl, LV_OBJ_FLAG_HIDDEN);
    }
    if (s_overview_machine_lbl)
        lv_label_set_text(s_overview_machine_lbl, s_machine_name[0] ? s_machine_name : "Machine");
    overview_actions_apply();
    overview_working_apply();
}

// Refresh the green "N working" sub-line = how many agents have a turn processing right now (busy_model).
// Hidden while the list is still loading or when nobody is working (no "0 working"). Caller holds the lock.
static void overview_working_apply(void)
{
    if (!s_overview_working_lbl) return;
    int working = 0;
    if (!s_overview_loading && !s_remote_offline_view)
        for (int i = 0; i < s_tile_count; i++) if (s_tiles[i].busy_model) working++;
    if (working > 0) {
        int64_t sec = esp_timer_get_time() / 1000000LL;   // shared clock → verb rotates every 6s (like agent tiles)
        lv_label_set_text_fmt(s_overview_working_lbl, "%d %s\xE2\x80\xA6", working, GERUNDS[(sec / 6) % N_GERUNDS]);
        lv_obj_clear_flag(s_overview_working_lbl, LV_OBJ_FLAG_HIDDEN);
    } else {
        lv_obj_add_flag(s_overview_working_lbl, LV_OBJ_FLAG_HIDDEN);
    }
}

// Rotate the working verb (and keep the count fresh) while the row is visible on the Overview. Runs on the LVGL
// task like the other *_tick timers — no extra lock. Idle on other tiles / when nobody is working.
static void overview_working_tick(lv_timer_t *t)
{
    (void)t;
    if (!s_overview_active || !s_overview_working_lbl || lv_obj_has_flag(s_overview_working_lbl, LV_OBJ_FLAG_HIDDEN)) return;
    overview_working_apply();
}

// Keep the actions visible but disabled during a reconnect, so their location does not jump. During the
// initial agent-list load we hide the whole action row and show only the centered spinner; route voice isn't
// ready then anyway. Caller holds the display lock (or runs on the LVGL task during ui_init).
static void overview_actions_apply(void)
{
    if (!s_overview_actions) return;
    set_hidden(s_overview_actions, s_overview_loading || s_remote_offline_view);
    // A routed voice turn needs at least one project to dispatch to — disable all three when the list is
    // empty, since every one of them would start an utterance with nowhere to go.
    bool ready = s_connected && !s_overview_loading && !s_remote_offline_view && s_tile_count > 0;
    lv_obj_t *btns[] = { s_overview_voice_btn, s_overview_goal_btn, s_overview_loop_btn };
    for (int i = 0; i < 3; i++) {
        if (!btns[i]) continue;
        if (ready) lv_obj_remove_state(btns[i], LV_STATE_DISABLED);
        else       lv_obj_add_state(btns[i], LV_STATE_DISABLED);
    }
    s_ov_ready = ready;
    overview_mod_apply();
}

// LV_STATE_DISABLED does nothing to a label or to the plain objects that draw the target rings, so the
// two modifier pills are dimmed by hand. WITH COLOUR ONLY — lv_obj_set_style_opa() would push these onto
// a temp layer, and that is precisely what hung the LVGL task on this board once already.
static void overview_mod_apply(void)
{
    lv_color_t goal = s_ov_ready ? COL_YELLOW : COL_INK_LOW;
    lv_color_t loop = s_ov_ready ? COL_ACCENT : COL_INK_LOW;
    lv_color_t text = s_ov_ready ? COL_FG     : COL_INK_LOW;
    for (int k = 0; k < 3; k++) {
        if (!s_ov_goal_ico[k]) continue;
        lv_obj_set_style_bg_color(s_ov_goal_ico[k], goal, 0);
        lv_obj_set_style_border_color(s_ov_goal_ico[k], goal, 0);
    }
    if (s_ov_loop_ico) lv_obj_set_style_image_recolor(s_ov_loop_ico, loop, 0);   // an image now, not a glyph
    if (s_ov_goal_lbl) lv_obj_set_style_text_color(s_ov_goal_lbl, text, 0);
    if (s_ov_loop_lbl) lv_obj_set_style_text_color(s_ov_loop_lbl, text, 0);
}

// The three actions. Same guard on each, and it is not decoration: overview_actions_apply() only paints
// the DISABLED look, so without this an empty or disconnected machine would still start a capture that
// has nowhere to go. voice_active() is checked too — the overlay owns the screen mid-capture.
static bool overview_action_ready(void)
{
    return s_connected && !s_overview_loading && !s_remote_offline_view && s_tile_count > 0
           && !voice_active();
}

// The three per-agent actions, arranged on the arc the way the Figma "Recap" frame places them: Goal and
// Loop level at y=339, Voice dropped 35px lower so the row follows the bezel instead of cutting across it.
// 80x80 hit targets with 40px marks, matching the design.
static bool agent_action_ready(void)
{
    return s_connected && !voice_active()
           && s_active_idx >= 0 && s_active_idx < s_tile_count;
}
static void agent_voice_tap(lv_event_t *e) { (void)e; if (agent_action_ready()) voice_start_impl(VOICE_CMD_NONE); }
static void agent_goal_tap (lv_event_t *e) { (void)e; if (agent_action_ready()) voice_start_impl(VOICE_CMD_GOAL); }
static void agent_loop_tap (lv_event_t *e) { (void)e; if (agent_action_ready()) voice_start_impl(VOICE_CMD_LOOP); }

// Visible only on a PROJECT tile — not the Overview, which has its own labelled row — and not while a
// secondary screen is up.
static void agent_actions_apply(void)
{
    if (!s_agent_acts) return;
    bool on = on_project_page() && !s_notif_open && !display_is_asleep()
              && s_active_idx >= 0 && s_active_idx < s_tile_count
              // ...and not while this agent is WORKING: the tile then belongs to the live status row, and
              // all three actions would start a NEW turn on an agent already running one.
              && !s_tiles[s_active_idx].busy_model;
    set_hidden(s_agent_acts, !on);
}

static lv_obj_t *agent_act_btn(int32_t x, int32_t y, lv_event_cb_t cb)
{
    lv_obj_t *b = lv_button_create(s_agent_acts);
    lv_obj_set_size(b, 80, 80);
    lv_obj_set_pos(b, x, y);
    lv_obj_set_style_bg_opa(b, LV_OPA_TRANSP, 0);
    lv_obj_set_style_bg_color(b, COL_FG, LV_STATE_PRESSED);
    lv_obj_set_style_bg_opa(b, LV_OPA_10, LV_STATE_PRESSED);
    lv_obj_set_style_radius(b, LV_RADIUS_CIRCLE, 0);
    lv_obj_set_style_border_width(b, 0, 0);
    lv_obj_set_style_shadow_width(b, 0, 0);
    lv_obj_set_style_pad_all(b, 0, 0);
    lv_obj_clear_flag(b, LV_OBJ_FLAG_SCROLLABLE | LV_OBJ_FLAG_GESTURE_BUBBLE);
    lv_obj_add_event_cb(b, cb, LV_EVENT_CLICKED, NULL);
    return b;
}

static void build_agent_actions(void)
{
    s_agent_acts = lv_obj_create(scr_projects);
    lv_obj_remove_style_all(s_agent_acts);
    lv_obj_set_size(s_agent_acts, 466, 466);
    lv_obj_set_pos(s_agent_acts, 0, 0);
    lv_obj_add_flag(s_agent_acts, LV_OBJ_FLAG_FLOATING | LV_OBJ_FLAG_HIDDEN);
    lv_obj_clear_flag(s_agent_acts, LV_OBJ_FLAG_SCROLLABLE | LV_OBJ_FLAG_CLICKABLE);

    // Each mark carries its OWN colour, straight from the Figma vectors: Goal #f0b429, Voice #00ff2f,
    // Loop #5b8cff — the same three these actions wear on the Overview.
    //
    // Voice and Loop are exported at 40px with the colour already in the pixels, and are drawn at native
    // size with no recolor. That is not a detail: scaling or recolouring an image makes LVGL render it to a
    // temp layer and run transform_and_recolor over it, and doing that on the tile that is on screen most
    // of the time pinned the LVGL task hard enough to trip the task watchdog every 5 seconds. Goal is drawn
    // from plain objects, so it never touches that path.
    //
    // ⚠️ THE THREE Y VALUES BELOW MOVE TOGETHER, and 20px is what was added on 2026-08-18. Two things
    // bound how far down this cluster can go, and only one of them is obvious:
    //
    //   • THE GLASS. The panel is a 466px circle, so the usable radius is 233 from (233,233). The tap
    //     targets are 80px but the MARK is 40px centred in one, and the mark is what has to stay on
    //     glass: at these positions the farthest icon edge sits ~221px out. Another 20px would put it at
    //     ~237 — off the arc. This row has no more room below it.
    //   • THE HOME SWIPE. touch.c treats a gesture STARTING below y=400 as the bottom-edge up-swipe to
    //     Overview, and Voice now sits inside that band. It costs nothing: that rule fires only for an
    //     upward SWIPE (dy < -SWIPE_MIN_PX), and a near-still tap below the line is still a tap.
    //
    // Goal — three rings at the design's 36 / 20 / 9 with a 4px stroke, innermost filled.
    { lv_obj_t *b = agent_act_btn(83, 359, agent_goal_tap);
      lv_obj_t *ring = lv_obj_create(b);
      lv_obj_remove_style_all(ring);
      lv_obj_clear_flag(ring, LV_OBJ_FLAG_CLICKABLE | LV_OBJ_FLAG_SCROLLABLE);
      lv_obj_set_size(ring, 40, 40);
      lv_obj_center(ring);
      const int sz[] = { 36, 20, 9 };
      for (int k = 0; k < 3; k++) {
          lv_obj_t *c = lv_obj_create(ring);
          lv_obj_remove_style_all(c);
          lv_obj_clear_flag(c, LV_OBJ_FLAG_CLICKABLE | LV_OBJ_FLAG_SCROLLABLE);
          lv_obj_set_size(c, sz[k], sz[k]);
          lv_obj_center(c);
          lv_obj_set_style_radius(c, LV_RADIUS_CIRCLE, 0);
          lv_obj_set_style_bg_color(c, COL_YELLOW, 0);
          lv_obj_set_style_bg_opa(c, k == 2 ? LV_OPA_COVER : LV_OPA_TRANSP, 0);
          lv_obj_set_style_border_width(c, k == 2 ? 0 : 4, 0);
          lv_obj_set_style_border_color(c, COL_YELLOW, 0);
      } }
    // Voice — sits 35px lower than its neighbours, per the design's arc.
    { lv_obj_t *b = agent_act_btn(193, 394, agent_voice_tap);
      lv_obj_t *ic = lv_image_create(b);
      lv_image_set_src(ic, &icon_act_voice);      // 40px native, colour baked — see the note on the asset
      lv_obj_center(ic); }
    // Loop — the exported Figma repeat arrows, the same mark the Overview carries.
    { lv_obj_t *b = agent_act_btn(303, 359, agent_loop_tap);
      lv_obj_t *ic = lv_image_create(b);
      lv_image_set_src(ic, &icon_act_loop);       // 40px native, colour baked
      lv_obj_center(ic); }
}

static void overview_voice_tap(lv_event_t *e)
{
    (void)e;
    if (!overview_action_ready()) return;
    ESP_LOGI(TAG, "overview action: Voice");
    voice_start_impl(VOICE_CMD_NONE);
}

static void overview_goal_tap(lv_event_t *e)
{
    (void)e;
    if (!overview_action_ready()) return;
    ESP_LOGI(TAG, "overview action: Goal");
    voice_start_impl(VOICE_CMD_GOAL);
}

// Loop reaches the backend on every engine; the ADAPTER drops it for anything that is not claude (decided
// when /loop was added). The Overview routes to whichever agent the router picks, so the engine is not
// known at press time and the button cannot be gated here — that filter has to stay where it is.
static void overview_loop_tap(lv_event_t *e)
{
    (void)e;
    if (!overview_action_ready()) return;
    ESP_LOGI(TAG, "overview action: Loop");
    voice_start_impl(VOICE_CMD_LOOP);
}

// touch.c calls this on press-down, before its screen-wide recognisers. A press that lands on an action
// button belongs to that button for the whole gesture: without this, the same touch is ALSO a near-still
// tap to touch.c, which opens the detail reader on the very release that starts the recording.
//
// Both rows count — the Overview's labelled pills and the three marks on an agent tile. The agent row went
// uncovered for a while and got away with it only because the tap used to be deferred past the double-tap
// window, by which time the recording had started and the tap was suppressed as a side effect. That
// deferral is gone with the gestures it existed for, so the cover has to be real.
bool ui_action_row_hit(uint16_t x, uint16_t y)
{
    // During a voice turn the buttons are hidden under the overlay and must NOT capture the gesture — else
    // touch.c suppresses tap-to-stop for the whole press (gesture_pressed=false), so a tap to stop the voice
    // does nothing. Let the tap flow to tap-to-stop instead; the clickable overlay blocks the LVGL button click.
    if (voice_active()) return false;
    if (display_is_asleep() || lv_screen_active() != scr_projects) return false;
    lv_point_t p = { .x = x, .y = y };
    // ALL THREE Overview controls. Every one of them must be listed, and missing one is a silent bug — the
    // button still looks right and still lights on press; it just also does something else.
    if (s_overview_active && s_overview_actions && !lv_obj_has_flag(s_overview_actions, LV_OBJ_FLAG_HIDDEN) &&
        ((s_overview_voice_btn && lv_obj_hit_test(s_overview_voice_btn, &p)) ||
         (s_overview_goal_btn  && lv_obj_hit_test(s_overview_goal_btn,  &p)) ||
         (s_overview_loop_btn  && lv_obj_hit_test(s_overview_loop_btn,  &p)))) return true;
    // The agent row is walked rather than listed: its container holds exactly the three buttons
    // agent_act_btn made and nothing else, so a fourth action added later is covered by having been added.
    if (s_agent_acts && !lv_obj_has_flag(s_agent_acts, LV_OBJ_FLAG_HIDDEN)) {
        uint32_t n = lv_obj_get_child_count(s_agent_acts);
        for (uint32_t i = 0; i < n; i++)
            if (lv_obj_hit_test(lv_obj_get_child(s_agent_acts, i), &p)) return true;
    }
    // The notification bell. Claiming it here is not an optimisation — it is the ONLY reason it can be
    // tapped at all: it sits at the very top of the face, inside the band touch.c reads as a pull-down,
    // and a captured press goes to the control instead of to the gesture. Without this the bell would be
    // a button you cannot press, standing in the middle of the swipe that opens the switcher.
    //
    // Not while the drawer is already open, when everything on the screen belongs to it.
    if (!s_notif_open && s_notif_pill && !lv_obj_has_flag(s_notif_pill, LV_OBJ_FLAG_HIDDEN) &&
        lv_obj_hit_test(s_notif_pill, &p)) return true;
    return false;
}

// (Re)build the bottom page-indicator dots (Figma "overview"): one per ring tile (overview + agents + Machine +
// the CURRENTLY-centered one a round green dot (a touch bigger), the rest grey #4C4C4C circles.
// Rebuilt on snap (tile_changed) + on list changes, never per-frame, so it is cheap.
static void rebuild_page_dots(void)
{
    // Page-indicator dots removed per design — keep the container empty + hidden. All callers stay no-ops.
    if (!page_dots) return;
    lv_obj_clean(page_dots);
    lv_obj_add_flag(page_dots, LV_OBJ_FLAG_HIDDEN);
}

// The current voice-language value (shown on the right of the Voice row). Short "EN"/"VI" so it fits
// Apply a brightness level (0x00 dimmest .. 0xFF max). Done purely in software: a black overlay on the
// OLED (black pixels are OFF → real luminance drop). full = transparent, low = up to ~80% black (never
// fully dark). We do NOT send the panel DCS 0x51 — the CO5300 barely honors it, and that SPI command
// shares the bus with the pixel flush; hammering it froze the display. Applied once on drag release,
// so changing the overlay opacity (a full-screen redraw) happens only when the finger lifts.
#define DIM_MAX_OPA 204              // control floor = 20% brightness (80% black overlay), never darker

// Overlay opacity for a brightness level. Map the slider range [BRIGHT_MIN..0xFF] linearly to opacity
// [DIM_MAX_OPA..0]: bottom of the slider = 20% brightness, top = full brightness (no overlay).
static lv_opa_t dim_opa_for_level(uint8_t level)
{
    if (level < BRIGHT_MIN) level = BRIGHT_MIN;
    return (lv_opa_t)(DIM_MAX_OPA * (0xFF - level) / (0xFF - BRIGHT_MIN));
}

static void apply_dim(uint8_t level)
{
    if (!s_dim) return;
    lv_opa_t opa = dim_opa_for_level(level);
    if (lv_obj_get_style_bg_opa(s_dim, 0) != opa) lv_obj_set_style_bg_opa(s_dim, opa, 0);
}

void ui_set_brightness(uint8_t level)
{
    s_brightness = level;
    apply_dim(level);
}

// ---- The model chip ----

// Format a raw model alias for display. Known Claude aliases → Titlecase ("opus"→"Opus"); other slugs are
// split on -/_ into space-joined title-cased words, with a standalone "gpt" word upper-cased ("gpt-5.6-sol"
// → "GPT 5.6 Sol"). Mirrors web formatModelLabel closely enough for the chip + rows.
static void format_model_label(const char *alias, char *out, size_t cap)
{
    if (!alias || !alias[0]) { snprintf(out, cap, "Auto"); return; }
    // An agent launched through an OpenRouter gateway (`ori claude`) reports its model as an OpenRouter
    // id: "anthropic/claude-sonnet-4.6", "~anthropic/claude-opus-latest". The vendor prefix is what the
    // engine mark beside this pill already says, and at this width it is what pushes the version off the
    // tile, so drop it along with OpenRouter's leading '~'. Mirrors web formatModelLabel.
    if (alias[0] == '~') alias++;
    const char *vendor_end = strrchr(alias, '/');
    if (vendor_end && vendor_end[1]) alias = vendor_end + 1;
    static const char *known[] = { "default", "best", "fable", "opus", "sonnet", "haiku" };
    for (size_t k = 0; k < sizeof(known) / sizeof(known[0]); k++) {
        size_t klen = strlen(known[k]);
        if (!strncasecmp(alias, known[k], klen) && (alias[klen] == '\0' || !strcasecmp(alias + klen, "[1m]"))) {
            snprintf(out, cap, "%c%s", (char)toupper((unsigned char)alias[0]), alias + 1);
            return;
        }
    }
    size_t o = 0;
    const char *c = alias;
    while (*c && o + 1 < cap) {
        const char *w = c;
        while (*c && *c != '-' && *c != '_') c++;
        size_t wl = (size_t)(c - w);
        if (o && o + 1 < cap) out[o++] = ' ';
        if (wl == 3 && !strncasecmp(w, "gpt", 3)) {
            if (o + 3 < cap) { out[o++] = 'G'; out[o++] = 'P'; out[o++] = 'T'; }
        } else {
            for (size_t k = 0; k < wl && o + 1 < cap; k++) {
                char ch = w[k];
                if (k == 0 && islower((unsigned char)ch)) ch = (char)toupper((unsigned char)ch);
                out[o++] = ch;
            }
        }
        while (*c == '-' || *c == '_') c++;
    }
    out[o] = '\0';
}

// Format p->model for its chip. Empty (the app omits `model` rather than sending null when absent) → Auto.
static void parse_and_store(tile_t *p)
{
    format_model_label(p->model, p->model_label, sizeof(p->model_label));
}

// The per-agent controls row — [engine mark] [Model] [Effort] — is the FIRST line on the tile and was too
// small to read at arm's length, so the row grew 1.5x (owner, 2026-07-30). The engine mark keeps the full
// 1.5x; the two PILLS were then taken back down ~20% (font 22 → 18) because at 22 they dominated the tile.
// The paddings stay under a true 1.5x on purpose: the round face is ~305px wide at this Y (the row moved
// down with the rest of the tile, which bought some), and wider pills put "Sonnet"+"Medium" past that and
// clipped their corners on the bezel. The GAP is the cheap way to give the row air — it costs 2 gaps, not 6
// pill edges — so spend it there before touching the paddings again.
#define CTL_CHIP_FONT   (&lv_font_montserrat_22)   // 18 → 22: 23 does not exist, and 24 leaves the row
                                                       // ~10px off the round face's chord at this Y
#define CTL_CHIP_PAD_H  11
#define CTL_CHIP_PAD_V  5
#define CTL_CHIP_GAP    13          // between pills (10 → 13: the row sits lower now, so there is room)
#define CTL_MARK_SRC    20          // every engine icon asset is 20x20
#define CTL_NAME_GAP    8           // chip row BOTTOM → agent name top

// Outer height of a pill: text line + its padding + the 1px border on each side.
static inline int32_t ctl_pill_h(void)
{
    return lv_font_get_line_height(CTL_CHIP_FONT) + 2 * CTL_CHIP_PAD_V + 2 /*border*/;
}

// The engine mark is sized to the PILL, not to a fixed zoom (owner, 2026-07-30): the row reads as one band
// only when the icon and the boxes share a height, and a hardcoded zoom drifts the moment the chip font or
// padding changes. Derived, so the three stay locked together.
static inline int32_t ctl_mark_scale(void)
{
    return ctl_pill_h() * 256 / CTL_MARK_SRC;   // 256 = 1:1 in LVGL
}

// The row FLOATS and is aligned by its TOP edge, so its offset has to absorb its own height — scaling the
// pills without this pushes them down onto the name instead of keeping the gap.
static inline int32_t ctl_row_y(void)
{
    return -(ctl_pill_h() + CTL_NAME_GAP);   // the mark matches the pill, so the pill sets the row height
}

// Total vertical band the floating chip row occupies above the name.
static inline int32_t ctl_band_h(void) { return ctl_pill_h() + CTL_NAME_GAP; }


// Is the row actually on screen for this agent? It is hidden on local machines and when the feature is off,
// and the working layout has to reserve its band only when it is really there.
static inline bool ctl_row_shown(tile_t *p)
{
    return p && p->ctl_row && !lv_obj_has_flag(p->ctl_row, LV_OBJ_FLAG_HIDDEN);
}

// The chip row hangs a whole band ABOVE its parent header's own box. Drawing there needs
// LV_OBJ_FLAG_OVERFLOW_VISIBLE, but TAPPING there needs this as well: lv_indev_search_obj only descends
// into a parent's children when the point falls inside the parent's box grown by its ext_draw_size, and
// ext_draw_size is style-derived (shadow/outline) so it would be 0 here. Without this the pills would
// render perfectly and silently stop opening the model/effort pickers. Grows the box on all four sides,
// which is harmless: the only children are the non-clickable name and the row itself, and each still has
// to pass its own hit test.
static void header_ext_draw_cb(lv_event_t *e)
{
    // This number is the reach of everything hanging above the header, and anything further out than it is
    // clipped away — drawn nowhere and tappable nowhere, with no warning. A switcher mark briefly lived a
    // band higher and was invisible for exactly this reason. Add a line above the header and this has to
    // grow with it.
    lv_event_set_ext_draw_size(e, ctl_band_h());
}

// A small glass-pill chip for the per-project controls row (Model / Effort).
//
// NOT clickable, and that is the whole change from the reference. There it opened a Model/Effort picker
// backed by a `models_list` RPC; grid-app has no counterpart, and a chip that responds to a tap by doing
// nothing is worse than one that plainly does not respond. docs/panel-protocol.md carries `model` on the
// project shape and nothing that could change it.
static lv_obj_t *ctl_chip(lv_obj_t *parent)
{
    lv_obj_t *c = lv_label_create(parent);
    lv_obj_set_style_text_font(c, CTL_CHIP_FONT, 0);
    lv_obj_set_style_text_color(c, COL_FG, 0);
    lv_obj_set_style_bg_color(c, lv_color_hex(0x1c1e24), 0);
    lv_obj_set_style_bg_opa(c, LV_OPA_70, 0);
    lv_obj_set_style_radius(c, LV_RADIUS_CIRCLE, 0);
    lv_obj_set_style_border_width(c, 1, 0);
    lv_obj_set_style_border_color(c, lv_color_hex(0x3a3f4b), 0);
    lv_obj_set_style_pad_hor(c, CTL_CHIP_PAD_H, 0);
    lv_obj_set_style_pad_ver(c, CTL_CHIP_PAD_V, 0);
    return c;
}

// Paint the Model chip from p->model_label (empty alias = "Auto", muted).
// Long names overflow the round face: the chip row must fit inside the chord at its Y, and Command Code
// and Devin carry names like "Deepseek V4 Flash" or "Nemotron 3 Ultra 550b A55b". Clip hard — no ellipsis,
// which only ate a glyph's worth of the room it was meant to save. Counted in CODEPOINTS, not bytes, so a
// multi-byte name is never cut mid-character into a garbage glyph. The picker still lists full names.
#define MODEL_CHIP_MAX_CHARS  11
#define EFFORT_CHIP_MAX_CHARS 6
static void chip_clip(const char *src, char *out, size_t cap, size_t max_glyphs)
{
    if (!out || cap == 0) return;
    out[0] = '\0';
    if (!src) return;
    size_t glyphs = 0, i = 0;
    while (src[i] && glyphs < max_glyphs) {
        size_t len = 1;
        unsigned char c = (unsigned char)src[i];
        if      ((c & 0xE0) == 0xC0) len = 2;
        else if ((c & 0xF0) == 0xE0) len = 3;
        else if ((c & 0xF8) == 0xF0) len = 4;
        for (size_t k = 1; k < len; k++) if (!src[i + k]) { len = k; break; }   // truncated input
        i += len;
        glyphs++;
    }
    size_t keep = i < cap - 1 ? i : cap - 1;
    memcpy(out, src, keep);
    out[keep] = '\0';
}

static void model_chip_paint(tile_t *p)
{
    if (!p || !p->model_lbl) return;
    bool has = p->model[0] != '\0';
    char label[48];
    chip_clip(p->model_label, label, sizeof(label), MODEL_CHIP_MAX_CHARS);
    lv_label_set_text(p->model_lbl, has ? label : "Auto");
    lv_obj_set_style_text_color(p->model_lbl, has ? COL_FG : COL_MUTED, 0);
    lv_obj_set_style_border_color(p->model_lbl, has ? COL_ACCENT : COL_MUTED, 0);
}

// Paint the Effort chip — A LITERAL "Auto", always, and it is worth saying why rather than deleting it.
//
// Nothing on this wire carries an effort. The reference parsed one out of its runtime-v1 profile and a tap
// opened a picker backed by a `models_list` RPC that grid-app has no counterpart for. The chip stays
// because the row is the tile's identity line — engine mark, model, effort — and a two-chip row reads as a
// row with something missing. It is drawn muted, like every other value this panel reports but cannot
// change, and it does nothing when tapped because there is nothing it could do.
static void effort_chip_paint(tile_t *p)
{
    if (!p || !p->effort_lbl) return;
    if (!p->model[0]) {                 // nothing known about the runtime at all → don't claim "Auto"
        lv_obj_add_flag(p->effort_lbl, LV_OBJ_FLAG_HIDDEN);
        return;
    }
    lv_obj_clear_flag(p->effort_lbl, LV_OBJ_FLAG_HIDDEN);
    lv_label_set_text(p->effort_lbl, "Auto");
    lv_obj_set_style_text_color(p->effort_lbl, COL_MUTED, 0);
    lv_obj_set_style_border_color(p->effort_lbl, COL_MUTED, 0);
}

// Show/hide the "Creating…" loading spinner (project create is an HTTP round-trip). Safe from any task.
void ui_set_creating(bool on)
{
    display_lock();
    if (s_creating_spin) {
        if (on) {
            lv_obj_clear_flag(s_creating_spin, LV_OBJ_FLAG_HIDDEN);
            lv_obj_move_foreground(s_creating_spin);
        } else {
            lv_obj_add_flag(s_creating_spin, LV_OBJ_FLAG_HIDDEN);
        }
    }
    display_unlock();
}


// Find a project by id, or -1.
static int find_proj(const char *id)
{
    for (int i = 0; i < s_tile_count; i++)
        if (strcmp(s_tiles[i].id, id) == 0) return i;
    return -1;
}

// ---- lazy content windowing ----
// Only the active tile ± CONTENT_WINDOW keep a materialized CONTENT subtree (body/list/card/busy/…);
// every other project keeps just its thin shell (tile/hdr/dot/name). This bounds the LVGL 64KB pool
// regardless of how many projects exist. The per-project model (m_preview/m_full/m_col/busy_model)
// lets an off-window tile be rebuilt on entry and lets live events (keyed by id) update state without
// touching LVGL until the tile is on-screen.
#define CONTENT_WINDOW 1

// Duplicate into PSRAM so project/event strings never crowd the internal heap.
// Returns NULL for empty input or PSRAM OOM; callers retain the previous model on OOM.
static char *dup_str(const char *s)
{
    if (!s || !s[0]) return NULL;
    return ram_psram_strdup(s, "ui_event_text");
}

// Build the single event-card label into p->list (shared by ui_tile_emit's live path and by
// materialize_content). `full` may be NULL (model had only a preview) — the reader then shows preview.
static void render_event_card(tile_t *p, const char *preview, const char *full, lv_color_t col)
{
    if (!p->list || !preview) return;
    char *reader_text = dup_str(full ? full : preview);
    if (!reader_text) return;
    if (p->empty) { lv_obj_delete(p->empty); p->empty = NULL; }
    // Recap card — flat dark "glassy" card (the gradient version merged into the black bg and looked bad, so
    // back to the old solid style), white text (the `col` keeps error/summary tinting), 32px, centred + wrapped.
    lv_obj_t *card = lv_obj_create(p->list);
    lv_obj_remove_style_all(card);
    lv_obj_clear_flag(card, LV_OBJ_FLAG_CLICKABLE | LV_OBJ_FLAG_SCROLLABLE);
    lv_obj_set_width(card, lv_pct(100));
    lv_obj_set_height(card, LV_SIZE_CONTENT);
    lv_obj_set_style_bg_color(card, lv_color_hex(0x23252f), 0);
    lv_obj_set_style_bg_opa(card, LV_OPA_COVER, 0);
    lv_obj_set_style_radius(card, 28, 0);
    lv_obj_set_style_pad_hor(card, 18, 0);
    lv_obj_set_style_pad_ver(card, 18, 0);
    lv_obj_set_style_border_width(card, 1, 0);
    lv_obj_set_style_border_color(card, lv_color_hex(0xa6a6a6), 0);
    lv_obj_set_style_border_opa(card, LV_OPA_20, 0);
    lv_obj_t *l = lv_label_create(card);
    lv_label_set_text(l, preview);
    lv_label_set_long_mode(l, LV_LABEL_LONG_WRAP);
    lv_obj_set_width(l, lv_pct(100));
    lv_obj_set_style_text_font(l, &geist_med_28, 0);   // recap body — trying Medium 28
    lv_obj_set_style_text_color(l, col, 0);
    lv_obj_set_style_text_align(l, LV_TEXT_ALIGN_CENTER, 0);
    lv_obj_set_style_text_line_space(l, 3, 0);
    lv_obj_set_user_data(card, reader_text);   // ev_card_free frees this
    lv_obj_add_event_cb(card, ev_card_free, LV_EVENT_DELETE, NULL);   // reader now opens via swipe-up, not a card tap
}

// Build the Figma "working" status into p->body from the model. A centred block: a green "<verb> <elapsed>"
// line + a grey teaser (last recap). No spinning sparkle — the green LED ring is the loading indicator now.
// Also recentres the whole tile ([name][busy]) vertically for this state (clear_busy restores the recap layout).
static void render_busy_row(tile_t *p)
{
    if (!p->body || p->busy) return;
    // Centre the [name + busy] group vertically for the working screen (recap keeps top-anchored name).
    if (p->tile) {
        lv_obj_set_flex_align(p->tile, LV_FLEX_ALIGN_CENTER, LV_FLEX_ALIGN_CENTER, LV_FLEX_ALIGN_CENTER);
        // Reserve the chip band. The row floats above the name, so flex does NOT count it when centring:
        // at a 0 top pad the visible block ([chips][name][status]) would sit half a band low, and a tall
        // turn (tool line + todo) could push the row clean off the top edge. Padding by exactly the band
        // makes flex centre the remainder, which lands the block — chips included — on the centre line.
        lv_obj_set_style_pad_top(p->tile, ctl_row_shown(p) ? ctl_band_h() : 0, 0);
        // The 14px engine subtitle is inside the header. Zero outer gap grows the centred busy group by
        // only the few pixels the old 8px name→body gap did not already reserve.
        lv_obj_set_style_pad_row(p->tile, 0, 0);
    }
    p->busy = lv_obj_create(p->body);
    lv_obj_remove_style_all(p->busy);
    lv_obj_clear_flag(p->busy, LV_OBJ_FLAG_CLICKABLE | LV_OBJ_FLAG_SCROLLABLE);
    lv_obj_set_width(p->busy, lv_pct(100));
    lv_obj_set_height(p->busy, LV_SIZE_CONTENT);
    lv_obj_set_flex_flow(p->busy, LV_FLEX_FLOW_COLUMN);
    lv_obj_set_flex_align(p->busy, LV_FLEX_ALIGN_CENTER, LV_FLEX_ALIGN_CENTER, LV_FLEX_ALIGN_CENTER);
    lv_obj_set_style_pad_row(p->busy, 4, 0);            // Figma verb→teaser gap
    p->busy_icon = NULL;                                 // no sparkle — the LED ring is the loading cue
    p->busy_verb = lv_label_create(p->busy);            // "<verb> <elapsed>" (green, one line)
    lv_obj_set_style_text_font(p->busy_verb, &geist_med_32, 0);
    lv_obj_set_style_text_color(p->busy_verb, COL_VOICE, 0);   // Figma #00ff2f
    p->busy_meta = NULL;   // no stale-recap teaser here; live activity shows via tool_line
    busy_compose(p);
}

// Agent-tile vertical rhythm. Set in TWO places (build + the restore after a busy turn), so keep it here:
// a mismatch shows up as the tile shifting after every turn.
//
// ONE number moves the whole block — the chip row, the agent name, the project subtitle and the recap card
// below them. The chip row looks independent and is not: ctl_row_y() anchors it to the HEADER, so it rides
// whatever this value does. Tuned on the real panel rather than from the Figma: 84 -> 89 -> 94 -> 99 -> 117
// while the top was crowded and the bottom had dead space, then back to 112 on 2026-08-18 once the action
// icons moved down 20px and the block wanted to sit higher against them.
//
// The floor is the notification pull-zone: touch.c owns y < 44 for the drawer, and the chip row starts at
// this value minus the chip band (~40), so much under ~90 and the chips stop being tappable.
#define TILE_PAD_TOP    112         // was 117 (Figma recap: name ~top84, card ~top157)
#define TILE_NAME_GAP   27          // name → recap card, minus the engine line the header adds

// Create the empty tile container for an agent (UNpositioned — update_content_window places it at its
// current ring column). Called by materialize_content on window entry; free_content deletes the whole tile
// on exit, so a far-off agent holds ZERO LVGL objects (the spacer reserves the whole virtual scroll range).
static void create_tile(tile_t *p)
{
    if (p->tile) return;
    p->tile = lv_obj_create(tileview);
    lv_obj_set_size(p->tile, carousel_w(), carousel_h());
    lv_obj_set_style_border_width(p->tile, 0, 0);
    lv_obj_set_style_radius(p->tile, 0, 0);
    lv_obj_set_style_bg_color(p->tile, COL_BG, 0);
    lv_obj_set_style_pad_all(p->tile, SCREEN_PAD, 0);
    lv_obj_set_flex_flow(p->tile, LV_FLEX_FLOW_COLUMN);
    lv_obj_set_flex_align(p->tile, LV_FLEX_ALIGN_START, LV_FLEX_ALIGN_CENTER, LV_FLEX_ALIGN_CENTER);
    lv_obj_set_style_pad_top(p->tile, TILE_PAD_TOP, 0);
    // Header adds one engine line. Subtract it from the name→body gap so the recap card keeps the same Y
    // position as before this subtitle existed.
    int32_t engine_h = lv_font_get_line_height(&lv_font_montserrat_14);
    lv_obj_set_style_pad_row(p->tile, LV_MAX(0, TILE_NAME_GAP - engine_h), 0);
    lv_obj_clear_flag(p->tile, LV_OBJ_FLAG_SCROLLABLE);
}

// Build the header shell (large centred agent name + small engine subtitle, no status pill/dot) into p->tile.
// Windowed with the content: a far-off agent has no tile at all. Both labels read from the model so they
// rebuild correctly after free_content deletes the tile outside the active window.
// Engine badge = product mark. Claude is a recolored monochrome mask; other marks retain the exact
// colors from the same vendored assets used by the web app.
static void apply_engine_label(tile_t *p)
{
    if (!p->engine_lbl || !p->engine_text_lbl) return;
    const lv_image_dsc_t *src = NULL;
    bool recolor = false;
    if (!strcmp(p->engine, "claude"))      { src = &icon_claude; recolor = true; }
    else if (!strcmp(p->engine, "codex"))  { src = &icon_codex; }
    else if (!strcmp(p->engine, "cursor")) { src = &icon_cursor; }
    else if (!strcmp(p->engine, "opencode")) { src = &icon_opencode; }
    else if (!strcmp(p->engine, "pi"))      { src = &icon_pi; }
    else if (!strcmp(p->engine, "hermes"))  { src = &icon_hermes; }
    else if (!strcmp(p->engine, "commandcode")) { src = &icon_commandcode; }
    else if (!strcmp(p->engine, "devin")) { src = &icon_devin; }
    else if (!strcmp(p->engine, "muse")) { src = &icon_muse; }
    else if (!strcmp(p->engine, "amp")) { src = &icon_amp; }
    else if (!strcmp(p->engine, "kilo")) { src = &icon_kilo; }
    else if (!strcmp(p->engine, "grok")) { src = &icon_grok; }
    lv_obj_add_flag(p->engine_text_lbl, LV_OBJ_FLAG_HIDDEN);   // product-mark path only
    if (src) {
        lv_image_set_src(p->engine_lbl, src);
        // Box = exactly one pill, artwork CENTRED inside it. Sizing the box to the zoomed bitmap instead
        // left it a pixel or two off the pills (integer rounding in the scale), and the row's flex centring
        // then split that difference — the mark read as sitting high next to the boxes. Pinning the box to
        // the pill height makes the row one band by construction, whatever the font or padding become.
        lv_image_set_inner_align(p->engine_lbl, LV_IMAGE_ALIGN_CENTER);
        lv_image_set_pivot(p->engine_lbl, (int32_t)src->header.w / 2, (int32_t)src->header.h / 2);
        lv_image_set_scale(p->engine_lbl, (uint32_t)ctl_mark_scale());
        lv_obj_set_size(p->engine_lbl, ctl_pill_h(), ctl_pill_h());
        lv_obj_set_style_image_recolor(p->engine_lbl, COL_CLAUDE, 0);
        // Reset this on every engine change: the same LVGL image object may previously have shown Claude.
        lv_obj_set_style_image_recolor_opa(p->engine_lbl, recolor ? LV_OPA_COVER : LV_OPA_TRANSP, 0);
        lv_obj_clear_flag(p->engine_lbl, LV_OBJ_FLAG_HIDDEN);
    } else {
        lv_obj_add_flag(p->engine_lbl, LV_OBJ_FLAG_HIDDEN);
    }
}

static void build_shell(tile_t *p)
{
    if (!p->tile || p->header) return;      // no tile, or shell already built
    p->dot = NULL;                          // recap design drops the status dot (its only reader is guarded)

    // Keep name + engine as ONE top-level tile child. The engine line consumes space from the old 24px
    // name→body gap, so adding it does not push the recap card down or affect the round-screen margins.
    p->header = lv_obj_create(p->tile);
    lv_obj_remove_style_all(p->header);
    lv_obj_clear_flag(p->header, LV_OBJ_FLAG_CLICKABLE | LV_OBJ_FLAG_SCROLLABLE);
    // Title + subtitle. Sized for both lines so the body below keeps the geometry it had when the header
    // was one line: growing the header rather than overlaying the subtitle is what stops the recap card
    // from being pushed into the round screen's bottom margin.
    lv_obj_set_size(p->header, SAFE_CONTENT_W,
                    lv_font_get_line_height(&geist_med_38) + lv_font_get_line_height(&geist_reg_20));
    lv_obj_set_flex_flow(p->header, LV_FLEX_FLOW_COLUMN);
    lv_obj_set_flex_align(p->header, LV_FLEX_ALIGN_START, LV_FLEX_ALIGN_CENTER, LV_FLEX_ALIGN_CENTER);
    lv_obj_set_style_pad_row(p->header, 0, 0);

    p->name_lbl = lv_label_create(p->header);
    lv_obj_set_style_text_color(p->name_lbl, COL_FG, 0);
    lv_obj_set_style_text_font(p->name_lbl, &geist_med_38, 0);   // agent name — Medium for emphasis
    lv_obj_set_size(p->name_lbl, SAFE_CONTENT_W, lv_font_get_line_height(&geist_med_38));
    lv_obj_set_style_text_align(p->name_lbl, LV_TEXT_ALIGN_CENTER, 0);
    lv_label_set_long_mode(p->name_lbl, LV_LABEL_LONG_DOT);
    lv_label_set_text(p->name_lbl, p->name[0] ? p->name : "\xE2\x80\xA6");  // chat title, or "…" placeholder

    // The project, under the title and quieter than it. A tile is one conversation now, and several of a
    // project's chats sit next to each other on the carousel — without this they are a row of titles with
    // nothing saying which folder any of them works in.
    p->project_lbl = lv_label_create(p->header);
    lv_obj_set_style_text_color(p->project_lbl, COL_MUTED, 0);
    lv_obj_set_style_text_font(p->project_lbl, &geist_reg_20, 0);
    lv_obj_set_size(p->project_lbl, SAFE_CONTENT_W, lv_font_get_line_height(&geist_reg_20));
    lv_obj_set_style_text_align(p->project_lbl, LV_TEXT_ALIGN_CENTER, 0);
    lv_label_set_long_mode(p->project_lbl, LV_LABEL_LONG_DOT);
    lv_label_set_text(p->project_lbl, p->project);
    if (!p->project[0]) lv_obj_add_flag(p->project_lbl, LV_OBJ_FLAG_HIDDEN);

    // Per-agent controls row FLOATING in the band ABOVE the name: [Engine] [Model] [Effort] pills, one style.
    // Remote machines only; a tap opens the model/effort picker. The notif pull-down zone was narrowed to
    // y<44 (touch.c) so taps here still reach LVGL.
    //
    // Parented to the HEADER, not the tile, so it tracks the name. A FLOATING child is positioned at
    // parent->coords.y1 + parent's top pad + offset, so hanging it off the tile pinned it to the tile's
    // pad_top — which the working state sets to 0, throwing the row ~48px off the top of the screen. The
    // header has no padding and flex moves it in both states, so anchoring here lands the row exactly one
    // CTL_NAME_GAP above the name whatever the state. Idle is unchanged: the row still sits at
    // TILE_PAD_TOP - (pill + gap). Only IN-parent aligns survive a re-layout (lv_obj_pos.c falls through
    // to `default:` for every LV_ALIGN_OUT_*), so this must stay TOP_MID with a negative offset.
    lv_obj_add_flag(p->header, LV_OBJ_FLAG_OVERFLOW_VISIBLE);   // the row hangs above the header's box
    lv_obj_add_event_cb(p->header, header_ext_draw_cb, LV_EVENT_REFR_EXT_DRAW_SIZE, NULL);  // …and stays tappable
    lv_obj_t *ctl = lv_obj_create(p->header);
    lv_obj_remove_style_all(ctl);
    lv_obj_set_size(ctl, LV_SIZE_CONTENT, LV_SIZE_CONTENT);
    lv_obj_set_flex_flow(ctl, LV_FLEX_FLOW_ROW);
    lv_obj_set_flex_align(ctl, LV_FLEX_ALIGN_CENTER, LV_FLEX_ALIGN_CENTER, LV_FLEX_ALIGN_CENTER);
    lv_obj_set_style_pad_column(ctl, CTL_CHIP_GAP, 0);
    lv_obj_clear_flag(ctl, LV_OBJ_FLAG_SCROLLABLE);
    lv_obj_add_flag(ctl, LV_OBJ_FLAG_FLOATING);
    lv_obj_align(ctl, LV_ALIGN_TOP_MID, 0, ctl_row_y());
    p->engine_lbl = lv_image_create(ctl);            // engine product mark
    p->engine_text_lbl = lv_label_create(ctl);       // retained as a hidden compatibility fallback
    lv_obj_set_size(p->engine_text_lbl, ctl_pill_h(), ctl_pill_h());   // fallback badge matches the pills too
    lv_obj_set_style_text_font(p->engine_text_lbl, CTL_CHIP_FONT, 0);
    lv_obj_set_style_text_align(p->engine_text_lbl, LV_TEXT_ALIGN_CENTER, 0);
    p->model_lbl  = ctl_chip(ctl);   // the model grid-app reported
    p->effort_lbl = ctl_chip(ctl);   // a literal "Auto" — nothing on the wire carries an effort
    apply_engine_label(p);
    model_chip_paint(p);
    effort_chip_paint(p);
    p->ctl_row = ctl;

    // ALWAYS SHOWN. The reference gated this row on the machine being a REMOTE (adapter) one, because that
    // is where its runtime model/effort profile applied. There is one machine here and no profile, and
    // `agent` + `model` come with every project (docs/panel-protocol.md, the project shape), so the gate
    // has nothing left to decide.
}

// Build the content subtree (body + list + card/empty + optional busy row) from the model. No-op if
// already live. tool_line/agents/todo are NOT rebuilt — they stream from the next live event.
static void materialize_content(int i)
{
    tile_t *p = &s_tiles[i];
    if (p->content_live) return;
    // Voice mode: the overlay is up and we deliberately keep ALL content freed so the PCM upload has
    // internal-RAM headroom. Don't let a swipe / live event re-materialize it mid-upload — it rebuilds
    // when voice_overlay_set(false) hides the overlay and calls update_content_window.
    if (s_voice_overlay && !lv_obj_has_flag(s_voice_overlay, LV_OBJ_FLAG_HIDDEN)) return;

    if (!p->tile) create_tile(p);      // windowed: build the empty tile on entry (positioned by update_content_window)
    if (!p->tile) return;              // pool exhausted → skip (extremely unlikely with the window bounded)
    build_shell(p);   // header first (child 0), so it stays pinned above the body in the flex column

    p->body = lv_obj_create(p->tile);
    lv_obj_remove_style_all(p->body);
    lv_obj_set_width(p->body, SAFE_CONTENT_W);
    lv_obj_set_height(p->body, LV_SIZE_CONTENT);
    lv_obj_set_flex_flow(p->body, LV_FLEX_FLOW_COLUMN);
    lv_obj_set_flex_align(p->body, LV_FLEX_ALIGN_START, LV_FLEX_ALIGN_CENTER, LV_FLEX_ALIGN_CENTER);
    lv_obj_set_style_pad_row(p->body, 12, 0);
    lv_obj_clear_flag(p->body, LV_OBJ_FLAG_SCROLLABLE);

    p->list = lv_obj_create(p->body);
    lv_obj_remove_style_all(p->list);
    lv_obj_set_width(p->list, lv_pct(100));
    lv_obj_set_height(p->list, LV_SIZE_CONTENT);
    lv_obj_set_flex_flow(p->list, LV_FLEX_FLOW_COLUMN);
    lv_obj_set_flex_align(p->list, LV_FLEX_ALIGN_CENTER, LV_FLEX_ALIGN_CENTER, LV_FLEX_ALIGN_CENTER);
    lv_obj_set_style_pad_row(p->list, 14, 0);
    lv_obj_clear_flag(p->list, LV_OBJ_FLAG_SCROLLABLE);

    if (p->m_preview) render_event_card(p, p->m_preview, p->m_full, p->m_col);
    else p->empty = make_label(p->list, "No activity yet", lv_color_hex(0x585863), &geist_reg_38);

    if (p->busy_model) {                         // a turn is processing → show the Working… row, hide card
        lv_obj_add_flag(p->list, LV_OBJ_FLAG_HIDDEN);
        render_busy_row(p);
    }
    p->content_live = true;
}

// Tear down the content subtree (frees the whole body subtree incl. the event card, whose DELETE cb
// frees its stashed full text). The model (m_preview/m_full/busy_model) is preserved for re-entry.
static void free_content(int i)
{
    tile_t *p = &s_tiles[i];
    if (!p->content_live) return;
    if (p->tile) { lv_obj_delete(p->tile); p->tile = NULL; }   // delete the WHOLE tile → 0 objects for a far agent
    p->body = p->list = p->empty = NULL;
    p->busy = p->busy_verb = p->busy_meta = p->busy_icon = NULL;
    p->tool_line = p->agents = p->todo = p->todo_active = NULL;
    p->project_lbl = NULL;
    p->dot = p->header = p->name_lbl = p->engine_lbl = p->engine_text_lbl = p->model_lbl = p->effort_lbl = NULL;
    p->ctl_row = NULL;
    p->content_live = false;
}

// Instrumentation (gated off): log LVGL's 64KB pool usage on every window change. Verified free bytes stay
// flat while swiping — materialize/free bounded, no leak. Flip to 1 to re-check pool health.
#define LAZY_MEM_DEBUG 0

// Position + materialize the ~CONTENT_WINDOW columns around the centered column; free everything outside.
// Columns map CIRCULARLY to ring positions (ring_of_col): ring 0 = the Overview, ring r>0 = project[r-1]. Each
// window column gets the right tile placed at col*W. An agent whose column left the window is freed → 0
// objects. Idempotent + cheap — call after any scroll settle / add / remove. Caller holds the lock.
static void update_content_window(void)
{
    int32_t w = carousel_w();
    int cc = carousel_col();

    // 1. Free every agent that no longer belongs in the window: its column drifted out (|tile_col-cc|), OR
    //    the ring at its column no longer maps to it (N changed → the modulo remapped that column to a
    //    different agent). Without the ring check, adding agents (which shifts N+1) would pile stale tiles
    //    at the same columns and leak the pool.
    for (int i = 0; i < s_tile_count; i++) {
        if (s_tiles[i].content_live) {
            int d = s_tiles[i].tile_col - cc; if (d < 0) d = -d;
            if (d > CONTENT_WINDOW || ring_of_col(s_tiles[i].tile_col) != ring_of_agent(i)) free_content(i);
        }
    }

    // 2. Materialize + position the right tile for each window column. A fixed tile (Overview/No-projects) can map
    //    to MULTIPLE window columns when there are few agents (tiny ring); pick the column CLOSEST to centre
    //    so it's never shoved off-screen.
    bool noagents_shown = false, overview_shown = false, settings_shown = false;
    int noagents_col = cc, noagents_best = CONTENT_WINDOW + 1;
    int overview_col = cc, overview_best = CONTENT_WINDOW + 1;
    int settings_col = cc, settings_best = CONTENT_WINDOW + 1;
    for (int dc = -CONTENT_WINDOW; dc <= CONTENT_WINDOW; dc++) {
        int col = cc + dc;
        int r = ring_of_col(col);
        int ad = dc < 0 ? -dc : dc;
        if (r == 0) {                                   // overview page (leading, ring 0)
            if (ad < overview_best) { overview_best = ad; overview_col = col; }
            overview_shown = true;
        } else if (r == ring_settings()) {              // the trailing Settings tile
            // Checked BEFORE the two below: its ring is neither 0 nor a project, and the project branch
            // would read it as an index past the end.
            if (ad < settings_best) { settings_best = ad; settings_col = col; }
            settings_shown = true;
        } else if (s_tile_count == 0) {                 // no projects → ring RING_LEAD is the "No projects" page
            if (ad < noagents_best) { noagents_best = ad; noagents_col = col; }
            noagents_shown = true;
        } else {                                        // project at this column
            int ai = agent_of_ring(r);
            if (ai >= 0 && ai < s_tile_count) {
                tile_t *p = &s_tiles[ai];
                if (!p->content_live) materialize_content(ai);
                if (p->tile) { lv_obj_set_x(p->tile, col * w); p->tile_col = col; }
            }
        }
    }
    // No-projects tile: shown at the centre-most ring-RING_LEAD column when the list is empty, else hidden.
    if (noagents_shown && s_no_agents_tile) {
        lv_obj_set_x(s_no_agents_tile, noagents_col * w);
        lv_obj_clear_flag(s_no_agents_tile, LV_OBJ_FLAG_HIDDEN);
    } else if (s_no_agents_tile) {
        lv_obj_add_flag(s_no_agents_tile, LV_OBJ_FLAG_HIDDEN);
    }
    // Overview tile (leading ring 0): symmetric to the other persistent fixed tiles.
    if (overview_shown && s_overview_tile) {
        lv_obj_set_x(s_overview_tile, overview_col * w);
        lv_obj_clear_flag(s_overview_tile, LV_OBJ_FLAG_HIDDEN);
    } else if (s_overview_tile) {
        lv_obj_add_flag(s_overview_tile, LV_OBJ_FLAG_HIDDEN);
    }
    // Settings tile (trailing): the same shape again.
    if (settings_shown && s_settings_tile) {
        lv_obj_set_x(s_settings_tile, settings_col * w);
        lv_obj_clear_flag(s_settings_tile, LV_OBJ_FLAG_HIDDEN);
    } else if (s_settings_tile) {
        lv_obj_add_flag(s_settings_tile, LV_OBJ_FLAG_HIDDEN);
    }

#if LAZY_MEM_DEBUG
    int live = 0;
    for (int i = 0; i < s_tile_count; i++) if (s_tiles[i].content_live) live++;
    lv_mem_monitor_t mon; lv_mem_monitor(&mon);
    ESP_LOGI(TAG, "lvmem free=%u biggest=%u used=%d%% frag=%d%% | projects=%d live=%d cc=%d ring=%d",
             (unsigned)mon.free_size, (unsigned)mon.free_biggest_size, (int)mon.used_pct,
             (int)mon.frag_pct, s_tile_count, live, cc, ring_of_col(cc));
#endif
}

// Small-ring smoothing — ONLY the 1-agent ring (ring_len == 2). With a single agent the ring has just two
// positions (0 = the Overview, 1 = the project), so BOTH window neighbours of any tile map to the SAME entity, but
// each entity owns one physical tile → one side stays blank until SCROLL_END rebuilds it. That blank-then-
// pop is the stutter when swiping off the Overview. Fix WITHOUT breaking the infinite ring and WITHOUT
// duplicating tiles: on every scroll frame, pin each of the (at most) two columns overlapping the viewport
// to its ring entity's single tile. The two visible columns are ADJACENT → opposite parity → always
// DIFFERENT entities (one Overview, one project), so the two single tiles never contend, and the tile a drag
// moves away from is 2 columns off (off-screen) at the moment it's relocated → the move is invisible.
// Also covers N==0 (ring_len 2: the Overview + the "No projects" page). N>=2 (ring_len>=3 already fills the
// ±CONTENT_WINDOW window with distinct tiles) is untouched.
static void carousel_cover_leading(void)
{
    if (ring_len() != 2) return;                     // the 1-agent AND empty rings collide in the window
    int32_t w = carousel_w();
    if (w <= 0) return;
    int32_t sx = lv_obj_get_scroll_x(tileview);
    int c0 = (int)(sx / w);                           // left visible column (sx is deep-positive mid-ring)
    for (int col = c0; col <= c0 + 1; col++) {        // the up-to-two columns overlapping the viewport
        int r = ring_of_col(col);
        if (r == 0) {                                 // Overview page (ring 0)
            if (s_overview_tile) {
                lv_obj_set_x(s_overview_tile, col * w);
                lv_obj_clear_flag(s_overview_tile, LV_OBJ_FLAG_HIDDEN);
            }
        } else if (s_tile_count == 0) {               // no projects → ring 1 is the "No projects" page
            if (s_no_agents_tile) {
                lv_obj_set_x(s_no_agents_tile, col * w);
                lv_obj_clear_flag(s_no_agents_tile, LV_OBJ_FLAG_HIDDEN);
            }
        } else {                                      // agent r-1 (kept materialized as a neighbour when N==1)
            int ai = r - 1;
            if (ai >= 0 && ai < s_tile_count) {
                tile_t *p = &s_tiles[ai];
                if (!p->content_live) materialize_content(ai);
                if (p->tile) { lv_obj_set_x(p->tile, col * w); p->tile_col = col; }
            }
        }
    }
}

static void carousel_scroll(lv_event_t *e) { (void)e; carousel_cover_leading(); }

// Voice mode: show the dark overlay and FREE every tile's content, which is what gives the PCM capture its
// internal-RAM headroom (a heavy UI otherwise leaves ~12 KB internal).
// Turning it off restores the active tile ± window. Caller holds the display lock.
static void voice_overlay_set(bool on)
{
    // Nothing to reset here any more. While the mode lived in a select, this was the one place that could
    // put it back to Auto once a capture ended — every path out of a capture (sent, cancelled, aborted,
    // quota-rejected) funnels through this call. The three buttons hold no state between turns, so the
    // mode is decided by which one was pressed and dies with the utterance on its own.
    if (s_voice_overlay) set_hidden(s_voice_overlay, !on);
    if (on) {
        for (int i = 0; i < s_tile_count; i++) free_content(i);
    } else {
        update_content_window();
    }
}

// Remove a project's tile (its session ended and the tmux pane is gone). Deletes the tile's LVGL
// subtree, shifts the model over the hole, re-columns the remaining tiles so the swipe stays
// gap-free, rebuilds the trailing settings tile, and re-focuses a valid tile. Safe if id is unknown.
void ui_tile_remove(const char *chat_id)
{
    if (!chat_id) return;
    char active_id[48];
    snprintf(active_id, sizeof(active_id), "%s", ui_active_tile_id());
    bool voice_aborted = active_id[0] && strcmp(active_id, chat_id) == 0 && voice_active();
    if (voice_aborted) voice_abort();

    display_lock();
    int i = find_proj(chat_id);
    if (i < 0) { display_unlock(); return; }
    clear_removed_project_transients_locked(chat_id, voice_aborted);

    // Capture the page centered NOW (old modulo) so we keep viewing the SAME agent after the shift + remodulo.
    // By id, because delete shifts indices; if the removed agent itself was centered, we land on a neighbour.
    int cc_ring = ring_of_col(carousel_col());
    char keep_id[48] = "";
    if (cc_ring >= RING_LEAD && cc_ring < ring_agents_end())   // on a project
        snprintf(keep_id, sizeof keep_id, "%s", s_tiles[agent_of_ring(cc_ring)].id);

    // Windowed model: free EVERY materialized agent tile first so the model shift below can't strand a tile
    // at a stale column — update_content_window rebuilds the window at the new columns. Free the removed
    // agent's PSRAM strings too (free_content only tears down LVGL, it preserves the model strings).
    for (int k = 0; k < s_tile_count; k++) free_content(k);
    free(s_tiles[i].m_preview);
    free(s_tiles[i].m_full);

    // Shift the model down over the hole, then clear the vacated slot (pointers now live below it).
    for (int k = i; k < s_tile_count - 1; k++) s_tiles[k] = s_tiles[k + 1];
    s_tile_count--;
    memset(&s_tiles[s_tile_count], 0, sizeof(tile_t));

    resize_spacer();           // scroll range shrank by one column
    rebuild_overview_tile();

    // Re-anchor: keep the same page centered under the new modulo. The last process exiting lands on the
    // dedicated no-agent page so Remote users immediately see the tmux restart instructions.
    // The viewed agent → its NEW index (re-found by id). If the removed agent WAS centered → the agent now
    // occupying its slot (clamped to the last).
    int target_ring;
    if (s_tile_count == 0) {
        target_ring = ring_of_agent(0);        // empty slot at RING_LEAD = the "No projects" page
    } else {
        int ni = find_proj(keep_id);
        int ai = (ni >= 0) ? ni : (i < s_tile_count ? i : s_tile_count - 1);
        target_ring = ring_of_agent(ai);       // project index → ring
    }
    carousel_goto(col_for_ring_near(carousel_col(), target_ring), LV_ANIM_OFF);
    apply_active_from_col();
    update_content_window();
    display_unlock();
}

// Put the tiles in the order the app sent, in place.
//
// THE CAROUSEL USED TO IGNORE ORDER ENTIRELY. The reconcile in panel_client.c matches incoming tiles by
// id — update in place, or append — so a tile's position was the order it FIRST appeared and nothing
// afterwards could change it. The app has reordered its list all along (`_commit` re-sorts newest-first,
// pinned first, and the panel is built from the same `liveConversations` the sidebar uses) and the mirror
// has always resent the whole list when the order moved, saying so in as many words. This end simply
// dropped it. The visible cost: a chat you just spoke in stayed where it was, and a NEW chat — first in
// the app — arrived at the far end of the ring.
//
// Caller holds the lock (this runs inside the reconcile's single display_lock, whose whole point is that
// the poll lands as one transition rather than a wobble).
void ui_tiles_reorder(const char ids[][48], int n)
{
    if (!ids || n < 0) return;
    // Most pushes carry the order already on the glass — a tile whose recap changed, a model swapped. Do
    // nothing then, so the common case costs one walk of the ids and no teardown at all.
    if (n == s_tile_count) {
        bool same = true;
        for (int i = 0; i < n; i++)
            if (strcmp(s_tiles[i].id, ids[i]) != 0) { same = false; break; }
        if (same) return;
    }

    // The chat in front of the user, remembered BY ID — its index is exactly what is about to change.
    int cc = carousel_col();
    int cr = ring_of_col(cc);
    char keep[48] = "";
    if (cr >= RING_LEAD && cr < ring_agents_end()) {
        int ai = agent_of_ring(cr);
        if (ai >= 0 && ai < s_tile_count) snprintf(keep, sizeof keep, "%s", s_tiles[ai].id);
    }

    // Selection sort against the app's list. Whole-struct swaps, so a tile carries its materialised LVGL
    // subtree, its live turn and its PSRAM strings to the new slot — nothing is rebuilt to move it.
    // Anything the app did not name (there should be none; the reconcile removes them first) is pushed to
    // the tail keeping its relative order, rather than being stranded in the middle.
    for (int i = 0; i < n && i < s_tile_count; i++) {
        int j = -1;
        for (int k = i; k < s_tile_count; k++)
            if (strcmp(s_tiles[k].id, ids[i]) == 0) { j = k; break; }
        if (j < 0 || j == i) continue;
        tile_t t = s_tiles[i]; s_tiles[i] = s_tiles[j]; s_tiles[j] = t;
    }

    // Re-anchor so the same CHAT stays centred, not the same position. Cheaper than the add/remove path:
    // the ring length did not change, so only this one index moved.
    int ni = keep[0] ? find_proj(keep) : -1;
    if (ni >= 0) {
        int col = col_for_ring_near(cc, ring_of_agent(ni));
        carousel_goto(col, LV_ANIM_OFF);
        // ...and hand the watched tile its new column DIRECTLY, instead of letting update_content_window
        // free it for sitting at one that no longer maps to it. It is the tile a live turn is drawing
        // into, and its tool line, sub-agent rows and todo list are LVGL-only — materialize_content
        // rebuilds the recap card and the Working… row from the model, but those three have no model
        // behind them and would blank until the next `turn.parts`. Reordering happens *because* a turn
        // started here, so that is precisely the moment it would show.
        tile_t *p = &s_tiles[ni];
        if (p->content_live && p->tile) {
            lv_obj_set_x(p->tile, col * carousel_w());
            p->tile_col = col;
        }
    }
    apply_active_from_col();   // s_active_idx follows the ring; the focus it stages is deduped by id
    update_content_window();   // frees the neighbours that no longer map to their column, builds the rest
}

void ui_tile_clear_all(void)
{
    display_lock();
    for (int i = 0; i < s_tile_count; i++) {
        free_content(i);
        free(s_tiles[i].m_preview);
        free(s_tiles[i].m_full);
    }
    memset(s_tiles, 0, MAX_TILES * sizeof(*s_tiles));
    s_tile_count = 0;
    resize_spacer();
    rebuild_overview_tile();
    rebuild_page_dots();
    carousel_goto(col_for_ring_near(carousel_col(), 0 /* overview */), LV_ANIM_OFF);
    apply_active_from_col();
    update_content_window();
    display_unlock();
}

// Create a tile for a new project (caller holds the lock). Returns index or -1 if full.
static int add_proj(const char *id)
{
    if (s_tile_count >= MAX_TILES) return -1;
    // Adding a project grows the ring (N+1), which remaps EVERY column → the page you're viewing would
    // jump. Capture the ring centered now (old modulo). Project indices don't shift on append, so the ring
    // value still identifies the same page; re-anchor to it under the new modulo below.
    int cc_ring = (s_tile_count > 0) ? ring_of_col(carousel_col()) : -1;
    int  on_agent    = (cc_ring >= RING_LEAD && cc_ring < ring_agents_end()) ? agent_of_ring(cc_ring) : -1;
    bool keep_remote_reload_page = s_remote_online_reload &&
        (lv_screen_active() != scr_projects || !s_overview_active);
    int i = s_tile_count++;
    tile_t *p = &s_tiles[i];
    snprintf(p->id, sizeof(p->id), "%s", id);
    p->busy = NULL;

    // No tile yet — create_tile + build_shell + content are built lazily by materialize_content ONLY while
    // this agent is inside the active window, and the whole tile is deleted when it leaves. A far-off agent
    // therefore holds ZERO LVGL objects; the spacer (resize_spacer) reserves its scroll column so scroll
    // positions stay absolute. The 64KB pool is bounded at ANY agent count → truly unlimited.
    resize_spacer();           // (re)assert the huge fixed scroll range
    rebuild_overview_tile();
    rebuild_page_dots();
    // First project → jump scroll to the MIDDLE of the huge range (on project 0) BEFORE windowing, so the
    // window materializes around where we actually are (not around column 0). During an offline→online
    // reload, stay on the Overview if that is where the user was; ui_land_after_reload owns the final focus.
    if (i == 0) {
        int tr = keep_remote_reload_page ? 0 /* overview */ : ring_of_agent(0);
        carousel_goto(col_for_ring_near(CAROUSEL_M / 2, tr), LV_ANIM_OFF);
    } else {
        int tr = (on_agent >= 0) ? ring_of_agent(on_agent) : 0 /* overview */;
        carousel_goto(col_for_ring_near(carousel_col(), tr), LV_ANIM_OFF);
    }
    apply_active_from_col();
    update_content_window();   // materialize the window at the current scroll column
    return i;
}


// Clip a project name to at most 15 UTF-8 chars (whole codepoints), appending "…" when longer — a
// very long name (now editable via rename) would otherwise overflow the round header.
static void name_clip(const char *in, char *out, size_t cap)
{
    const int MAX_CP = 15;
    const unsigned char *p = (const unsigned char *)in;
    size_t o = 0; int cp = 0;
    while (*p && cp < MAX_CP) {
        int len = (*p < 0x80) ? 1 : ((*p & 0xE0) == 0xC0) ? 2 : ((*p & 0xF0) == 0xE0) ? 3 : ((*p & 0xF8) == 0xF0) ? 4 : 1;
        if (o + (size_t)len + 4 > cap) break;               // leave room for "…" + NUL
        for (int k = 0; k < len && p[k]; k++) out[o++] = (char)p[k];
        p += len; cp++;
    }
    if (*p && o + 4 <= cap) { out[o++] = (char)0xE2; out[o++] = (char)0x80; out[o++] = (char)0xA6; }  // …
    out[o] = '\0';
}

// The project a tile's chat lives in — the subtitle under its title. Empty hides the row rather than
// drawing a blank line, so a tile whose project the app did not name keeps the geometry it had.
void ui_tile_set_project(const char *chat_id, const char *project)
{
    if (!chat_id || !project) return;
    display_lock();
    int i = find_proj(chat_id);
    if (i < 0) i = add_proj(chat_id);
    if (i >= 0) {
        char filtered[48];
        utf8_filter(project, filtered, sizeof(filtered));   // same tofu-box guard the title gets
        snprintf(s_tiles[i].project, sizeof s_tiles[i].project, "%s", filtered);
        if (s_tiles[i].project_lbl) {
            lv_label_set_text(s_tiles[i].project_lbl, s_tiles[i].project);
            if (s_tiles[i].project[0]) lv_obj_clear_flag(s_tiles[i].project_lbl, LV_OBJ_FLAG_HIDDEN);
            else                       lv_obj_add_flag(s_tiles[i].project_lbl, LV_OBJ_FLAG_HIDDEN);
        }
    }
    display_unlock();
}

void ui_tile_set_name(const char *chat_id, const char *name)
{
    if (!chat_id || !name) return;
    display_lock();
    int i = find_proj(chat_id);
    if (i < 0) i = add_proj(chat_id);
    if (i >= 0) {
        char filtered[80];
        utf8_filter(name, filtered, sizeof(filtered));   // drop glyphs the font can't render (emoji/CJK) → no tofu box
        char clipped[80];
        name_clip(filtered, clipped, sizeof(clipped));
        snprintf(s_tiles[i].name, sizeof s_tiles[i].name, "%s", clipped);   // MODEL: source of truth
        if (s_tiles[i].name_lbl) lv_label_set_text(s_tiles[i].name_lbl, clipped);   // VIEW mirrors model (may be NULL when off-window)
    }
    display_unlock();
}

static const char *normalized_engine(const char *engine)
{
    return engine && (!strcmp(engine, "claude") || !strcmp(engine, "codex") ||
                      !strcmp(engine, "cursor") || !strcmp(engine, "opencode") ||
                      !strcmp(engine, "pi") || !strcmp(engine, "hermes") ||
                      !strcmp(engine, "commandcode") || !strcmp(engine, "devin") ||
                      !strcmp(engine, "muse") ||
                      !strcmp(engine, "amp") ||
                      !strcmp(engine, "kilo") ||
                      !strcmp(engine, "grok")) ? engine : NULL;
}

// Store an agent's runtime-v1 profile (or "") and repaint its Model/Effort chips. Shared by the
// authoritative setter (agent_synced) and the guarded reconcile (poll).
static void apply_selected_model(tile_t *p, const char *model)
{
    snprintf(p->model, sizeof(p->model), "%s", model ? model : "");
    parse_and_store(p);
    model_chip_paint(p);
    effort_chip_paint(p);
}

// Authoritative update (from agent_synced): always applies and clears any pending optimistic hold.
void ui_tile_set_selected_model(const char *chat_id, const char *model)
{
    if (!chat_id) return;
    display_lock();
    int i = find_proj(chat_id);
    if (i >= 0) apply_selected_model(&s_tiles[i], model);
    display_unlock();
}

void ui_tile_set_engine(const char *chat_id, const char *engine)
{
    if (!chat_id) return;
    display_lock();
    int i = find_proj(chat_id);
    if (i >= 0) {
        const char *valid = normalized_engine(engine);
        if (valid) snprintf(s_tiles[i].engine, sizeof(s_tiles[i].engine), "%s", valid);
        else s_tiles[i].engine[0] = '\0';
        apply_engine_label(&s_tiles[i]);
    }
    display_unlock();
}

void ui_tile_fill_missing_engine(const char *engine)
{
    const char *valid = normalized_engine(engine);
    if (!valid) return;
    display_lock();
    for (int i = 0; i < s_tile_count; i++) {
        if (s_tiles[i].engine[0]) continue;
        snprintf(s_tiles[i].engine, sizeof(s_tiles[i].engine), "%s", valid);
        apply_engine_label(&s_tiles[i]);
    }
    display_unlock();
}

int ui_tile_count(void)
{
    return s_tile_count;
}

int ui_active_tile_index(void)
{
    display_lock();
    int idx = (s_active_idx >= 0 && s_active_idx < s_tile_count ) ? s_active_idx : -1;
    display_unlock();
    return idx;
}

// Copy the id of the tile at index `i` into `buf`. Returns false if out of range. For the
// refresh poll's reconcile (drop tiles whose project is no longer in the fetched list).
bool ui_tile_id_at(int i, char *buf, size_t n)
{
    display_lock();
    bool ok = (i >= 0 && i < s_tile_count);
    if (ok && buf && n) snprintf(buf, n, "%s", s_tiles[i].id);
    display_unlock();
    return ok;
}

bool ui_tile_has_event(const char *chat_id)
{
    if (!chat_id || !chat_id[0]) return false;
    display_lock();
    int i = find_proj(chat_id);
    bool has = i >= 0 && i < s_tile_count && s_tiles[i].m_preview && s_tiles[i].m_preview[0];
    display_unlock();
    return has;
}

bool ui_tile_is_busy(const char *chat_id)
{
    if (!chat_id || !chat_id[0]) return false;
    display_lock();
    int i = find_proj(chat_id);
    bool busy = i >= 0 && i < s_tile_count && s_tiles[i].busy_model;
    display_unlock();
    return busy;
}

bool ui_is_tiles_active(void)
{
    return lv_screen_active() == scr_projects;
}

// True while the full-text detail reader is the active screen. touch.c uses it to give the reader its own
// tight gesture set (vertical = native scroll only; bottom-20px up = Overview; horizontal = back to agent).
bool ui_reader_is_open(void)
{
    return lv_screen_active() == scr_reader;
}

// Height (px) of the top notification pull-down zone. Kept NARROW (44) on a project tile, where the chip
// row sits in the top band; the Overview has nothing up there, so it gets the full band and a
// pull-to-open is easy to land.
int ui_notif_pull_zone_px(void)
{
    // 44 on a project tile so the chip row above it still gets taps; the wider 90 everywhere else,
    // including Settings, whose top holds nothing to protect. The bell sits inside this band on every one
    // of them and is exempt by ui_action_row_hit — a press that starts on it is a tap, not a pull.
    return on_project_page() ? 44 : 90;
}

// Focus a tile because GRID-APP asked, not because the user swiped.
//
// The difference is the loop. apply_active_from_col runs on the way there and would otherwise notice a
// new centred tile and report it straight back — a round trip that only ends because the id stops
// changing. Marking it as already-sent here ends it on the first lap; grid-app does the same on its side,
// so neither end depends on the other being careful.
//
// A tile this panel does not have is ignored: the app is ahead of the list this panel was sent, and the
// `chats` that brings the tile will arrive on its own.
void ui_focus_tile_from_app(const char *chat_id)
{
    if (!chat_id || !chat_id[0]) return;
    display_lock();
    snprintf(s_focus_pending, sizeof(s_focus_pending), "%s", chat_id);
    snprintf(s_focus_sent, sizeof(s_focus_sent), "%s", chat_id);
    display_unlock();
    ui_focus_tile(chat_id);
}

void ui_focus_tile(const char *chat_id)
{
    if (!chat_id) return;
    display_lock();
    int i = find_proj(chat_id);
    if (i >= 0) {
        carousel_goto(col_for_ring_near(carousel_col(), ring_of_agent(i)), LV_ANIM_OFF);   // nearest column showing agent i
        s_active_idx = i;
        update_content_window();   // build the focused tile's content (it may have been an off-window shell)
        rebuild_page_dots();
    }
    display_unlock();
}

// ---- the agent switcher's picker ----

bool ui_switch_is_open(void)
{
    return s_switch_screen && !lv_obj_has_flag(s_switch_screen, LV_OBJ_FLAG_HIDDEN);
}

static void switch_close(void)
{
    if (s_switch_screen) lv_obj_add_flag(s_switch_screen, LV_OBJ_FLAG_HIDDEN);
}

static void switch_bg_tap(lv_event_t *e) { (void)e; switch_close(); }

// Picking is the same move a swipe makes, and it has to stay that way: ui_focus_tile centres the tile, and
// apply_active_from_col is what STAGES the focus message so the window follows. Skipping the second would
// leave the panel looking at one chat and the desktop at another — the two screens are one desk.
static void switch_row_tap(lv_event_t *e)
{
    // current_target, not target: the row is what carries the index, and a click that landed on one of its
    // labels bubbles up with target still pointing at the label.
    int idx = (int)(intptr_t)lv_obj_get_user_data(lv_event_get_current_target(e));
    if (idx < 0 || idx >= SWITCH_LIST_MAX) return;
    char id[ID_MAX];
    snprintf(id, sizeof id, "%s", s_switch_ids[idx]);   // copy: closing rebuilds nothing, but a pick might
    switch_close();
    if (!id[0]) return;
    ui_focus_tile(id);
    display_lock();
    apply_active_from_col();
    display_unlock();
}

// Fill the picker from the FIRST tiles in the list.
//
// That is already "the agents you touched most recently" and not an approximation of it: the tile order is
// grid-app's own chat order, pushed whole whenever it moves — pinned first, then most recently spoken in.
// Sorting here would invent a second opinion about recency out of data this device does not have, and it
// would disagree with the sidebar the moment a chat was pinned. Caller holds the lock.
static void switch_rebuild(void)
{
    if (!s_switch_list) return;
    lv_obj_clean(s_switch_list);
    memset(s_switch_ids, 0, sizeof(s_switch_ids));
    int n = s_tile_count < SWITCH_LIST_MAX ? s_tile_count : SWITCH_LIST_MAX;
    for (int i = 0; i < n; i++) {
        tile_t *t = &s_tiles[i];
        snprintf(s_switch_ids[i], ID_MAX, "%s", t->id);
        // ...and nothing is "here" when the page behind the picker is the Overview or Settings, which name
        // no agent. Marking one anyway would point at whichever tile was last centred.
        bool here = (i == s_active_idx) && !s_overview_active && !s_settings_active;

        lv_obj_t *row = lv_button_create(s_switch_list);
        lv_obj_set_width(row, lv_pct(100));
        lv_obj_set_height(row, LV_SIZE_CONTENT);
        lv_obj_set_style_bg_color(row, COL_CARD, 0);
        lv_obj_set_style_bg_opa(row, here ? LV_OPA_COVER : LV_OPA_60, 0);
        lv_obj_set_style_radius(row, 16, 0);
        lv_obj_set_style_border_width(row, here ? 1 : 0, 0);
        lv_obj_set_style_border_color(row, COL_ACCENT, 0);
        lv_obj_set_style_shadow_width(row, 0, 0);
        lv_obj_set_style_pad_hor(row, 16, 0);
        lv_obj_set_style_pad_ver(row, 10, 0);
        lv_obj_set_flex_flow(row, LV_FLEX_FLOW_COLUMN);
        lv_obj_set_flex_align(row, LV_FLEX_ALIGN_CENTER, LV_FLEX_ALIGN_CENTER, LV_FLEX_ALIGN_CENTER);
        lv_obj_set_style_pad_row(row, 2, 0);
        lv_obj_clear_flag(row, LV_OBJ_FLAG_SCROLLABLE);
        lv_obj_set_user_data(row, (void *)(intptr_t)i);
        lv_obj_add_event_cb(row, switch_row_tap, LV_EVENT_CLICKED, NULL);

        // The chat's own name, then the project under it — the same two lines the tile leads with, so the
        // list reads as the tiles it is a shortcut through. A working agent says so in green.
        // A size up on both lines, and centred. 24 -> med 28 for the name: 29 is what "+5" asks for and no
        // such face is built, so it takes the nearest one — which is also the weight every other title on
        // this panel wears (the tile's own name is med 38, the reader's med 32). The subtitle lands on
        // reg 25 exactly.
        lv_obj_t *nm = lv_label_create(row);
        lv_obj_set_style_text_font(nm, &geist_med_28, 0);
        lv_obj_set_style_text_color(nm, t->busy_model ? COL_VOICE : COL_FG, 0);
        lv_obj_set_width(nm, lv_pct(100));
        lv_obj_set_style_text_align(nm, LV_TEXT_ALIGN_CENTER, 0);
        lv_label_set_long_mode(nm, LV_LABEL_LONG_DOT);
        lv_label_set_text(nm, t->name[0] ? t->name : "Untitled");
        if (t->project[0]) {
            lv_obj_t *pr = lv_label_create(row);
            lv_obj_set_style_text_font(pr, &geist_reg_25, 0);
            lv_obj_set_style_text_color(pr, COL_MUTED, 0);
            lv_obj_set_width(pr, lv_pct(100));
            lv_obj_set_style_text_align(pr, LV_TEXT_ALIGN_CENTER, 0);
            lv_label_set_long_mode(pr, LV_LABEL_LONG_DOT);
            lv_label_set_text(pr, t->project);
        }
    }
    if (n == 0) make_label(s_switch_list, "No agents yet", COL_MUTED, &geist_med_28);
}

static void switch_build(void)
{
    if (s_switch_screen) return;
    s_switch_screen = lv_obj_create(lv_layer_top());
    lv_obj_remove_style_all(s_switch_screen);
    lv_obj_set_size(s_switch_screen, lv_pct(100), lv_pct(100));
    lv_obj_set_pos(s_switch_screen, 0, 0);
    lv_obj_set_style_bg_color(s_switch_screen, COL_BG, 0);
    lv_obj_set_style_bg_opa(s_switch_screen, LV_OPA_COVER, 0);
    lv_obj_add_flag(s_switch_screen, LV_OBJ_FLAG_CLICKABLE);     // empty-area tap closes it
    lv_obj_add_event_cb(s_switch_screen, switch_bg_tap, LV_EVENT_CLICKED, NULL);
    lv_obj_add_flag(s_switch_screen, LV_OBJ_FLAG_HIDDEN);

    // NO CLOSE BUTTON. A tap on the empty area closes it, and on this face there is always empty area to
    // tap: the list is SAFE_CONTENT_W wide inside a 466px circle, so ~40px of backdrop runs down each side
    // however many rows there are, plus whatever is left above and below.
    //
    // The rows live in a column that is CENTRED rather than pinned to the top, which is only possible now
    // that nothing sits above them. Height is content-driven with a ceiling, so a short list sits in the
    // middle of the face instead of hanging from a fixed box, and a full one clamps and scrolls.
    s_switch_list = lv_obj_create(s_switch_screen);
    lv_obj_remove_style_all(s_switch_list);
    lv_obj_set_width(s_switch_list, SAFE_CONTENT_W);
    lv_obj_set_height(s_switch_list, LV_SIZE_CONTENT);
    lv_obj_set_style_max_height(s_switch_list, 360, 0);   // 360 keeps the end rows inside the round face
    lv_obj_center(s_switch_list);
    lv_obj_set_flex_flow(s_switch_list, LV_FLEX_FLOW_COLUMN);
    lv_obj_set_flex_align(s_switch_list, LV_FLEX_ALIGN_START, LV_FLEX_ALIGN_CENTER, LV_FLEX_ALIGN_CENTER);
    lv_obj_set_style_pad_row(s_switch_list, 8, 0);
    lv_obj_set_scroll_dir(s_switch_list, LV_DIR_VER);
    lv_obj_set_scrollbar_mode(s_switch_list, LV_SCROLLBAR_MODE_OFF);
}

// The bell's tap. A plain wrapper so the pill can stay a bare object rather than growing a second
// meaning: everything about WHEN the drawer may open already lives in ui_notif_open.
static void notif_pill_tap(lv_event_t *e) { (void)e; ui_notif_open(); }

void ui_switch_open(void)
{
    // From ANY carousel page, not only an agent tile: the gesture it inherited opened the drawer on the
    // Overview and on Settings too, and a list of recent agents is if anything more useful from the home
    // page than from one of the agents themselves.
    if (voice_active() || display_is_asleep() || lv_screen_active() != scr_projects) return;
    display_lock();
    switch_build();
    switch_rebuild();
    lv_obj_clear_flag(s_switch_screen, LV_OBJ_FLAG_HIDDEN);
    lv_obj_move_foreground(s_switch_screen);
    lv_obj_scroll_to_y(s_switch_list, 0, LV_ANIM_OFF);
    display_unlock();
    ESP_LOGI(TAG, "agent switcher: %d recent", s_tile_count < SWITCH_LIST_MAX ? s_tile_count : SWITCH_LIST_MAX);
}

// "Home" gesture (bottom-edge swipe-up, from touch.c): jump to the Overview tile (ring 0) from ANY screen.
// Closes the notif drawer, leaves any secondary screen (the reader, the question card, the error screen)
// back to the projects carousel, and centres ring 0. No-op before the carousel exists (early boot).
void ui_home_overview(void)
{
    ui_notif_close();   // no-op if closed; takes/releases the lock itself (must not nest inside our lock)
    display_lock();
    if (tileview) {
        if (lv_screen_active() != scr_projects) lv_screen_load(scr_projects);
        carousel_goto(col_for_ring_near(carousel_col(), 0 /* overview ring */), LV_ANIM_OFF);
        apply_active_from_col();     // recompute s_overview_active / settings / machines from the centered ring
        update_content_window();
        rebuild_page_dots();
    }
    display_unlock();
}

void ui_voice_routed(bool auto_sent, bool need_new, const char *route_id, const char *chat_id,
                     const char *transcript)
{
    ESP_LOGI(TAG, "voice.transcript: auto=%d need_route=%d project='%s' heard='%s'",
             auto_sent, need_new, chat_id ? chat_id : "", transcript ? transcript : "");
    // grid-app answered → the routing wait is over. Drop the "Sending…" overlay so the UI is interactive
    // again (and busy_dots_tick stops holding it).
    display_lock();
    s_voice_routing = false; s_voice_route_ms = 0;
    voice_icon_apply(VIC_NONE);
    voice_overlay_set(false);
    display_unlock();
    // The app named no project and could not work one out. Stay on the Overview: there is nothing to
    // focus and nothing this panel could pick that the app has not already declined to.
    if (need_new || !chat_id || !chat_id[0]) return;
    // Switch the carousel to the project so the user sees it working.
    ui_focus_tile(chat_id);
    // `needsConfirm` was set: grid-app GUESSED the project and is holding the transcript until this panel
    // agrees. It agrees IMMEDIATELY, and that is worth saying plainly rather than dressing up: nobody is
    // asked. The carousel has just been moved to the guessed project, so the user does see where their
    // sentence went — one beat before it runs, not before it is decided.
    //
    // TODO(BE): the confirm step is therefore inert. docs/panel-protocol.md calls it the only guard between
    // a guess and a turn dispatched into a real repository, and on 2026-08-17 that guard let a question
    // about crypto prices open a turn in a sports project — the app logged "waiting for the panel to
    // confirm" and the turn started in the same second. Making it real means a card here with the guessed
    // project and a way to pick another, which is UI that does not exist yet. Until it does, routing
    // accuracy is entirely the router's job (see kPanelRouteDeadline).
    if (!auto_sent && route_id && route_id[0]) panel_client_voice_confirm(route_id, chat_id);
}

// Put the voice UI away, whatever state it is in.
//
// UNCONDITIONAL, and that is the point. Every other release path is a condition — the periodic tick
// clears the "Sending…" state only when it happens to observe `VIC_SEND && !voice_active() &&
// !s_voice_routing`, and ui_voice_route_abort only fires for a route capture. A capture that ends with
// NOTHING SENT (the speech gate never latched, or the link went) has no answer coming from anywhere, so
// the screen must not be left depending on someone noticing: pressing Voice and stopping straight away
// left the panel on the loading overlay, and the app-side log for it is empty — which is the tell, since
// the app was never told a capture happened at all.
//
// Safe from any task: takes the lock itself, and every call inside is idempotent.
void ui_voice_release(void)
{
    display_lock();
    s_voice_routing = false;
    s_voice_route_ms = 0;
    voice_icon_apply(VIC_NONE);
    voice_overlay_set(false);
    display_unlock();
}

// Backend gave up on this route voice (empty transcript / STT or router error) — no agent will be picked.
// Release the loading overlay immediately instead of waiting out the routing watchdog. No-op unless a route
// voice is actually waiting (safe to call for non-route 'empty'/'error' frames).
void ui_voice_route_abort(void)
{
    display_lock();
    if (s_voice_routing) {
        s_voice_routing = false; s_voice_route_ms = 0;
        voice_icon_apply(VIC_NONE);
        voice_overlay_set(false);
    }
    display_unlock();
}

// ---------------------------------------------------------------------------------------------------
// Notification centre: a top "🔔 N" unread pill + a pull-down drawer of recent done events.
// ---------------------------------------------------------------------------------------------------
// Unread count = drives the top pill. Opening the drawer marks everything read, so the pill clears
// once seen even though the notifications stay in the list until tapped (Model B).
static int notif_count(void)
{
    int n = 0;
    for (int k = 0; k < NOTIF_MAX; k++) if (s_notif[k].used && s_notif[k].unread) n++;
    return n;
}
static void notif_rel_time(uint32_t ms, char *out, size_t cap)
{
    uint32_t s = lv_tick_elaps(ms) / 1000;
    if (s < 60)        snprintf(out, cap, "%us", (unsigned)s);
    else if (s < 3600) snprintf(out, cap, "%um", (unsigned)(s / 60));
    else               snprintf(out, cap, "%uh", (unsigned)(s / 3600));
}
// The top pill shows the pending-notification count on the projects + Overview screens (hidden while
// asleep / on Settings / Machines / when the drawer is open / when 0). Caller holds the lock.
static void notif_badge_apply(void)
{
    if (!s_notif_pill) return;
    int n = notif_count();
    bool show = n > 0 && !display_is_asleep() && lv_screen_active() == scr_projects
                && !s_notif_open && !ui_switch_is_open();   // shown on the Overview home too
    set_hidden(s_notif_pill, !show);
    if (show && s_notif_pill_lbl) { char b[8]; snprintf(b, sizeof b, "%d", n); lv_label_set_text(s_notif_pill_lbl, b); }
}
static void notif_ud_free(lv_event_t *e) { free(lv_obj_get_user_data(lv_event_get_target(e))); }
// What a drawer row needs on tap: which agent, and which machine it belongs to (may not be the selected one).
typedef struct { char proj[48]; } notif_ref_t;
// Remove ONE project's notification from the queue (compact the tail up). Caller holds the lock.
static void notif_remove(const char *proj_id)
{
    for (int k = 0; k < NOTIF_MAX; k++) {
        if (s_notif[k].used && strcmp(s_notif[k].proj_id, proj_id) == 0) {
            for (int j = k; j < NOTIF_MAX - 1; j++) s_notif[j] = s_notif[j + 1];
            s_notif[NOTIF_MAX - 1].used = false;
            return;
        }
    }
}
// Tap a row → remove ONLY that notification (Model B: the rest are kept), then go to that agent. A
// notification from a machine the device ISN'T rendering (multi-attach background badge) switches machines
// first — its tiles don't exist yet, so the jump is deferred to ui_land_after_reload via s_notif_focus.
// Focus an agent AND open its detail reader — where a notification tap should land. Same text source as
// the swipe-up gesture (m_full, falling back to m_preview) so the two routes can never disagree about what
// "detail" means. Keeps the one exception swipe-up already makes: while the agent is WORKING its tile shows
// the live status and the reader would only hold the previous turn's stale text, so stop at the tile.
static void open_agent_detail(const char *proj_id)
{
    if (!proj_id || !proj_id[0]) return;
    ui_focus_tile(proj_id);          // takes the lock itself
    const char *text = NULL;
    display_lock();
    int i = find_proj(proj_id);
    if (i >= 0 && !s_tiles[i].busy_model) text = s_tiles[i].m_full ? s_tiles[i].m_full : s_tiles[i].m_preview;
    display_unlock();
    if (text && text[0]) open_reader_text(text);   // takes the lock itself — must not nest
}

static void notif_row_tap(lv_event_t *e)
{
    const notif_ref_t *ref = (const notif_ref_t *)lv_obj_get_user_data(lv_event_get_target(e));
    char id[48];                                                    // copy before close frees the rows
    snprintf(id, sizeof id, "%s", ref ? ref->proj : "");
    if (id[0]) notif_remove(id);
    ui_notif_close();
    if (id[0]) open_agent_detail(id);   // straight to the detail screen, not just the tile
}
static void notif_bg_tap(lv_event_t *e) { (void)e; ui_notif_close(); }   // tap empty area → close

// Rebuild the drawer's row list from s_notif (newest first). Big type; the time is a small inline label
// on the name row (NOT its own wide column). Caller holds the lock.
static void notif_rebuild(void)
{
    if (!s_notif_list) return;
    lv_obj_clean(s_notif_list);   // frees old rows (their notif_ud_free DELETE cb releases the strdup'd id)
    int shown = 0;
    for (int k = 0; k < NOTIF_MAX; k++) {
        notif_t *n = &s_notif[k];
        if (!n->used) continue;
        notif_ref_t *ref = ram_psram_alloc(sizeof(notif_ref_t), "notif_row_ref");
        if (!ref) continue;
        snprintf(ref->proj, sizeof ref->proj, "%s", n->proj_id);
        shown++;
        // Card (new Figma): a glassy dark rounded rect, COLUMN of [name row] over [recap]. The name row is
        // a green dot + the green agent name (grows) + a small muted time on the right (iOS-style — the
        // "time" the design omitted, placed where it reads naturally). Recap = big white wrapped text.
        lv_obj_t *row = lv_button_create(s_notif_list);
        lv_obj_set_width(row, lv_pct(100));
        lv_obj_set_height(row, LV_SIZE_CONTENT);
        lv_obj_set_style_bg_color(row, lv_color_hex(0x23252f), 0);
        lv_obj_set_style_bg_color(row, lv_color_hex(0x2e313d), LV_STATE_PRESSED);
        lv_obj_set_style_radius(row, 26, 0);
        lv_obj_set_style_pad_hor(row, 16, 0);
        lv_obj_set_style_pad_ver(row, 14, 0);
        lv_obj_set_style_border_width(row, 1, 0);            // subtle glassy edge (Figma inner highlight)
        lv_obj_set_style_border_color(row, lv_color_hex(0xa6a6a6), 0);
        lv_obj_set_style_border_opa(row, LV_OPA_20, 0);
        lv_obj_set_flex_flow(row, LV_FLEX_FLOW_COLUMN);
        lv_obj_set_flex_align(row, LV_FLEX_ALIGN_START, LV_FLEX_ALIGN_START, LV_FLEX_ALIGN_START);
        lv_obj_set_style_pad_row(row, 8, 0);
        lv_obj_set_user_data(row, ref);
        lv_obj_add_event_cb(row, notif_row_tap, LV_EVENT_CLICKED, NULL);
        lv_obj_add_event_cb(row, notif_ud_free, LV_EVENT_DELETE, NULL);
        lv_obj_t *nmrow = lv_obj_create(row);   // [• green name grows ....... time]
        lv_obj_remove_style_all(nmrow);
        lv_obj_clear_flag(nmrow, LV_OBJ_FLAG_CLICKABLE | LV_OBJ_FLAG_SCROLLABLE);
        lv_obj_set_width(nmrow, lv_pct(100));
        lv_obj_set_height(nmrow, LV_SIZE_CONTENT);
        lv_obj_set_flex_flow(nmrow, LV_FLEX_FLOW_ROW);
        lv_obj_set_flex_align(nmrow, LV_FLEX_ALIGN_START, LV_FLEX_ALIGN_CENTER, LV_FLEX_ALIGN_CENTER);
        lv_obj_set_style_pad_column(nmrow, 8, 0);
        lv_obj_t *dot = lv_obj_create(nmrow);   // green "pending" dot (removed only when tapped)
        lv_obj_remove_style_all(dot);
        lv_obj_clear_flag(dot, LV_OBJ_FLAG_CLICKABLE | LV_OBJ_FLAG_SCROLLABLE);
        lv_obj_set_size(dot, 8, 8);
        lv_obj_set_style_radius(dot, LV_RADIUS_CIRCLE, 0);
        lv_obj_set_style_bg_opa(dot, LV_OPA_COVER, 0);
        lv_obj_set_style_bg_color(dot, lv_color_hex(0x04fe08), 0);
        lv_obj_t *nm = lv_label_create(nmrow);
        lv_obj_set_style_text_font(nm, &geist_reg_20, 0);   // agent name — small, GREEN
        lv_obj_set_style_text_color(nm, lv_color_hex(0x04fe08), 0);
        lv_obj_set_flex_grow(nm, 1);
        lv_label_set_long_mode(nm, LV_LABEL_LONG_DOT);
        lv_label_set_text(nm, n->name[0] ? n->name : n->proj_id);
        lv_obj_t *tm = lv_label_create(nmrow);   // small muted time on the right
        lv_obj_set_style_text_font(tm, &lv_font_montserrat_14, 0);
        lv_obj_set_style_text_color(tm, COL_MUTED, 0);
        char tb[12]; notif_rel_time(n->ms, tb, sizeof tb);
        lv_label_set_text(tm, tb);
        lv_obj_t *sm = lv_label_create(row);
        lv_obj_set_style_text_font(sm, &geist_reg_25, 0);   // recap — big WHITE (font_viet, kept)
        lv_obj_set_style_text_color(sm, COL_FG, 0);
        lv_obj_set_width(sm, lv_pct(100));
        lv_label_set_long_mode(sm, LV_LABEL_LONG_WRAP);
        // Recap is already ≤15 words from the backend; clip generously as a safety net + "…".
        const char *full = n->summary[0] ? n->summary : "done";
        char snip[128]; int plen = utf8_clip(full, 100);
        if (plen > (int)sizeof(snip) - 4) plen = (int)sizeof(snip) - 4;
        memcpy(snip, full, plen);
        if ((int)strlen(full) > plen) { memcpy(snip + plen, "\xE2\x80\xA6", 3); plen += 3; }  // …
        snip[plen] = '\0';
        lv_label_set_text(sm, snip);
    }
    if (s_notif_empty) set_hidden(s_notif_empty, shown > 0);
}
void ui_notif_open(void)
{
    if (!s_notif_drawer || s_notif_open) return;
    if (lv_screen_active() != scr_projects ) return;   // from a project tile OR the Overview home (badge shows on both)
    display_lock();
    notif_rebuild();   // notifications stay green (unread) until tapped away — viewing does NOT dim them
    s_notif_open = true;
    set_hidden(s_notif_drawer, false);
    lv_anim_t a; lv_anim_init(&a);   // slide down from off-top (position anim — no snapshot layer)
    lv_anim_set_var(&a, s_notif_drawer);
    lv_anim_set_exec_cb(&a, (lv_anim_exec_xcb_t)lv_obj_set_y);
    lv_anim_set_values(&a, -466, 0);
    lv_anim_set_duration(&a, 220);
    lv_anim_set_path_cb(&a, lv_anim_path_ease_out);
    lv_anim_start(&a);
    notif_badge_apply();   // hide the pill while the drawer is open
    display_unlock();
}
void ui_notif_close(void)
{
    if (!s_notif_drawer || !s_notif_open) return;
    display_lock();
    s_notif_open = false;
    lv_anim_delete(s_notif_drawer, (lv_anim_exec_xcb_t)lv_obj_set_y);
    lv_obj_set_y(s_notif_drawer, 0);
    set_hidden(s_notif_drawer, true);
    // Model B: closing keeps the list (only tapping a row removes that one). Opening already marked
    // everything read, so the badge stays hidden until a new done event arrives.
    notif_badge_apply();
    display_unlock();
}
bool ui_notif_is_open(void) { return s_notif_open; }
// A swipe-up inside the drawer: close it ONLY if the list is already scrolled to the top (else the
// gesture was just scrolling the list — don't fling the whole drawer away).
void ui_notif_swipe_up(void)
{
    if (s_notif_open && s_notif_list && lv_obj_get_scroll_y(s_notif_list) <= 0) ui_notif_close();
}

// Push a done notification for project i (dedupe by id → refresh + move to top). Caller holds the lock.
static void notif_push(const char *proj_id, int i)
{
    notif_t rec = {0};
    snprintf(rec.proj_id, sizeof rec.proj_id, "%s", proj_id);
    const char *nm = s_tiles[i].name[0] ? s_tiles[i].name : proj_id;   // MODEL, not the widget
    snprintf(rec.name, sizeof rec.name, "%s", nm ? nm : proj_id);
    const char *sm = s_tiles[i].m_preview ? s_tiles[i].m_preview : "";
    snprintf(rec.summary, sizeof rec.summary, "%s", sm);
    rec.ms = lv_tick_get();
    rec.unread = true; rec.used = true;
    int at = -1;   // existing entry for this project?
    for (int k = 0; k < NOTIF_MAX; k++) if (s_notif[k].used && strcmp(s_notif[k].proj_id, proj_id) == 0) { at = k; break; }
    if (at >= 0) { for (int k = at; k < NOTIF_MAX - 1; k++) s_notif[k] = s_notif[k + 1]; s_notif[NOTIF_MAX - 1].used = false; }
    for (int k = NOTIF_MAX - 1; k > 0; k--) s_notif[k] = s_notif[k - 1];   // shift down, insert newest at 0
    s_notif[0] = rec;
}

// A turn just finished for this project (paired with the completion beep in panel_client.c).
// - Looking at the SAME agent that just finished (awake, on its tile): do NOTHING — the result shows live
//   on the tile, so the beep alone is enough (no redundant notification).
// - Awake on a DIFFERENT agent (e.g. viewing Agent A, Agent B finishes): bump the unread badge so they can
//   open the drawer when ready — DON'T yank them off A.
// - Screen OFF (user away): wake the panel and open the NOTIFICATION LIST (drawer) so they land straight
//   on what finished.
// Runs on the WS task under display_lock (like ui_tile_emit); display_lock is recursive, so calling
// ui_notif_open (which locks) from here is safe.
void ui_notify_task_done(const char *chat_id)
{
    if (!chat_id || !chat_id[0]) return;
    display_lock();
    int i = find_proj(chat_id);
    if (i >= 0) {
        bool viewing = !display_is_asleep() && !s_overview_active && !s_settings_active
                       && !s_notif_open && s_active_idx == i;
        if (!viewing) {
            bool was_asleep = display_is_asleep();
            notif_push(chat_id, i);   // record it so the drawer/badge has the entry
            if (was_asleep) {
                // Woke from an off screen → open the notification list directly. ui_notif_open only opens
                // over the projects carousel (not settings), so land there first.
                display_wake();
                if (lv_screen_active() != scr_projects) lv_screen_load(scr_projects);
                ui_notif_open();
            } else {
                // Awake on a different agent → just badge, don't yank the user off what they're viewing.
                notif_badge_apply();
            }
        }
    }
    display_unlock();
}

void ui_set_connected(bool connected)
{
    display_lock();
    s_connected = connected;
    refresh_conn_ui();   // recolour the tile dots + toggle the "Not connected" badge
    overview_actions_apply();
    display_unlock();
}

// Codepoints geist_reg_20 actually contains (ASCII + Vietnamese + a few symbols). Anything else
// (CJK, emoji, …) has no glyph; rendering such text could read a bad glyph bitmap and corrupt the
// heap — and it shows as tofu anyway — so we strip them.
static bool cp_in_font(uint32_t cp)
{
    if (cp == '\n' || cp == '\t') return true;
    if (cp >= 0x20 && cp <= 0x7E) return true;        // ASCII
    if (cp >= 0xA0 && cp <= 0x24F) return true;       // Latin-1 + Extended-A/B
    if (cp >= 0x1E00 && cp <= 0x1EFF) return true;    // Latin Extended Additional (Vietnamese)
    if (cp >= 0x2013 && cp <= 0x2026) return true;    // – — ' ' " " …
    if (cp == 0x203A || cp == 0x2713 || cp == 0x2717) return true; // › ✓ ✗
    return false;
}

// Copy `s` to `out` (≤cap) keeping only UTF-8 chars the font can render; collapse runs of dropped
// chars to a single space so words don't run together.
static void utf8_filter(const char *s, char *out, size_t cap)
{
    size_t o = 0; bool gap = false;
    while (*s && o + 5 < cap) {
        unsigned char c = (unsigned char)*s;
        int len; uint32_t cp;
        if (c < 0x80)            { cp = c;        len = 1; }
        else if ((c & 0xE0) == 0xC0) { cp = c & 0x1F; len = 2; }
        else if ((c & 0xF0) == 0xE0) { cp = c & 0x0F; len = 3; }
        else if ((c & 0xF8) == 0xF0) { cp = c & 0x07; len = 4; }
        else { s++; continue; }
        bool ok = true;
        for (int k = 1; k < len; k++) { if ((((unsigned char)s[k]) & 0xC0) != 0x80) { ok = false; break; } cp = (cp << 6) | (s[k] & 0x3F); }
        if (!ok) { s++; continue; }
        if (cp_in_font(cp)) {
            if (gap && o + 1 < cap) { out[o++] = ' '; gap = false; }
            for (int k = 0; k < len && o + 1 < cap; k++) out[o++] = s[k];
        } else if (o > 0) {
            gap = true; // remember we dropped something between kept chars
        }
        s += len;
    }
    out[o] = '\0';
}

// Truncate to at most `max` bytes without splitting a UTF-8 sequence.
static int utf8_clip(const char *s, int max)
{
    int n = (int)strlen(s);
    if (n <= max) return n;
    int i = max;
    while (i > 0 && ((unsigned char)s[i] & 0xC0) == 0x80) i--;
    return i;
}

// Free the full text stashed on an event card when LVGL deletes the card.
static void ev_card_free(lv_event_t *e)
{
    void *full = lv_obj_get_user_data(lv_event_get_target(e));
    if (full) free(full);
}

// Open the full-text reader on some event's text. Called by the tap gesture (ui_tap).
// What the reader shows for a turn that has a headline and no body.
//
// NOT the headline again. The tile is already showing it, unclipped, two centimetres away — repeating it
// is the "two zones, one sentence" this protocol calls a bug in the reader, and it is worse than saying
// nothing because it looks like the long form failed to load. A turn has no body until a model has
// written one (docs/panel-protocol.md, "The tile shape").
static const char *READER_NO_BODY = "No longer form for this one yet.";

static void open_reader_text(const char *full)
{
    if (!full || !full[0]) return;
    display_lock();
    lv_label_set_text(reader_lbl, full);   // no leading indent — the name pill now heads the screen
    // Top pill = the active tile's project/agent name (Figma "detail screen").
    if (s_reader_name) {
        int i = (s_active_idx >= 0 && s_active_idx < s_tile_count) ? s_active_idx : -1;
        const char *nm = (i >= 0 && s_tiles[i].name[0]) ? s_tiles[i].name : NULL;   // MODEL, not the widget
        lv_label_set_text(s_reader_name, (nm && nm[0] && strcmp(nm, "…") != 0) ? nm : "");
    }
    lv_obj_scroll_to_y(scr_reader, 0, LV_ANIM_OFF);
    lv_screen_load(scr_reader);
    display_unlock();
}

// Close the reader → back to the projects view. Called by swipe-down at the reader's top.
static void reader_close(lv_event_t *e)
{
    (void)e;
    display_lock();
    lv_screen_load(scr_projects);
    display_unlock();
}

// Marker + colour for a commander event kind. Markers are Unicode glyphs included in geist_reg_20
// (the custom font has no FontAwesome symbols).
static void kind_style(const char *kind, const char **sym, lv_color_t *col)
{
    if (kind && !strcmp(kind, "act"))        { *sym = "\xE2\x80\xBA ";  *col = COL_ACCENT; } // ›
    else if (kind && !strcmp(kind, "ask"))   { *sym = "? ";             *col = COL_YELLOW; }
    else if (kind && !strcmp(kind, "done"))  { *sym = "\xE2\x9C\x93 ";  *col = COL_GREEN;  } // ✓
    else if (kind && !strcmp(kind, "summary")){ *sym = "";               *col = COL_FG;     } // turn summary = main readable content (neutral, not alarming green)
    else if (kind && !strcmp(kind, "error")) { *sym = "\xE2\x9C\x97 ";  *col = COL_RED;    } // ✗
    else                                     { *sym = "";               *col = COL_FG;     } // say
}

// Drop the transient "processing" dot row (if any) and restore the event card to full opacity.
// The card is faded while processing so the blinking dots stand out; this un-fades it. Caller holds lock.
static void clear_busy(tile_t *p)
{
    p->busy_model = false;   // model: turn is no longer processing (matters for off-window tiles too)
    if (p->tool_line) { lv_obj_delete(p->tool_line); p->tool_line = NULL; }  // drop the current-tool row
    if (p->agents) { lv_obj_delete(p->agents); p->agents = NULL; }  // drop the sub-agent list (turn ended → summary replaces it)
    if (p->busy) { lv_obj_delete(p->busy); p->busy = NULL; }  // deletes the two child labels too
    p->busy_verb = NULL; p->busy_meta = NULL; p->busy_icon = NULL; p->busy_tokens = 0; p->busy_last_ms = 0;
    if (p->todo) { lv_obj_delete(p->todo); p->todo = NULL; p->todo_active = NULL; }  // drop the checklist
    if (p->list) { lv_obj_clear_flag(p->list, LV_OBJ_FLAG_HIDDEN); lv_obj_set_style_opa(p->list, LV_OPA_COVER, 0); }
    if (p->tile) {   // restore the recap layout: top-anchored name + card (render_busy_row had centred it)
        lv_obj_set_flex_align(p->tile, LV_FLEX_ALIGN_START, LV_FLEX_ALIGN_CENTER, LV_FLEX_ALIGN_CENTER);
        lv_obj_set_style_pad_top(p->tile, TILE_PAD_TOP, 0);
        int32_t engine_h = lv_font_get_line_height(&lv_font_montserrat_14);
        lv_obj_set_style_pad_row(p->tile, LV_MAX(0, TILE_NAME_GAP - engine_h), 0);
    }
    overview_working_apply();   // this agent stopped working → refresh the Overview "N working" count
    agent_actions_apply();      // …and the actions come back on the tile
}

// Update the working-status token counter for a project (from the backend's processing event).
// No-op if the project isn't currently processing.
void ui_tile_set_busy_tokens(const char *chat_id, int tokens)
{
    if (!chat_id || tokens < 0) return;
    display_lock();
    int i = find_proj(chat_id);
    if (i >= 0 && s_tiles[i].busy) { s_tiles[i].busy_tokens = tokens; busy_compose(&s_tiles[i]); }
    display_unlock();
}

// Reap orphaned busy tiles by heartbeat absence. A tile goes/stays "Working…" only via a live 'processing'
// frame; the ONLY thing that clears it is a live terminal event (summary/done/error). That terminal can be
// lost (WS drop right as the turn ends) or never produced at all (turn completed while the adapter was
// restarting → hydrated silently), and history replay never clears busy (project_apply_event's !restored
// guard) — so the tile would spin forever. Backstop: while a turn is live, BOTH the adapter and the VM node
// re-emit 'processing' every ~5s (turn heartbeat), covering the turn AND the trailing "Summarizing…" window.
// Each such frame stamps busy_last_ms. If the stamps stop for > BUSY_TIMEOUT the turn is gone (ended, or the
// link died) → clear. Safe because a genuinely-live turn keeps stamping every 5s; only silence clears. Called
// from the ~1s refresh loop. Returns #cleared.
int ui_prune_stale_busy(void)
{
    // 25s ≈ 5 turn-heartbeats — tolerates 2-3 missed beats before deciding the turn is gone. Firing early
    // wrongly clears a live turn; waiting costs nothing (the busy was stuck forever without this) → bias large.
    const int64_t BUSY_TIMEOUT_US = 25LL * 1000000LL;
    int cleared = 0;
    display_lock();
    int64_t now = esp_timer_get_time();
    for (int i = 0; i < s_tile_count; i++) {
        tile_t *p = &s_tiles[i];
        if (!p->busy_model) { p->busy_last_ms = 0; continue; }
        if (p->busy_last_ms == 0) { p->busy_last_ms = now; continue; } // busy set without a stamp yet → arm it
        if (now - p->busy_last_ms < BUSY_TIMEOUT_US) continue;         // still receiving heartbeats → live turn
        ESP_LOGW(TAG, "prune stale busy: agent=%s silent %llds — no heartbeat, clearing",
                 p->id[0] ? p->id : "?", (long long)((now - p->busy_last_ms) / 1000000));
        clear_busy(p);
        cleared++;
    }
    display_unlock();
    return cleared;
}

// Parse "#RRGGBB" (or "RRGGBB") into an lv_color_t; NULL/malformed → COL_MUTED (grey).
static lv_color_t parse_hex(const char *s)
{
    if (!s) return COL_MUTED;
    if (*s == '#') s++;
    if (strlen(s) < 6) return COL_MUTED;
    char buf[7]; memcpy(buf, s, 6); buf[6] = '\0';
    char *end = NULL;
    long v = strtol(buf, &end, 16);
    if (end != buf + 6) return COL_MUTED;
    return lv_color_hex((uint32_t)v);
}

// Colour for a step, from its `kind` — command · web · tool · thinking.
//
// **The device must not infer a colour from the tool's NAME**, which is what the reference did by taking a
// pre-formatted `color` hex off the wire and what a device is tempted to do by matching on "Bash". The
// wire carries `kind` for exactly this: a tool this build has never heard of still lands in the right
// colour, because the app already said what KIND of thing it is. An unrecognised kind draws neutral.
static lv_color_t kind_color(const char *kind)
{
    if (!kind || !kind[0])                return COL_FG;
    if (strcmp(kind, "command") == 0)     return COL_ACCENT;
    if (strcmp(kind, "web") == 0)         return lv_color_hex(0x64d2ff);
    if (strcmp(kind, "tool") == 0)        return COL_GREEN;
    if (strcmp(kind, "thinking") == 0)    return COL_MUTED;
    return COL_FG;
}

// Live "current step" block above the Working row: TWO lines, stacked (tool_line is a COLUMN):
//   row 1 (inner ROW): the `tool` name in its kind's colour + the step's `label` (muted)
//   row 2 (dt):        the raw `arg` — the command / query / url — hidden when empty
// Overwrites each call; only while processing (needs p->busy).
void ui_tile_set_tool(const char *chat_id, const char *tool_name, const char *title,
                         const char *kind, const char *detail)
{
    if (!chat_id || !tool_name || !tool_name[0]) return;
    display_lock();
    int i = find_proj(chat_id);
    if (i < 0 || !s_tiles[i].busy) { display_unlock(); return; }   // only during processing
    tile_t *p = &s_tiles[i];
    // When a todo checklist or a sub-agent list is on screen it already fills the space — don't also
    // show the current-tool block. Otherwise show it as usual.
    if (p->todo || p->agents) {
        if (p->tool_line) lv_obj_add_flag(p->tool_line, LV_OBJ_FLAG_HIDDEN);
        display_unlock();
        return;
    }
    if (p->tool_line) lv_obj_clear_flag(p->tool_line, LV_OBJ_FLAG_HIDDEN);
    if (!p->tool_line) {
        // Outer COLUMN: [ inner row (toolName+title) ] over [ detail line ]. Content-sized + centered.
        p->tool_line = lv_obj_create(p->body);
        lv_obj_remove_style_all(p->tool_line);
        lv_obj_clear_flag(p->tool_line, LV_OBJ_FLAG_CLICKABLE | LV_OBJ_FLAG_SCROLLABLE);
        lv_obj_set_size(p->tool_line, LV_SIZE_CONTENT, LV_SIZE_CONTENT);
        lv_obj_set_flex_flow(p->tool_line, LV_FLEX_FLOW_COLUMN);
        lv_obj_set_flex_align(p->tool_line, LV_FLEX_ALIGN_CENTER, LV_FLEX_ALIGN_CENTER, LV_FLEX_ALIGN_CENTER);
        lv_obj_set_style_pad_row(p->tool_line, 2, 0);
        // Inner ROW: toolName (colored) + title (muted) — unchanged from before.
        lv_obj_t *tr = lv_obj_create(p->tool_line);
        lv_obj_remove_style_all(tr);
        lv_obj_clear_flag(tr, LV_OBJ_FLAG_CLICKABLE | LV_OBJ_FLAG_SCROLLABLE);
        lv_obj_set_size(tr, LV_SIZE_CONTENT, LV_SIZE_CONTENT);
        lv_obj_set_flex_flow(tr, LV_FLEX_FLOW_ROW);
        lv_obj_set_flex_align(tr, LV_FLEX_ALIGN_CENTER, LV_FLEX_ALIGN_CENTER, LV_FLEX_ALIGN_CENTER);
        lv_obj_set_style_pad_column(tr, 6, 0);
        lv_obj_t *gi = lv_image_create(tr);   // WebSearch globe marker — shown INSTEAD of the toolName text
        lv_image_set_src(gi, &icon_globe);
        lv_obj_add_flag(gi, LV_OBJ_FLAG_HIDDEN);
        lv_obj_t *nm = lv_label_create(tr);   // toolName (colored) — used for non-WebSearch tools
        lv_obj_set_style_text_font(nm, &geist_reg_25, 0);
        lv_obj_t *ti = lv_label_create(tr);   // title (muted; width is capped per update to stay on one line)
        lv_obj_set_style_text_font(ti, &geist_reg_25, 0);
        lv_obj_set_style_text_color(ti, COL_MUTED, 0);
        lv_obj_set_style_text_align(ti, LV_TEXT_ALIGN_LEFT, 0);
        lv_label_set_long_mode(ti, LV_LABEL_LONG_DOT);
        // Detail line (raw arg): smaller + muted. Fixed width → wraps; height is set per-update to cap
        // at 3 lines (longer → ellipsized). Hidden when there's no detail.
        lv_obj_t *dt = lv_label_create(p->tool_line);
        lv_obj_set_style_text_font(dt, &geist_reg_20, 0);
        lv_obj_set_style_text_color(dt, COL_MUTED, 0);
        lv_obj_set_style_text_align(dt, LV_TEXT_ALIGN_CENTER, 0);
        lv_obj_set_width(dt, SAFE_CONTENT_W);
        lv_obj_move_to_index(p->tool_line, lv_obj_get_index(p->busy));   // sit just above the Working row
    }
    lv_obj_t *tr = lv_obj_get_child(p->tool_line, 0);
    lv_obj_t *gi = lv_obj_get_child(tr, 0);   // globe icon (WebSearch)
    lv_obj_t *nm = lv_obj_get_child(tr, 1);   // toolName text (other tools)
    lv_obj_t *ti = lv_obj_get_child(tr, 2);
    lv_obj_t *dt = lv_obj_get_child(p->tool_line, 1);
    static char nbuf[48], tbuf[96], dbuf[256];
    // A `web` step gets the globe mark instead of its tool name (Figma "proccessing screen"); everything
    // else keeps the name, in its kind's colour. Note this switches on the KIND, not on the tool being
    // called "WebSearch" — the reference matched the name and would have missed every other web tool.
    bool is_web = kind && strcmp(kind, "web") == 0;
    if (is_web) {
        lv_obj_clear_flag(gi, LV_OBJ_FLAG_HIDDEN);
        lv_obj_add_flag(nm, LV_OBJ_FLAG_HIDDEN);
    } else {
        lv_obj_add_flag(gi, LV_OBJ_FLAG_HIDDEN);
        lv_obj_clear_flag(nm, LV_OBJ_FLAG_HIDDEN);
        utf8_filter(tool_name, nbuf, sizeof(nbuf));
        lv_label_set_text(nm, nbuf);
        lv_obj_set_style_text_color(nm, kind_color(kind), 0);
    }
    if (title && title[0]) {
        utf8_filter(title, tbuf, sizeof(tbuf));
        lv_point_t lead_sz = {0}, title_sz = {0};
        int lead_w = 26;   // icon_globe native width; a web step hides the text label
        if (!is_web) {
            lv_text_get_size(&lead_sz, nbuf, &geist_reg_25, 0, 0, LV_COORD_MAX, LV_TEXT_FLAG_NONE);
            lead_w = lead_sz.x;
        }
        lv_text_get_size(&title_sz, tbuf, &geist_reg_25, 0, 0, LV_COORD_MAX, LV_TEXT_FLAG_NONE);
        int title_w = SAFE_CONTENT_W - lead_w - 6;   // 6px flex gap between tool name/icon and title
        if (title_w < 1) title_w = 1;
        if (title_w > title_sz.x) title_w = title_sz.x;
        // LV_LABEL_LONG_DOT only ellipsizes reliably when both dimensions are fixed. Keeping the row at
        // exactly one font line prevents long titles such as "Fetched api.coingecko.com" from wrapping.
        lv_obj_set_size(ti, title_w, lv_font_get_line_height(&geist_reg_25));
        lv_label_set_text(ti, tbuf);
        lv_obj_clear_flag(ti, LV_OBJ_FLAG_HIDDEN);
    } else {
        lv_label_set_text(ti, "");
        lv_obj_add_flag(ti, LV_OBJ_FLAG_HIDDEN);
    }
    if (detail && detail[0]) {
        utf8_filter(detail, dbuf, sizeof(dbuf));
        // Show only the first ~40 chars + "…" — the full raw arg (URL / command / query) is too much info
        // on the small round screen. Clip UTF-8-safe (same pattern as the notification recap snippet).
        char snip[80]; int plen = utf8_clip(dbuf, 40);
        if (plen > (int)sizeof(snip) - 4) plen = (int)sizeof(snip) - 4;
        memcpy(snip, dbuf, plen);
        if ((int)strlen(dbuf) > plen) { memcpy(snip + plen, "\xE2\x80\xA6", 3); plen += 3; }  // …
        snip[plen] = '\0';
        lv_obj_set_height(dt, LV_SIZE_CONTENT);
        lv_label_set_long_mode(dt, LV_LABEL_LONG_WRAP);   // ≤50 chars → 1–2 short lines, centered
        lv_label_set_text(dt, snip);
        lv_obj_clear_flag(dt, LV_OBJ_FLAG_HIDDEN);
    } else {
        lv_label_set_text(dt, "");
        lv_obj_add_flag(dt, LV_OBJ_FLAG_HIDDEN);
    }
    display_unlock();
}

// Sub-agent (Task/Agent delegation) list above Working…: one LINE per sub-agent, pre-formatted by the
// backend as {text, color} (title unused). text = "› {desc}" (orange, running) / "✓ {desc} · Xs" (green,
// done) — the description of the work, not the agent type. Backend sends the FULL list each change (like
// todos); this rebuilds it. Only while processing (needs p->busy). Empty/NULL array clears the list.
void ui_tile_set_agents(const char *chat_id, const struct cJSON *agents_)
{
    const cJSON *agents = (const cJSON *)agents_;
    if (!chat_id) return;
    display_lock();
    int i = find_proj(chat_id);
    if (i < 0 || !s_tiles[i].busy) { display_unlock(); return; }   // only during processing
    tile_t *p = &s_tiles[i];
    if (p->agents) { lv_obj_delete(p->agents); p->agents = NULL; }   // rebuild from scratch each time

    int n = (agents && cJSON_IsArray(agents)) ? cJSON_GetArraySize(agents) : 0;
    if (n <= 0) { display_unlock(); return; }
    if (p->tool_line) lv_obj_add_flag(p->tool_line, LV_OBJ_FLAG_HIDDEN);   // sub-agent list owns the space now

    p->agents = lv_obj_create(p->body);
    lv_obj_remove_style_all(p->agents);
    lv_obj_set_width(p->agents, SAFE_CONTENT_W);
    lv_obj_set_height(p->agents, LV_SIZE_CONTENT);   // measured + capped below
    lv_obj_set_flex_flow(p->agents, LV_FLEX_FLOW_COLUMN);
    lv_obj_set_flex_align(p->agents, LV_FLEX_ALIGN_CENTER, LV_FLEX_ALIGN_CENTER, LV_FLEX_ALIGN_CENTER);
    lv_obj_set_style_pad_row(p->agents, 4, 0);
    // Same scrollable-box treatment as the todo list: render ALL agents; the overflow scrolls. CLICKABLE
    // so the drag scrolls THIS box (not the horizontal tileview); no vertical scroll-chain.
    lv_obj_add_flag(p->agents, LV_OBJ_FLAG_SCROLLABLE | LV_OBJ_FLAG_CLICKABLE);
    lv_obj_clear_flag(p->agents, LV_OBJ_FLAG_SCROLL_CHAIN_VER);
    lv_obj_set_scroll_dir(p->agents, LV_DIR_VER);
    lv_obj_set_scrollbar_mode(p->agents, LV_SCROLLBAR_MODE_ON);

    lv_obj_t *active_row = NULL;
    static char nbuf[128];
    for (int k = 0; k < n; k++) {
        const cJSON *it = cJSON_GetArrayItem(agents, k);
        if (!it) continue;
        const cJSON *tj = cJSON_GetObjectItemCaseSensitive(it, "text");
        const cJSON *cj = cJSON_GetObjectItemCaseSensitive(it, "color");
        const char *text  = cJSON_IsString(tj) ? tj->valuestring : "";
        const char *color = cJSON_IsString(cj) ? cj->valuestring : NULL;
        // One sub-agent = ONE line: "› {desc}" (running, orange) / "✓ {desc} · Xs" (done, green).
        // Backend folds everything into `text`; device just renders the single colored label.
        lv_obj_t *nm = lv_label_create(p->agents);
        lv_obj_set_style_text_font(nm, &geist_reg_25, 0);
        lv_obj_set_width(nm, LV_SIZE_CONTENT);
        lv_obj_set_style_max_width(nm, SAFE_CONTENT_W, 0);   // long desc → trailing "…" on ONE line, never wraps
        lv_label_set_long_mode(nm, LV_LABEL_LONG_DOT);
        lv_obj_set_style_text_align(nm, LV_TEXT_ALIGN_CENTER, 0);
        utf8_filter(text, nbuf, sizeof(nbuf));
        lv_label_set_text(nm, nbuf);
        lv_obj_set_style_text_color(nm, parse_hex(color), 0);
        // "›" (U+203A = E2 80 BA) prefixes a RUNNING agent → auto-scroll it into view.
        if ((unsigned char)text[0] == 0xE2 && (unsigned char)text[1] == 0x80 && (unsigned char)text[2] == 0xBA) active_row = nm;
    }
    // Cap to AGENTS_VISIBLE_ROWS rows; the rest scroll. Measure a real row height (all one line).
    lv_obj_update_layout(p->agents);
    if (lv_obj_get_child_count(p->agents) > AGENTS_VISIBLE_ROWS) {
        lv_coord_t rowh = lv_obj_get_height(lv_obj_get_child(p->agents, 0));
        lv_obj_set_height(p->agents, rowh * AGENTS_VISIBLE_ROWS + 4 * (AGENTS_VISIBLE_ROWS - 1) + 2);
    }
    if (active_row) lv_obj_scroll_to_view(active_row, LV_ANIM_OFF);
    lv_obj_move_to_index(p->agents, lv_obj_get_index(p->busy));   // sit just above the Working row
    display_unlock();
}

// The plan, from `turn.parts.todos[]` — an array of `{text, status}`. Windows to TODO_VISIBLE_ROWS rows
// and scrolls the rest, auto-scrolling the running item into view; the recap card is hidden while it
// shows. NULL/empty clears it and restores the card.
//
// ⚠️ A TODO'S `status` IS ITS OWN THREE-VALUE VOCABULARY — pending · running · done — and it is NOT a
// step's four. **An unrecognised todo status is drawn as `pending`, never as done**, which is the exact
// OPPOSITE of the rule for a step. The two failure modes are opposite: an unrecognised step left spinning
// claims work is happening that is not, so unknown settles to finished; an unrecognised todo drawn as
// finished puts a tick against work nobody has begun, so unknown settles to not-started. A plan has no
// equivalent of "ran, but never reported back". Sharing one code path between the two would make one of
// them wrong, which is why this reads `text`/`status` and its own three words rather than calling out to
// whatever the step side does.
void ui_tile_set_todos(const char *chat_id, const struct cJSON *todos_)
{
    const cJSON *todos = (const cJSON *)todos_;
    if (!chat_id) return;
    display_lock();
    int i = find_proj(chat_id);
    // Only render into a materialized tile (todos build into p->body). Off-window: skip — the checklist
    // re-streams from the next live todos event once the tile is swiped into view.
    if (i < 0 || !s_tiles[i].content_live) { display_unlock(); return; }
    tile_t *p = &s_tiles[i];
    if (p->todo) { lv_obj_delete(p->todo); p->todo = NULL; p->todo_active = NULL; }

    int n = (todos && cJSON_IsArray(todos)) ? cJSON_GetArraySize(todos) : 0;
    if (n <= 0) {                                   // no list → bring the event card back, but only if the
        // turn isn't still processing (p->busy). During processing we keep the card hidden so ONLY the
        // "Working… (elapsed · tokens)" row shows; clear_busy un-hides it when the turn ends.
        if (p->list && !p->busy) lv_obj_clear_flag(p->list, LV_OBJ_FLAG_HIDDEN);
        display_unlock();
        return;
    }

    // Show ALL items (no windowing) inside a scrollable box; remember the in_progress row so we can
    // auto-scroll it into view after building.
    int start = 0, end = n;

    if (p->list) lv_obj_add_flag(p->list, LV_OBJ_FLAG_HIDDEN);   // hide event card while the list shows
    if (p->tool_line) lv_obj_add_flag(p->tool_line, LV_OBJ_FLAG_HIDDEN);   // todos own the space now

    p->todo = lv_obj_create(p->body);
    lv_obj_remove_style_all(p->todo);
    lv_obj_set_width(p->todo, SAFE_CONTENT_W);
    lv_obj_set_height(p->todo, LV_SIZE_CONTENT);   // measured after building; capped below if too tall
    lv_obj_set_flex_flow(p->todo, LV_FLEX_FLOW_COLUMN);
    lv_obj_set_flex_align(p->todo, LV_FLEX_ALIGN_START, LV_FLEX_ALIGN_CENTER, LV_FLEX_ALIGN_START);  // rows centered horizontally
    lv_obj_set_style_pad_row(p->todo, 7, 0);
    // CLICKABLE so a press lands ON the box (not through it to the tileview) → LVGL scrolls THIS box
    // vertically instead of letting the tileview eat the drag. SCROLL_CHAIN off so a vertical drag never
    // bubbles up to the horizontal tileview.
    lv_obj_add_flag(p->todo, LV_OBJ_FLAG_SCROLLABLE | LV_OBJ_FLAG_CLICKABLE);   // vertical scroll through all items
    lv_obj_clear_flag(p->todo, LV_OBJ_FLAG_SCROLL_CHAIN_VER);
    lv_obj_set_scroll_dir(p->todo, LV_DIR_VER);
    lv_obj_set_scrollbar_mode(p->todo, LV_SCROLLBAR_MODE_ON);   // always visible → confirms the scroll region
    lv_obj_move_to_index(p->todo, 0);               // top of the body, above the (hidden) card + working row

    lv_obj_t *active_row = NULL;
    static char clean[64];
    for (int k = start; k < end; k++) {
        const cJSON *it = cJSON_GetArrayItem(todos, k);
        const cJSON *cj = it ? cJSON_GetObjectItemCaseSensitive(it, "text") : NULL;
        const cJSON *sj = it ? cJSON_GetObjectItemCaseSensitive(it, "status") : NULL;
        const char *ct = cJSON_IsString(cj) ? cj->valuestring : "";
        const char *st = cJSON_IsString(sj) ? sj->valuestring : "";
        // Only the two words that are recognised do anything. Everything else — a missing status, a value
        // from a newer app — falls through to PENDING.
        bool run  = strcmp(st, "running") == 0;
        bool done = strcmp(st, "done") == 0;

        lv_obj_t *row = lv_obj_create(p->todo);
        lv_obj_remove_style_all(row);
        lv_obj_clear_flag(row, LV_OBJ_FLAG_CLICKABLE | LV_OBJ_FLAG_SCROLLABLE);
        lv_obj_set_width(row, lv_pct(100));       // full width → center the [glyph + text] within the row
        lv_obj_set_height(row, LV_SIZE_CONTENT);
        lv_obj_set_flex_flow(row, LV_FLEX_FLOW_ROW);
        lv_obj_set_flex_align(row, LV_FLEX_ALIGN_CENTER, LV_FLEX_ALIGN_CENTER, LV_FLEX_ALIGN_CENTER);
        lv_obj_set_style_pad_column(row, 8, 0);

        // Glyph: green dot = done, orange (pulsed) = running, grey ring = pending.
        lv_obj_t *g = lv_obj_create(row);
        lv_obj_remove_style_all(g);
        lv_obj_clear_flag(g, LV_OBJ_FLAG_CLICKABLE | LV_OBJ_FLAG_SCROLLABLE);
        lv_obj_set_size(g, 12, 12);
        lv_obj_set_style_radius(g, LV_RADIUS_CIRCLE, 0);
        if (done) {
            lv_obj_set_style_bg_color(g, COL_GREEN, 0); lv_obj_set_style_bg_opa(g, LV_OPA_COVER, 0);
        } else if (run) {
            lv_obj_set_style_bg_color(g, COL_ORANGE, 0); lv_obj_set_style_bg_opa(g, LV_OPA_COVER, 0);
            p->todo_active = g;
            active_row = row;
        } else {
            lv_obj_set_style_bg_opa(g, LV_OPA_TRANSP, 0);
            lv_obj_set_style_border_width(g, 2, 0); lv_obj_set_style_border_color(g, COL_MUTED, 0);
        }

        utf8_filter(ct, clean, sizeof(clean));
        lv_obj_t *lbl = lv_label_create(row);
        // Content-width so the glyph+text sizes to the item and the whole row can be centered as a unit;
        // bounded by max_width with a trailing "…" for long items. One line.
        lv_obj_set_width(lbl, LV_SIZE_CONTENT);
        lv_obj_set_style_max_width(lbl, SAFE_CONTENT_W - 40, 0);
        lv_label_set_long_mode(lbl, LV_LABEL_LONG_DOT);
        lv_obj_set_style_text_align(lbl, LV_TEXT_ALIGN_CENTER, 0);
        lv_obj_set_style_text_font(lbl, &geist_reg_25, 0);
        lv_obj_set_style_text_color(lbl, run ? COL_ORANGE : done ? COL_MUTED : COL_FG, 0);
        lv_label_set_text(lbl, clean);
    }
    // Show at most 3 rows; the rest scroll inside the box. Measure a row's real height (each is one
    // line) and pin the box to exactly 3 rows so the Working status + time/tokens stay on screen below.
    lv_obj_update_layout(p->todo);
    if (lv_obj_get_child_count(p->todo) > TODO_VISIBLE_ROWS) {
        lv_coord_t rowh = lv_obj_get_height(lv_obj_get_child(p->todo, 0));
        lv_obj_set_height(p->todo, rowh * TODO_VISIBLE_ROWS + 7 * (TODO_VISIBLE_ROWS - 1) + 2);
    }
    // Keep the in_progress item visible when the list scrolls (the user can still scroll freely; the
    // next update re-centers on the active task).
    if (active_row) lv_obj_scroll_to_view(active_row, LV_ANIM_OFF);
    display_unlock();
}

// Apply either a live commander event or a persisted historical recap. A restored recap updates the
// card underneath Working but must never own/clear the live turn lifecycle.
static void project_apply_event(const char *chat_id, const char *kind,
                                const char *text, const char *recap, bool restored)
{
    const char *pid = (chat_id && chat_id[0]) ? chat_id : "(none)";
    display_lock();
    int i = find_proj(pid);
    if (i < 0) i = add_proj(pid);
    if (i < 0) { display_unlock(); return; }
    tile_t *p = &s_tiles[i];

    bool live = p->content_live;   // is this tile's content on-screen? if not, we only update the model

    // "processing" is a transient status (server 2s heartbeat / "Summarizing…"), NOT a ring-buffer
    // event. It flips the model's busy flag; the Working… row (orange gerund + grey elapsed·tokens) is
    // built from the model — now if this tile is materialized, else when it's swiped into. Cleared the
    // moment a real event lands. Rows updated by busy_dots_tick (elapsed 1s / verb 6s).
    if (kind && strcmp(kind, "processing") == 0) {
        if (restored) { display_unlock(); return; }   // never resurrect transient state from history
        bool started = !p->busy_model;
        if (started) { p->busy_model = true; p->busy_since = esp_timer_get_time(); p->busy_tokens = 0; overview_working_apply(); agent_actions_apply(); }
        // Live proof-of-life: stamp the time of this 'processing' frame. Both the turn (Processing) and the
        // trailing summarize (Summarizing…) heartbeat here every ~5s; ui_prune_stale_busy() clears the tile
        // if the stamps stop arriving (a terminal event was lost or never produced), so busy never wedges.
        p->busy_last_ms = esp_timer_get_time();
        // A turn just (re)started. If the user fired it by voice from the full-text reader, pop back to
        // the projects view and focus this tile so they watch it work (this also materializes it).
        if (started && lv_screen_active() == scr_reader) {
            lv_screen_load(scr_projects);
            carousel_goto(col_for_ring_near(carousel_col(), ring_of_agent(i)), LV_ANIM_OFF);   // nearest column showing agent i
            s_active_idx = i;
            update_content_window();
            live = p->content_live;
        }
        if (live) {
            render_busy_row(p);                                          // no-op if already built
            if (p->list) lv_obj_add_flag(p->list, LV_OBJ_FLAG_HIDDEN);   // hide the card; only the working row shows
            update_stop_btn();
        }
        display_unlock();
        return;
    }
    // Only a LIVE real event (summary/done/error/…) ends the turn. Historical recap can race a freshly
    // replayed processing frame after machine selection; keep Working visible and update its hidden card.
    if (!restored) {
        p->busy_model = false;
        if (live) { clear_busy(p); update_stop_btn(); }
        overview_working_apply();   // turn ended → drop the Overview "N working" count (live or off-window)
        agent_actions_apply();      // …and restore the actions if this is the tile on screen
    }

    // A bare terminal 'done' (generic fallback the backend sends when NO turn-summary was produced) is
    // only a signal to clear the "Processing" status — not readable content. Keep the last real card.
    if (kind && strcmp(kind, "done") == 0 && (!text || !text[0] || strcmp(text, "done") == 0)) {
        display_unlock();
        return;
    }

    const char *sym; lv_color_t col;
    kind_style(kind, &sym, &col);
    const char *body = (text && text[0]) ? text : (kind ? kind : "");
    // Scratch in PSRAM (~5.3KB off internal RAM): all four fields are used within this one call, which
    // runs on the small commander WS task and is serialized under display_lock. Was static .bss; on the
    // stack it overflowed and smashed the return address (crash on long events), hence the shared buffer.
    static struct emit_scratch { char clean[2100]; char full[2160]; char preview[520]; char recap_clean[512]; } *s_emit;
    if (!s_emit) s_emit = ram_psram_alloc(sizeof(*s_emit), "event_format_scratch");
    if (!s_emit) { display_unlock(); return; }   // PSRAM exhausted (never in practice) → bail, don't crash
    char *clean = s_emit->clean, *full = s_emit->full, *preview = s_emit->preview, *recap_clean = s_emit->recap_clean;
    utf8_filter(body, clean, sizeof(s_emit->clean));          // drop glyphs the font can't render (CJK/emoji)
    snprintf(full, sizeof(s_emit->full), "%s%s", sym, clean); // marker + renderable text (for the reader)

    // Tile shows a short preview; when a `recap` headline is provided (summary card) show it IN FULL,
    // otherwise clip `full` as a teaser.
    const char *preview_src = full;
    int limit = PREVIEW_BYTES;
    if (recap && recap[0]) {
        utf8_filter(recap, recap_clean, sizeof(s_emit->recap_clean));  // drop unrenderable glyphs
        if (recap_clean[0]) { preview_src = recap_clean; limit = (int)sizeof(s_emit->preview) - 8; }
    }
    int plen = utf8_clip(preview_src, limit);
    memcpy(preview, preview_src, plen);
    if ((int)strlen(preview_src) > plen) { memcpy(preview + plen, "\xE2\x80\xA6", 3); plen += 3; } // …
    preview[plen] = '\0';

    // Update atomically so a PSRAM OOM never discards the previous readable recap.
    char *next_preview = dup_str(preview);
    char *next_full = dup_str(full);
    if (!next_preview || !next_full) {
        free(next_preview);
        free(next_full);
        display_unlock();
        return;
    }
    free(p->m_preview); p->m_preview = next_preview;
    free(p->m_full);    p->m_full = next_full;
    p->m_col = col;

    if (!live) {
        // Off-window: the model is enough; the card renders when the agent's column enters the window.
        // If this agent IS currently in the visible window (e.g. freshly added), the refresh materializes it.
        update_content_window();
        display_unlock();
        return;
    }

    // Live render into the on-screen list. Drop the placeholder, dedup an exact repeat (the backend can
    // emit the same event twice), trim to MAX_EVENTS, then draw the card.
    if (p->empty) { lv_obj_delete(p->empty); p->empty = NULL; }
    uint32_t n0 = p->list ? lv_obj_get_child_count(p->list) : 0;
    if (n0 > 0) {
        lv_obj_t *last = lv_obj_get_child(p->list, n0 - 1);
        const char *prev = last ? (const char *)lv_obj_get_user_data(last) : NULL;
        if (prev && strcmp(prev, full) == 0) { display_unlock(); return; }
    }
    uint32_t cnt = p->list ? lv_obj_get_child_count(p->list) : 0;
    while (cnt >= MAX_EVENTS) {
        lv_obj_t *oldest = lv_obj_get_child(p->list, 0);
        if (!oldest) break;
        lv_obj_delete(oldest);
        cnt--;
    }
    render_event_card(p, preview, full, col);
    display_unlock();
}

// Append a live commander event to a project's tile, keeping only the last MAX_EVENTS.
void ui_tile_emit(const char *chat_id, const char *kind, const char *text, const char *recap)
{
    project_apply_event(chat_id, kind, text, recap, false);
}

void ui_tile_restore_event(const char *chat_id, const char *kind, const char *text, const char *recap)
{
    project_apply_event(chat_id, kind, text, recap, true);
}

void ui_tile_clear_event(const char *chat_id)
{
    if (!chat_id || !chat_id[0]) return;
    display_lock();
    int i = find_proj(chat_id);
    if (i < 0) { display_unlock(); return; }
    tile_t *p = &s_tiles[i];
    free(p->m_preview); p->m_preview = NULL;
    free(p->m_full);    p->m_full = NULL;
    p->m_col = COL_FG;

    if (p->content_live && p->list) {
        while (lv_obj_get_child_count(p->list) > 0) {
            lv_obj_t *child = lv_obj_get_child(p->list, 0);
            if (!child) break;
            lv_obj_delete(child);
        }
        p->empty = NULL;
        if (!p->busy_model) {
            lv_obj_clear_flag(p->list, LV_OBJ_FLAG_HIDDEN);
            p->empty = make_label(p->list, "No activity yet", lv_color_hex(0x585863), &geist_reg_38);
        }
    }
    display_unlock();
}

// ---- AskUserQuestion: answer the agent's question from the round screen ----
// ONE question with N options, where the reference carried a list of questions each with its own answer
// key and a multi-select mode. `question` (docs/panel-protocol.md §2) is a single summary, an optional
// command and a flat `options[]` of {id, label} — an agent asking permission to run one command.
//
// **`options` is the whole set of answers.** The device must not invent one and must not assume two: the
// count varies with what the agent offered, which is why OPT_MAX is a cap on rendering rather than a
// shape the code relies on.
#define OPT_MAX 6
#define OPT_ID_MAX 40      // option id — opaque, echoed back verbatim in `answer`

static EXT_RAM_BSS_ATTR struct {
    bool active;
    char id[80];                      // the app's handle for this request. OPAQUE — echoed unchanged.
    char project[ID_MAX];
    char summary[200];
    char command[160];                // the command the agent wants to run; "" when it named none
    char opt_id[OPT_MAX][OPT_ID_MAX];
    char opt_label[OPT_MAX][80];
    int  n_options;
} s_q;

static void q_render(void);
static void q_cancel(void);
static void q_opt_tap(lv_event_t *e);
static void q_back_tap(lv_event_t *e);

// A non-interactive wrapped text line (question prompt, header, status).
static void q_add_text(const char *txt, lv_color_t col, const lv_font_t *font)
{
    lv_obj_t *l = lv_label_create(scr_question);
    lv_label_set_long_mode(l, LV_LABEL_LONG_WRAP);
    lv_obj_set_width(l, lv_pct(100));
    lv_obj_set_style_text_font(l, font, 0);
    lv_obj_set_style_text_color(l, col, 0);
    lv_obj_set_style_text_align(l, LV_TEXT_ALIGN_CENTER, 0);
    lv_label_set_text(l, txt);
}

// Option text is capped to a word budget for RENDER COST, not for tidiness. An option label wraps, so a
// long one becomes a tall box, and a screenful of tall boxes is what pinned the LVGL task long enough for
// the task watchdog to fire every 5s with the UI frozen. The full label is still what gets ANSWERED —
// q_opt_tap and q_done_tap both read q->options[i], never what is on screen.
//
// Cut on spaces only, so a multi-byte character can never be split (0x20 cannot appear inside a UTF-8
// sequence). The marker is a real ellipsis: U+2026 IS in geist_med_32 (its cmap has a sparse
// U+2013..U+2717 range on top of the ASCII/Latin ones — an earlier reading decoded only the first sparse
// range and wrongly concluded the glyph was missing). It is worth having at all because two long options
// that share their first ten words would otherwise render identical, and the choice becomes a guess.
#define Q_OPT_MAX_WORDS 10
static void q_clip_words(const char *src, char *out, size_t cap, int max_words)
{
    if (!out || cap == 0) return;
    out[0] = '\0';
    if (!src) return;

    int words = 0;
    bool in_word = false;
    size_t cut = 0;                                   // 0 = the budget was never reached
    for (size_t i = 0; src[i]; i++) {
        if (src[i] != ' ') {
            if (!in_word) { in_word = true; if (++words > max_words) { cut = i; break; } }
        } else {
            in_word = false;
        }
    }

    size_t keep = cut ? cut : strlen(src);
    while (keep && src[keep - 1] == ' ') keep--;       // no dangling space before the marker
    const char *mark = cut ? "\u2026" : "";
    size_t mlen = strlen(mark);
    if (keep + mlen + 1 > cap) keep = (cap > mlen + 1) ? cap - mlen - 1 : 0;
    while (keep && ((unsigned char)src[keep] & 0xC0) == 0x80) keep--;   // byte cap must not split a glyph
    memcpy(out, src, keep);
    memcpy(out + keep, mark, mlen);
    out[keep + mlen] = '\0';
}

// A big full-width BUTTON (large touch target — bare labels were too thin to hit reliably and the
// scroll container swallowed the press). `idx` is stashed on the button for the tap handler.
static lv_obj_t *q_add_btn(const char *txt, lv_color_t txtcol, lv_color_t bg, lv_event_cb_t cb, int idx)
{
    lv_obj_t *b = lv_button_create(scr_question);
    lv_obj_set_width(b, lv_pct(100));
    lv_obj_set_style_bg_color(b, bg, 0);
    // A SIMPLE box. Two deliberate cheapenings, both about the software renderer:
    //   · shadow_width 0 — lv_button_create inherits the default theme's shadow (LV_DPX(3) @ OPA_50), and
    //     LVGL draws it with a software BLUR. That blur, over a screenful of full-width option boxes, is
    //     where the LVGL task was pinned when this screen froze the device.
    //   · a modest radius instead of LV_RADIUS_CIRCLE — a full pill on a multi-line box means a much
    //     larger rounded mask to compose, for a shape that reads no better once the text wraps.
    lv_obj_set_style_shadow_width(b, 0, 0);
    lv_obj_set_style_radius(b, 14, 0);
    lv_obj_set_style_pad_ver(b, 14, 0);
    lv_obj_set_style_pad_hor(b, 18, 0);
    lv_obj_set_style_border_width(b, 0, 0);
    lv_obj_t *l = lv_label_create(b);
    lv_label_set_long_mode(l, LV_LABEL_LONG_WRAP);
    lv_obj_set_width(l, lv_pct(100));
    lv_obj_set_style_text_font(l, &geist_med_32, 0);   // Figma option/button text 32px
    lv_obj_set_style_text_color(l, txtcol, 0);
    lv_obj_set_style_text_align(l, LV_TEXT_ALIGN_CENTER, 0);
    lv_label_set_text(l, txt);
    lv_obj_center(l);
    if (cb) {
        lv_obj_set_user_data(b, (void *)(intptr_t)idx);
        lv_obj_add_event_cb(b, cb, LV_EVENT_CLICKED, NULL);
    }
    return b;
}

// Rebuild the question screen for the current question (caller holds the lock). Figma layout:
// bold prompt title (32px) · dark option pills (selected → green ✓) · blue "Done". Tap-only: a question
// is answered by picking an option, never by voice.
static void q_render(void)
{
    lv_obj_clean(scr_question);
    static char tmp[256];
    utf8_filter(s_q.summary, tmp, sizeof(tmp));
    q_add_text(tmp[0] ? tmp : "?", COL_FG, &geist_med_32);                       // the summary IS the title
    // The command, when the agent named one. Set in the code pill's green mono rather than as another line
    // of prose: this is the thing the user is being asked to allow, and it must not read as the sentence
    // above it. `command` is optional on the wire and absent means "no command", not an empty one.
    if (s_q.command[0]) {
        char cmd[200]; utf8_filter(s_q.command, cmd, sizeof(cmd));
        char shown[200]; q_clip_words(cmd, shown, sizeof(shown), 12);
        code_pill(scr_question, shown);
    }
    for (int i = 0; i < s_q.n_options; i++) {
        char ftxt[100]; utf8_filter(s_q.opt_label[i], ftxt, sizeof(ftxt));
        char shown[100]; q_clip_words(ftxt, shown, sizeof(shown), Q_OPT_MAX_WORDS);   // display only
        q_add_btn(shown, COL_FG, COL_SET_PILL, q_opt_tap, i);                    // dark box, white text
    }
}

// Send `answer` and return to the projects view. Caller holds the lock.
//
// `id` and `optionId` go back EXACTLY as they arrived. Both are the app's, opaque here — the panel has no
// vocabulary of its own for either, and re-deriving one from the label the user tapped is how a rename on
// the app side turns into an answer nobody asked for.
//
// An answer for an id the app has already settled is discarded silently at the far end, not an error: the
// desktop shows the same question and the two surfaces race by design.
static void q_answer(int oi)
{
    if (oi < 0 || oi >= s_q.n_options) return;
    char id[sizeof(s_q.id)], opt[OPT_ID_MAX], project[ID_MAX];
    snprintf(id, sizeof(id), "%s", s_q.id);
    snprintf(opt, sizeof(opt), "%s", s_q.opt_id[oi]);
    snprintf(project, sizeof(project), "%s", s_q.project);
    ESP_LOGI(TAG, "answer %s -> %s", id, opt);
    s_q.active = false;
    int ri = find_proj(project);   // land back on the answered project, where the turn resumes
    lv_screen_load(scr_projects);
    if (ri >= 0) { carousel_goto(col_for_ring_near(carousel_col(), ring_of_agent(ri)), LV_ANIM_OFF); s_active_idx = ri; update_content_window(); }
    panel_client_answer(project, id, opt);
}

// Dismiss WITHOUT answering (caller holds lock) — back out to the projects view. The agent's turn stays
// waiting; the user can answer at the desktop, or stop the turn from the tile.
static void q_cancel(void)
{
    ESP_LOGI(TAG, "question dismissed (id=%s)", s_q.id);
    s_q.active = false;
    int ri = find_proj(s_q.project);
    lv_screen_load(scr_projects);
    if (ri >= 0) { carousel_goto(col_for_ring_near(carousel_col(), ring_of_agent(ri)), LV_ANIM_OFF); s_active_idx = ri; update_content_window(); }
}

// Called by ui_tile_remove while the display lock is held. Process lifetime wins over transient UI:
// a deleted active/busy agent cannot leave a capture overlay or an AskUserQuestion screen orphaned.
static void clear_removed_project_transients_locked(const char *chat_id, bool voice_aborted)
{
    if (voice_aborted) {
        s_voice_routing = false;
        s_voice_route_ms = 0;
        voice_icon_apply(VIC_NONE);
        voice_overlay_set(false);
        update_stop_btn();
    }
    if (s_q.active && strcmp(s_q.project, chat_id) == 0) {
        memset(&s_q, 0, sizeof(s_q));
        if (lv_screen_active() == scr_question) lv_screen_load(scr_projects);
    }
}

// "‹ Back": dismiss the whole question (the turn stays waiting).
static void q_back_tap(lv_event_t *e)
{
    (void)e;
    display_lock();
    if (s_q.active) q_cancel();
    display_unlock();
}

static void q_opt_tap(lv_event_t *e)
{
    int oi = (int)(intptr_t)lv_obj_get_user_data(lv_event_get_target(e));
    display_lock();
    if (s_q.active) q_answer(oi);
    display_unlock();
}

void ui_question_show(const char *chat_id, const char *id, const char *summary,
                      const char *command, const struct cJSON *options)
{
    if (!id || !id[0] || !options) return;
    display_lock();
    // The same question can be re-sent (a reconnect re-states what is waiting). Same id, same card.
    if (s_q.active && strcmp(s_q.id, id) == 0) { display_unlock(); return; }
    memset(&s_q, 0, sizeof(s_q));
    snprintf(s_q.id, sizeof(s_q.id), "%s", id);
    snprintf(s_q.project, sizeof(s_q.project), "%s", chat_id ? chat_id : "");
    snprintf(s_q.summary, sizeof(s_q.summary), "%s", summary ? summary : "");
    snprintf(s_q.command, sizeof(s_q.command), "%s", command ? command : "");

    const cJSON *op;
    cJSON_ArrayForEach(op, (const cJSON *)options) {
        if (s_q.n_options >= OPT_MAX) break;
        const cJSON *oid = cJSON_GetObjectItemCaseSensitive(op, "id");
        const cJSON *lbl = cJSON_GetObjectItemCaseSensitive(op, "label");
        // An option with no id cannot be answered — `answer.optionId` is the whole of what is sent back —
        // so drawing it would offer a button that could only fail. Skipped, not faked.
        if (!cJSON_IsString(oid) || !oid->valuestring[0]) continue;
        snprintf(s_q.opt_id[s_q.n_options], OPT_ID_MAX, "%s", oid->valuestring);
        snprintf(s_q.opt_label[s_q.n_options], sizeof(s_q.opt_label[0]), "%s",
                 cJSON_IsString(lbl) && lbl->valuestring[0] ? lbl->valuestring : oid->valuestring);
        s_q.n_options++;
    }
    // No usable option = no card. The device must not invent one, and a question with nothing to tap is a
    // dead screen the user cannot leave except by swiping away from something that looks answerable.
    if (s_q.n_options == 0) { ESP_LOGW(TAG, "question %s carried no usable option", id); display_unlock(); return; }
    s_q.active = true;
    ESP_LOGI(TAG, "question shown (id=%s opts=%d)", s_q.id, s_q.n_options);
    if (display_is_asleep()) display_wake();
    q_render();
    lv_screen_load(scr_question);
    display_unlock();
    audio_notify_done();   // audible alert so the user notices a question is waiting
}

// `question.cancel` — the desktop answered first, or the app's own timer gave up (55 s today; the agent
// stops waiting at 60). It can arrive AT ANY MOMENT and will, because the same question is on two
// surfaces. A panel that ignored this would hold a dead card forever.
//
// Matched on the id so a cancel for a question this panel already answered, or never saw, is a no-op
// rather than a screen change.
void ui_question_cancel(const char *chat_id, const char *id)
{
    (void)chat_id;
    display_lock();
    if (s_q.active && id && strcmp(s_q.id, id) == 0) {
        ESP_LOGI(TAG, "question.cancel %s", id);
        q_cancel();
    }
    display_unlock();
}

// True while a card is up. Voice is refused then — a question is answered by tapping an option, never by
// speaking — and fw_update.c will not start an install over one.
bool ui_awaiting_answer(void)
{
    return s_q.active;
}


// Silent auto-abort: a recording that captured no speech in its first VOICE_SILENCE_MS (accidental / forgotten
// Voice press). Discards it (audio_client_abort → no voice_end, nothing reaches the backend) and restores the
// UI, same teardown as the quota path, with a brief note so the disappearing overlay isn't a mystery.
static void ui_voice_discard_silent(void)
{
    ESP_LOGI(TAG, "voice: no speech in first %us — auto-discard", VOICE_SILENCE_MS / 1000);
    if (voice_active()) voice_abort();
    display_lock();
    s_voice_routing = false;
    s_voice_route_ms = 0;
    voice_icon_apply(VIC_NONE);
    voice_overlay_set(false);
    update_stop_btn();
    display_unlock();   // silent: no speech → just close, no toast
}


// Track which project tile is visible (the tile-act getter is unset until the first swipe).
static void tile_changed(lv_event_t *e)
{
    (void)e;
    apply_active_from_col();   // active/settings from the centered ring position
    update_content_window();   // materialize the newly-active tile ± window, free the rest
    rebuild_page_dots();       // move the green sparkle to the newly-centered page
    // Swiping onto an agent's tile = the user saw it → drop that agent's notification (if any).
    if (!s_overview_active && !s_settings_active &&
        s_active_idx >= 0 && s_active_idx < s_tile_count && s_tiles[s_active_idx].id[0]) {
        notif_remove(s_tiles[s_active_idx].id);
    }
    update_stop_btn();    // STOP follows the newly-visible tile's processing state (hidden on settings)
    voice_btn_apply_visibility();
    notif_badge_apply();            // unread pill hides on the Settings tile / shows on a project tile
}

// Circular carousel via a huge virtual range (CAROUSEL_M / ring_of_col): Settings repeats every (N+1)
// columns, so Settings ↔ ANY agent (including the "last" one) is always a native adjacent slide. There is
// NO edge and NO wrap jump. ui_swipe_begin/end only route the machine/reader screens back to projects;
// horizontal paging is pure native scroll handled by the container.
void ui_swipe_begin(void) { }
void ui_swipe_end(int dir)
{
    (void)dir;
    if (lv_screen_active() == scr_reader) { reader_close(NULL); return; }   // horizontal swipe on the detail reader → back to the main projects screen
}

// Voice-state queries for the gesture layer (touch.c). recording = actively capturing (a tap stops it);
// active = recording OR the clip still uploading (blocks a new start). Both run on the LVGL task.
bool ui_voice_is_recording(void) { return s_vic_state == VIC_MIC || s_vic_state == VIC_REC; }
bool ui_voice_is_active(void)    { return voice_active(); }

// A plain (deferred, non-recording) tap toggles the detail reader: on the reader → back to projects; on
// a project tile → open that project's detail. No-op on the Settings tile / other screens. Runs on the
// LVGL task, so no extra lock needed.
void ui_tap(void)
{
    if (lv_screen_active() == scr_reader) { reader_close(NULL); return; }
    if (on_project_page() && s_active_idx >= 0 && s_active_idx < s_tile_count) {
        tile_t *p = &s_tiles[s_active_idx];
        // While the agent is working, the tile shows the LIVE status ("Cooking… 34s" + tool line); the
        // reader would only show the PREVIOUS turn's stale text. Keep the live view — don't open detail.
        if (p->busy_model) return;
        // The headline is on the tile; the reader shows the BODY or says there is none. Still a no-op
        // when the tile has nothing at all — there is no turn to read about.
        if (p->m_preview) open_reader_text(p->m_full && p->m_full[0] ? p->m_full : READER_NO_BODY);
    }
}

// Vertical edge-swipe (from touch.c). dir: +1 = swipe up, -1 = swipe down. Swipe-up on a project opens
// its detail reader; swipe-down at the top of the reader closes it (else LVGL just scrolls the text).
// Show STOP only when the active tile is processing AND we aren't recording voice (mutually
// exclusive with the mic, which shares the bottom-center spot). Caller holds the display lock.
static void update_stop_btn(void)
{
    // On-screen STOP removed — the physical BOOT button cancels the running turn now. Keep it hidden.
    if (stop_btn) lv_obj_add_flag(stop_btn, LV_OBJ_FLAG_HIDDEN);
}

// Cancel the running turn of the visible project (physical BOOT button, or the legacy STOP tap). Only
// acts when that tile is actually processing, so a press while idle doesn't emit a stray "Cancelled".
// Safe to call from a non-LVGL task.
void ui_boot_pressed(void)
{
    // While a question is shown, BOOT means "back" (cancel voice / dismiss the question). Otherwise, if
    // the visible project is WORKING, pop a "Cancel task?" confirm (a running turn is always shown on
    // the projects screen) so an accidental press can't kill it. Nothing running → ignore.
    display_lock();
    bool q = s_q.active;
    int idx = (s_active_idx >= 0 && s_active_idx < s_tile_count) ? s_active_idx : 0;
    bool processing = (!q && s_tile_count > 0 && !s_overview_active && !s_settings_active
                       && s_tiles[idx].busy != NULL);
    if (q) { display_unlock(); q_back_tap(NULL); return; }
    if (processing) {
        ESP_LOGI(TAG, "BOOT → show 'Cancel task?' confirm");
        lv_obj_clear_flag(s_cancel_confirm, LV_OBJ_FLAG_HIDDEN);
        overlay_raise(s_cancel_confirm);
    } else {
        ESP_LOGI(TAG, "BOOT → no working task, ignored");
    }
    display_unlock();
}

// "Cancel task?" confirm handlers (run on the LVGL task, already under the display lock).
static void cancel_confirm_no(lv_event_t *e)
{
    (void)e;
    lv_obj_add_flag(s_cancel_confirm, LV_OBJ_FLAG_HIDDEN);
}
static void cancel_confirm_yes(lv_event_t *e)
{
    (void)e;
    lv_obj_add_flag(s_cancel_confirm, LV_OBJ_FLAG_HIDDEN);
    ui_stop_active_turn();   // the actual interrupt
}


// Interrupt the visible project's turn.
//
// KEYED ON THE CHAT, where the reference keyed on a session id. `turn.stop` carries `chatId` and
// nothing else, and the id travels precisely because the panel can stop a project the desktop does not
// have open (docs/panel-protocol.md §2). The panel never sees a conversation, so there is no session here
// to name one with.
void ui_stop_active_turn(void)
{
    display_lock();
    int idx = (s_active_idx >= 0 && s_active_idx < s_tile_count) ? s_active_idx : 0;
    bool processing = (s_tile_count > 0 && !s_overview_active && !s_settings_active
                       && s_tiles[idx].busy != NULL);
    char pid[ID_MAX];
    snprintf(pid, sizeof(pid), "%s", processing ? s_tiles[idx].id : "");
    display_unlock();
    if (!processing || !pid[0]) return;   // nothing running → do nothing
    ESP_LOGI(TAG, "STOP → turn.stop %s", pid);
    panel_client_stop_project(pid);
    // Optimistic: drop the tile's Working row now. `turn.done` will also clear it — the app answers a stop
    // with one — so this only makes the tap feel immediate.
    display_lock();
    if (s_tile_count > 0) clear_busy(&s_tiles[idx]);
    update_stop_btn();
    display_unlock();
}

static void stop_event(lv_event_t *e)
{
    if (lv_event_get_code(e) != LV_EVENT_CLICKED) return;
    ui_stop_active_turn();
}

// --- Voice ---

// The project id of the currently-visible tile, or "" on the Overview.
//
// The reference had a companion ui_get_active_session_id(); it is gone. `turn.send`, `turn.stop` and
// `answer` all key on the PROJECT — the panel never sees a conversation, and grid-app decides which one
// the words go into (docs/panel-protocol.md §2).
const char *ui_active_tile_id(void)
{
    static char out[ID_MAX];
    out[0] = '\0';
    display_lock();
    // Settings excluded deliberately: this is what voice_start_impl asks to decide whether the user named
    // a project or spoke from a screen that names none. Answering with the last project looked at would
    // make a sentence spoken on the Settings page dispatch itself into it.
    if (s_tile_count > 0 && !s_overview_active && !s_settings_active) {
        int idx = (s_active_idx >= 0 && s_active_idx < s_tile_count) ? s_active_idx : 0;
        snprintf(out, sizeof(out), "%s", s_tiles[idx].id);
    }
    display_unlock();
    return out;
}

static void voice_start_impl(voice_cmd_t cmd)
{
    // A question is answered by TAPPING an option — never by voice. The question screen owns the button
    // while it is up, so a press (or a GOAL long-press) here does nothing rather than starting a stray
    // recording behind the dialog.
    display_lock();
    bool q_active = s_q.active;
    display_unlock();
    if (q_active) return;

    // Not while the screen is locked.
    //
    // ⚠️ THE REFERENCE DOES NOT DO THIS, and it is not an oversight worth copying: `ui_lock_active()` is
    // declared and defined over there with **no readers at all**. The gesture layer runs its recognisers in
    // the raw indev callback, BEFORE LVGL hit-tests anything, so the lock overlay never sees the touch that
    // matters — a gesture under "Draw Pattern to Unlock" would start recording, upload the clip and
    // dispatch a turn into somebody's repository, with the lock screen still up the whole time.
    //
    // A lock that stops nothing it was put there to stop is worse than no lock, because it is believed.
    if (ui_lock_active()) { ESP_LOGW(TAG, "voice: the screen is locked"); return; }

    if (voice_active()) { ESP_LOGW(TAG, "voice: already active"); return; }
    // Gate on the SESSION, not on a cable: usb_serial_jtag_is_connected() is true of any running computer
    // with the lead in, including one with grid-app closed. Recording into that is recording into nothing.
    if (!panel_client_is_connected()) { ESP_LOGW(TAG, "voice: no session with grid-app"); return; }
    char pid_buf[ID_MAX];
    snprintf(pid_buf, sizeof(pid_buf), "%s", ui_active_tile_id());   // its buffer is static; copy it
    const char *pid = pid_buf;
    bool route = false;
    if (!pid[0]) {
        // No focused project tile. From the OVERVIEW both a normal voice turn and a GOAL press are ROUTE
        // turns: `voice.begin` OMITS `chatId` and grid-app has to work out where the transcript goes —
        // and, when it has to guess, answer with `needsConfirm` rather than dispatch.
        display_lock(); bool overview = s_overview_active; display_unlock();
        if (!overview) { ESP_LOGW(TAG, "voice: no active chat tile"); return; }
        route = true;
    }
    ESP_LOGI(TAG, "voice start: %s", route ? "ROUTE(overview)" : pid);
    // Interrupt any RUNNING turn first, so the new spoken instruction takes over instead of queueing
    // behind it. Guarded on the tile actually processing: `turn.stop` on an idle project is not a no-op at
    // the far end — it ends a turn that was not running and the tile reports the cancellation.
    display_lock();
    int aidx = (s_active_idx >= 0 && s_active_idx < s_tile_count) ? s_active_idx : 0;
    bool processing = (!route && s_tile_count > 0 && s_tiles[aidx].busy != NULL);   // route has no focused project
    display_unlock();
    if (processing) { ESP_LOGI(TAG, "voice → interrupt the running turn first (%s)", pid); panel_client_stop_project(pid); }
    // Show the mic indicator (red) — it's hidden whenever we're not recording. Clear the active tile's
    // processing row + hide STOP (the mic owns the bottom-center spot while recording).
    display_lock();
    s_voice_start_ms = lv_tick_get();             // arm the VOICE_MAX_MS cap (busy_dots_tick)
    s_voice_max_ms = VOICE_MAX_MS;
    s_voice_routing = route;                       // route (Overview) voice → hold the loading overlay past upload
    s_voice_route_ms = 0;                          // (armed at upload-complete in busy_dots_tick)
    // Show WHICH command is being recorded. This is what makes it safe to reset the select only after the
    // utterance ends: the choice stays visible for the whole capture instead of vanishing at the tap.
    s_voice_cmd = cmd;
    if (s_voice_goal_lbl) {
        lv_label_set_text(s_voice_goal_lbl, cmd == VOICE_CMD_LOOP ? "LOOP" : "GOAL");
        lv_obj_set_style_text_color(s_voice_goal_lbl, cmd == VOICE_CMD_LOOP ? COL_ACCENT : COL_ORANGE, 0);
    }
    voice_icon_apply(VIC_MIC);                    // press → mic icon
    voice_overlay_set(true);                      // dark overlay + free all tile content (RAM for the upload)
    lv_timer_create(vic_to_rec_cb, 450, NULL);    // → recording bars after a brief beat
    if (!route && s_tile_count > 0) clear_busy(&s_tiles[aidx]);
    update_stop_btn();
    display_unlock();
    // NULL project id on a route turn: `voice.begin` then omits the key entirely, and that ABSENCE is the
    // message — it tells grid-app the user spoke from a screen that names no project, so it has to route
    // the transcript itself and ask. An empty string would be a project id, one that matches nothing.
    voice_start(route ? NULL : pid, cmd);
}

// Double-tap on an agent tile / its reader (touch.c). The Overview and the tiles' own action rows call
// voice_start_impl directly with the command they mean; this is the gesture's way in, and it means the
// plain kind — a Goal or a Loop is a deliberate thing you pick, not something a gesture should guess.
void ui_voice_start(void) { voice_start_impl(VOICE_CMD_NONE); }

void ui_voice_stop(void)
{
    // Hide the recording indicator FIRST and unconditionally: voice_stop() can block
    // (WS stop/destroy, esp. if the socket was mid-connect during a backend restart), and the
    // mic icon must never stay stuck on screen after recording ends.
    // Recording ended → the clip now uploads (audio_client stays active). Swap the mic for a "Sending…"
    // label so the ~15s upload isn't a silent void; busy_dots_tick hides it once the upload completes.
    display_lock();
    if (voice_active()) { voice_icon_apply(VIC_SEND); }   // recording ended → sending spinner (overlay stays up, content stays freed until busy_dots_tick sees the upload finish)
    else                       { s_voice_routing = false; s_voice_route_ms = 0; voice_icon_apply(VIC_NONE); voice_overlay_set(false); }  // nothing to send → restore the UI now
    update_stop_btn();
    display_unlock();
    if (voice_active()) voice_stop();
}


// ── THE MACHINE ─────────────────────────────────────────────────────────────────────────────────────
// One name, from `welcome.machine.name`. The reference kept a list and a picker; there is exactly one
// machine here — the computer holding the cable — so the name is a string and the picker is gone.
void ui_set_machine_name(const char *name)
{
    display_lock();
    snprintf(s_machine_name, sizeof(s_machine_name), "%s", name && name[0] ? name : "");
    if (s_overview_machine_lbl)
        lv_label_set_text(s_overview_machine_lbl, s_machine_name[0] ? s_machine_name : "Machine");
    if (s_na_eyebrow) lv_label_set_text(s_na_eyebrow, s_machine_name);
    display_unlock();
}

// Swipe the carousel end to end, `passes` times, so a stutter can be MEASURED instead of described.
//
// A finger cannot do this: swipe speed and length vary per try, which is exactly the variance that makes
// "is it smoother now?" unanswerable. It is a floor, not the whole cost — an animated scroll_to is
// cheaper than a drag, because a drag also runs the touch driver and LVGL's momentum. A number that gets
// WORSE here is real; a number that looks fine here still has to be confirmed with a finger.
void ui_scroll_benchmark(int passes)
{
    if (passes < 1) passes = 1;
    if (passes > 20) passes = 20;
    // No guard on s_tile_count: with none the ring is still two pages (the Overview and the empty page)
    // and scrolling between them is exactly the measurement that isolates the frame from the content.
    for (int p = 0; p < passes; p++) {
        for (int r = 0; r < ring_len(); r++) {
            display_lock();
            carousel_goto(col_for_ring_near(carousel_col(), r), LV_ANIM_ON);
            display_unlock();
            vTaskDelay(pdMS_TO_TICKS(600));
        }
    }
}

// A message that says itself and then gets out of the way.
//
// ui_show_error() loads a screen and STAYS there, which is right for a version mismatch and wrong for a
// voice press that caught no speech: the panel would be stuck on a notice about something that already
// finished. The reference has machine_toast() for exactly this and it went with the Machines page; this
// is that idea on a screen this device does have.
static void notice_expire_cb(lv_timer_t *t)
{
    if (lv_screen_active() == scr_error) lv_screen_load(scr_projects);
    lv_timer_delete(t);
}

void ui_show_notice(const char *title, const char *body)
{
    display_lock();
    ui_show_error(title, body);           // takes the lock again; it is recursive
    lv_timer_create(notice_expire_cb, 6000, NULL);
    display_unlock();
}

// ── FIRMWARE UPDATE ─────────────────────────────────────────────────────────────────────────────────
// The panel is rewriting its own flash and must not look frozen while it does. One screen — a spinner
// and one line — because that is what an update is here: a wait with a name on it.
//
// The reference builds a whole self-contained progress screen (ui_ota_boot_*) with its own bar, because
// its update happens in a dedicated boot mode where ui_init has not run and there is no other screen to
// borrow. That mode does not exist on this device: the image arrives over the cable that is already
// attached, in the middle of an ordinary session, with every screen already built.
//
// The panel keeps drawing through the flash writes. It scans its frame buffer out of PSRAM and every
// flash write disables the cache — which is the case CONFIG_SPIRAM_XIP_FROM_PSRAM exists for. If a
// future change ever brings back a strobing panel here, check that option before reaching for
// display_sleep().
static void fw_screen(const char *line)
{
    display_lock();
    if (!scr_fw) {
        scr_fw = make_screen();
        lv_obj_set_style_pad_row(scr_fw, 22, 0);
        make_spinner(scr_fw, 88);
        s_fw_lbl = make_label(scr_fw, "", COL_FG, &geist_reg_25);
        make_label(scr_fw, "Do not unplug", COL_MUTED, &geist_reg_20);
    }
    if (s_fw_lbl) lv_label_set_text(s_fw_lbl, line);
    if (display_is_asleep()) display_wake();
    if (lv_screen_active() != scr_fw) lv_screen_load(scr_fw);
    display_unlock();
}

void ui_fw_updating(const char *version)
{
    char step[64];
    snprintf(step, sizeof(step), "Updating to %s\xE2\x80\xA6", version && version[0] ? version : "a new build");
    fw_screen(step);
}

void ui_fw_progress(int pct)
{
    if (pct < 0) pct = 0;
    if (pct > 100) pct = 100;
    display_lock();
    if (s_fw_lbl) lv_label_set_text_fmt(s_fw_lbl, "Updating\xE2\x80\xA6 %d%%", pct);
    display_unlock();
}

void ui_fw_verifying(void)  { fw_screen("Checking the update\xE2\x80\xA6"); }
void ui_fw_restarting(void) { fw_screen("Restarting\xE2\x80\xA6"); }

void ui_fw_failed(const char *message)
{
    display_lock();
    scr_fw = NULL;   // it is a screen object; ui_show_error loads another and this one is rebuilt on demand
    s_fw_lbl = NULL;
    display_unlock();
    ui_show_error("Update failed", message && message[0] ? message : "The panel is still on its old firmware.");
}

// Is ANY project mid-turn? fw_update.c asks before accepting an offer: rebooting over a running turn
// costs work the panel then has to explain the loss of, and the app re-offers in fifteen seconds.
//
// Reads the MODEL, not the widgets — an off-window project holds no LVGL objects at all but its turn is
// just as real.
bool ui_any_tile_busy(void)
{
    display_lock();
    bool busy = false;
    for (int i = 0; i < s_tile_count && !busy; i++) busy = s_tiles[i].busy_model;
    display_unlock();
    return busy;
}

// ── THE TURN'S CLOCK ────────────────────────────────────────────────────────────────────────────────
// `turn.started` is the anchor, and anchoring it HERE rather than at the first step is the whole design.
//
// Every step in `turn.parts` carries `t0` — milliseconds from the start of the turn to the moment that
// step began — which does not change while the step runs. So the app can say nothing for a minute and the
// panel still draws a clock that ticks, off a payload that is standing still (docs/panel-protocol.md,
// `turn.parts`). The alternative, sending elapsed seconds, puts ~3 KB on the wire every second for a
// number the device could have counted.
//
// ⚠️ THE DEVICE MUST NOT TIMESTAMP A STEP WHEN IT FIRST SEES IT. The app re-sends the whole timeline
// after a panel reboot, and every step would then read as having just begun.
void ui_tile_turn_started(const char *chat_id)
{
    if (!chat_id || !chat_id[0]) return;
    display_lock();
    int i = find_proj(chat_id);
    if (i >= 0) {
        s_tiles[i].busy_since = esp_timer_get_time();
        s_tiles[i].busy_tokens = 0;
    }
    display_unlock();
    // Outside the branch on purpose: `turn.started` for a project this panel has never heard of still has
    // to create its tile, and emit does that.
    ui_tile_emit(chat_id, "processing", "", NULL);
}

// The recap card's tint, from `recapKind`.
//
// **An unrecognised value is drawn as `done`, never as an error.** Guessing "failed" on a turn that worked
// is the worse of the two mistakes: it invites someone to go and look for a problem that is not there,
// where the reverse merely under-sells one they will find in the recap anyway.
void ui_tile_set_recap_kind(const char *chat_id, const char *recap_kind)
{
    if (!chat_id || !chat_id[0]) return;
    display_lock();
    int i = find_proj(chat_id);
    if (i >= 0) {
        lv_color_t col = COL_FG;
        if (recap_kind && strcmp(recap_kind, "failed") == 0) col = COL_RED;
        else if (recap_kind && strcmp(recap_kind, "stopped") == 0) col = COL_MUTED;
        s_tiles[i].m_col = col;
        // Repaint only a card that is actually on screen; an off-window tile rebuilds from m_col on entry.
        if (s_tiles[i].content_live && s_tiles[i].list) {
            uint32_t n = lv_obj_get_child_count(s_tiles[i].list);
            if (n > 0) {
                lv_obj_t *card = lv_obj_get_child(s_tiles[i].list, n - 1);
                lv_obj_t *lbl = card ? lv_obj_get_child(card, 0) : NULL;
                if (lbl) lv_obj_set_style_text_color(lbl, col, 0);
            }
        }
    }
    display_unlock();
}

// The long form of the last recap, from the `summary` message — what the detail reader shows.
//
// OVERWRITES, never appends: it is keyed by chatId and describes THE LAST COMPLETED TURN. It also
// arrives late and may never arrive at all (no model reachable, the call failed), which is why the reader
// has to read as "nothing more to show" rather than as loading forever — it does, because it simply keeps
// showing the one-line recap the tile already has.
void ui_tile_set_summary(const char *chat_id, const char *text)
{
    if (!chat_id || !chat_id[0] || !text || !text[0]) return;
    display_lock();
    int i = find_proj(chat_id);
    if (i < 0) { display_unlock(); return; }
    tile_t *p = &s_tiles[i];
    static char clean[2100];
    utf8_filter(text, clean, sizeof(clean));
    char *next = dup_str(clean);
    if (next) { free(p->m_full); p->m_full = next; }   // atomic: a PSRAM OOM keeps the previous body
    // If the reader is open ON THIS PROJECT right now, refresh it in place. Anywhere else, the model is
    // enough — the reader reads m_full when it opens.
    if (reader_lbl && lv_screen_active() == scr_reader && s_active_idx == i) lv_label_set_text(reader_lbl, clean);
    display_unlock();
}
